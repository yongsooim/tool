ASAP2_VERSION 1 40
/begin PROJECT HVCU "Fuel Cell EV ECU for XC2786 Version"
/begin HEADER "HVCU" PROJECT_NO HVCU10 VERSION "A0A0" /end HEADER
/begin MODULE ETK "TENERGY"
/begin MOD_PAR " " VERSION " " ADDR_EPK 0x0 EPK "" CUSTOMER_NO "" USER "YISU" PHONE_NO "+82-2-473-1824" ECU "CIB2.2" CPU_TYPE "XC2786-96F"
 /begin MEMORY_LAYOUT PRG_CODE 0xC00000 0x2000 -1 -1 -1 -1 -1 /begin IF_DATA ASAP1B_CCP DP_BLOB 0xC00000 0x1FFF /end IF_DATA /end MEMORY_LAYOUT
 /begin MEMORY_LAYOUT PRG_CODE 0xC02000 0x2000 -1 -1 -1 -1 -1 /begin IF_DATA ASAP1B_CCP DP_BLOB 0xC02000 0x1FFF /end IF_DATA /end MEMORY_LAYOUT
 /begin MEMORY_LAYOUT PRG_CODE 0xC04000 0x2000 -1 -1 -1 -1 -1 /begin IF_DATA ASAP1B_CCP DP_BLOB 0xC04000 0x1FFF /end IF_DATA /end MEMORY_LAYOUT
 /begin MEMORY_LAYOUT PRG_CODE 0xC06000 0x2000 -1 -1 -1 -1 -1 /begin IF_DATA ASAP1B_CCP DP_BLOB 0xC06000 0x1FFF /end IF_DATA /end MEMORY_LAYOUT
 /begin MEMORY_LAYOUT PRG_CODE 0xC08000 0x2000 -1 -1 -1 -1 -1 /begin IF_DATA ASAP1B_CCP DP_BLOB 0xC08000 0x1FFF /end IF_DATA /end MEMORY_LAYOUT
 /begin MEMORY_LAYOUT PRG_DATA 0xC0A000 0x5000 -1 -1 -1 -1 -1 /begin IF_DATA ASAP1B_CCP DP_BLOB 0xC0A000 0x4FFF /end IF_DATA /end MEMORY_LAYOUT
 /begin MEMORY_LAYOUT PRG_RESERVED 0xC0F000 0x01000 -1 -1 -1 -1 -1 /begin IF_DATA ASAP1B_CCP DP_BLOB 0xC0F000 0x0FFF /end IF_DATA /end MEMORY_LAYOUT
 /begin MEMORY_LAYOUT PRG_CODE 0xC10000 0x30000 -1 -1 -1 -1 -1 /begin IF_DATA ASAP1B_CCP DP_BLOB 0xC10000 0x2FFFF /end IF_DATA /end MEMORY_LAYOUT
 /begin MEMORY_LAYOUT PRG_RESERVED 0xC40000 0x40000 -1 -1 -1 -1 -1 /begin IF_DATA ASAP1B_CCP DP_BLOB 0xC40000 0x3FFFF /end IF_DATA /end MEMORY_LAYOUT
 /begin MEMORY_LAYOUT PRG_RESERVED 0xC80000 0x40000 -1 -1 -1 -1 -1 /begin IF_DATA ASAP1B_CCP DP_BLOB 0xC20000 0x3FFFF /end IF_DATA /end MEMORY_LAYOUT
/end MOD_PAR
/begin IF_DATA ASAP1B_ETK
 /begin SOURCE "Synchro" 103 1 QP_BLOB 1 29 0x2EE0 0x3000 0x3B00 0 0 0 /end SOURCE
 /begin SOURCE "8ms" 3 8 QP_BLOB 2 45 0x2F20 0x3100 0x3B02 8 0 0 /end SOURCE
 /begin SOURCE "128ms" 3 128 QP_BLOB 3 45 0x2F80 0x3200 0x3B04 512 0 0 /end SOURCE
 /begin TP_BLOB 0x3800 1 39 12 2 0x0 0x0 0x0 0x0 0x0 0 ETK_CFG 0x0F 0x00 0xF0 0x03 0xFF 0xFD 0xDF 0x01 EXRAM 0x0000 0xFFFF -1 -1 -1 -1 -1 /end TP_BLOB
/end IF_DATA
/* --- AgI-Objekt f? CCP (ASAP V1.21), Stand 1.0 31.7.98 --- */
/begin IF_DATA ASAP1B_CCP
 /begin SOURCE "10ms" 4 1 /begin QP_BLOB 0 LENGTH 10 CAN_ID_FIXED 0x613 RASTER 0 /end QP_BLOB /end SOURCE
 /begin SOURCE "100ms" 5 1 /begin QP_BLOB 1 LENGTH 10 CAN_ID_FIXED 0x614 RASTER 1 /end QP_BLOB /end SOURCE
 /begin SOURCE "Synchro" 103 1 /begin QP_BLOB 2 LENGTH 3 CAN_ID_FIXED 0x612 RASTER 2 /end QP_BLOB /end SOURCE
 /begin RASTER "10ms" "10_ms" 0 4 1 /end RASTER
 /begin RASTER "100ms" "100_ms" 1 5 1 /end RASTER
 /begin RASTER "Synchro" "seg_sync" 2 103 1 /end RASTER
 /begin SEED_KEY /* seed&key dll for CAL privilege */ "" /* seed&key dll for DAQ privilege */ "" /* seed&key dll for PGM privilege */ "" /end SEED_KEY
 /begin TP_BLOB /* CCP version */ 0x201 /* Blob version */ 0x202 /* CAN msg ID - send */ 0x610 /* CAN msg ID - recv */ 0x611 /* station address */ 0x1234 /* byte order */ 2
  /begin CAN_PARAM /* crystal frequency */ 0x1F4 /* timing register 0 */ 0x41 /* timing register 1 */ 0x25 /end CAN_PARAM
  DAQ_MODE BURST RESUME_SUPPORTED STORE_SUPPORTED CONSISTENCY ODT ADDRESS_EXTENSION ODT
  /begin CHECKSUM_PARAM /* algorithm */ 0xC001 /* limit */ 0xFFFFFFFF CHECKSUM_CALCULATION ACTIVE_PAGE /end CHECKSUM_PARAM
  /begin DEFINED_PAGES 1 "reference page" /* address ext. */ 0x0 /* base address */ 0xC0A000 /* page length */ 0x01000 ROM DEFAULT /end DEFINED_PAGES
  /begin DEFINED_PAGES 2 "working page" /* address ext. */ 0x0 /* base address */ 0xE01000 /* page length */ 0x01000 RAM RAM_INIT_BY_ECU /end DEFINED_PAGES
  OPTIONAL_CMD 0x1 OPTIONAL_CMD 0x2 OPTIONAL_CMD 0x3 OPTIONAL_CMD 0x4 OPTIONAL_CMD 0x5 OPTIONAL_CMD 0x6 OPTIONAL_CMD 0x7 OPTIONAL_CMD 0x8 OPTIONAL_CMD 0x9 /* GET_ACTIVE_CAL_PAGE */ OPTIONAL_CMD 0xC /* SET_S_STATUS */ OPTIONAL_CMD 0xD /* GET_S_STATUS */ OPTIONAL_CMD 0xE /* BUILD_CHKSUM */ OPTIONAL_CMD 0xF OPTIONAL_CMD 0x10 OPTIONAL_CMD 0x11 /* SELECT_CAL_PAGE */ OPTIONAL_CMD 0x12 /* GET_SEED */ OPTIONAL_CMD 0x13 /* UNLOCK */ OPTIONAL_CMD 0x14 OPTIONAL_CMD 0x15 OPTIONAL_CMD 0x16 OPTIONAL_CMD 0x17 OPTIONAL_CMD 0x18 OPTIONAL_CMD 0x19 /* MOVE */ OPTIONAL_CMD 0x1b OPTIONAL_CMD 0x20 OPTIONAL_CMD 0x21 OPTIONAL_CMD 0x22 OPTIONAL_CMD 0x23 /end TP_BLOB
/end IF_DATA
/begin IF_DATA ASAP1B_KWP2000
 /begin SOURCE "timeslot" 0 0 QP_BLOB 0 BLOCKMODE 0xF0 0 20 /end SOURCE
 /begin TP_BLOB /* Blob version */ 0x100 /* ECU address on k line */ 0x11 /* requ. tester address */ 0xF1 /* ECU stimulation mode */ WuP /* byte order */ MSB_LAST 1 /* project base address */ 0x0 BAUD_DEF /* BaudRate */ 10400 /* DiagMode */ 0x86 0x14 TIME_DEF /* Default values as in KWP2000.cnf INCA3.2 defined, ISO-default */ /* p1Max */ 0x0014 /* p2Min */ 0x0019 /* p2Max */ 0x0032 /* p3Min */ 0x0037 /* p3Max */ 0x1388 /* p4Min */ 0x0005 /end TP_BLOB
/end IF_DATA
/* --- AgI-Objekt f? McMess/VS2x (ASAP V1.3), Stand 2.1 11.10.99; AML: ETAS-Og/Vector-Schnorr, 23.9.99 --- */
/begin IF_DATA ASAP1B_MCMESS
 /begin SOURCE "Handshake" 103 1 QP_BLOB HANDSHAKE 0 /end SOURCE
 /begin TP_BLOB /* Version des TP_BLOB:*/ 0x102 KOMKEN 13 /* Kommunikationskennung 1..255 */ MCTGT 0x11 /* Targetadresse im Steuerger? im KWP2000 */ MCINI MASSE /* Reizungstyp */ WFSIDLE0 12 /* Wartezeit bevor Tester mit Reizung/Vorspann beginnt (quant. 10ms) */ WFSIDLE1 8 /* Retriggerzeit von WFSIDLE0 (10ms-Quantisierung) */ WFS5B 10 /* Wartezeit nach 5-Baud-Vorspann, bevor Tester mit der Protokoll-Einleitung beginnt (quant. 100ms) */ NOOFCYL 4 /* Zylinderanzahl */ CYLCNAME zzyl /* Name der Zylinderz?lerramzelle */ CYLSEQU "1,3,4,2" /* Z?dreihenfolge */ XRAMOF 0 /* EXRAM-Offset: 0..255 */
  /begin VS_DEF /* Verstellparameterzuordnung */ "VSW:vszw" "VSFG:vsfrk" "VSWV:vsvw" "VSNS:vsns" "VSWZ1:vszwkr_0_A" "VSWZ2:vszwkr_1_A" "VSWZ3:vszwkr_2_A" "VSWZ4:vszwkr_3_A" "VSWZ5:vszwkr_4_A" "VSWZ6:vszwkr_5_A" "VSWZ7:vszwkr_6_A" "VSWZ8:vszwkr_7_A" "VSKF:vske" "VSMFA:vsdmr" "VSMFL:vsfpses" "VSLDS:vsrlmx" "VSLUC:vsldtv" /end VS_DEF
  /begin PSEUDO_ADR /* Pseudoadressen */ /end PSEUDO_ADR
  BYTE_ORDER MSB_LAST /end TP_BLOB
/end IF_DATA
/begin RECORD_LAYOUT DTYPE_UB FNC_VALUES 1 UBYTE ROW_DIR DIRECT /end RECORD_LAYOUT
/begin RECORD_LAYOUT DTYPE_SB FNC_VALUES 1 SBYTE ROW_DIR DIRECT /end RECORD_LAYOUT
/begin RECORD_LAYOUT DTYPE_UW FNC_VALUES 1 UWORD ROW_DIR DIRECT /end RECORD_LAYOUT
/begin RECORD_LAYOUT DTYPE_SW FNC_VALUES 1 SWORD ROW_DIR DIRECT /end RECORD_LAYOUT
/begin COMPU_METHOD Compuc_CFTRPSSCT "Compuc_CFTRPSSCT" RAT_FUNC "%8.6" "msec" COEFFS 0 1 0.000000 0 0 1.000000 /end COMPU_METHOD
/begin COMPU_METHOD Compuc_HDSGRAD "Compuc_HDSGRAD" RAT_FUNC "%8.6" "%/V" COEFFS 0 1 0.000000 0 0 0.012500 /end COMPU_METHOD
/begin COMPU_METHOD Compuc_HDSOFS "Compuc_HDSOFS" RAT_FUNC "%8.6" "%" COEFFS 0 1 0.000000 0 0 0.031250 /end COMPU_METHOD
/begin COMPU_METHOD Compuc_HFMGRAD "Compuc_HFMGRAD" RAT_FUNC "%8.6" "lpm/V" COEFFS 0 1 0.000000 0 0 6.250000 /end COMPU_METHOD
/begin COMPU_METHOD Compuc_HFMOFS "Compuc_HFMOFS" RAT_FUNC "%8.6" "lpm%" COEFFS 0 1 0.000000 0 0 0.061037 /end COMPU_METHOD
/begin COMPU_METHOD Compuc_IRIDL_MAXTIME "Compuc_IRIDL_MAXTIME" RAT_FUNC "%8.6" "sec" COEFFS 0 1 0.000000 0 0 0.512000 /end COMPU_METHOD
/begin COMPU_METHOD Compuc_LDSGRAD "Compuc_LDSGRAD" RAT_FUNC "%8.6" "mm/V" COEFFS 0 1 0.000000 0 0 1.562520 /end COMPU_METHOD
/begin COMPU_METHOD Compuc_LDSOFS "Compuc_LDSOFS" RAT_FUNC "%8.6" "mm" COEFFS 0 1 0.000000 0 0 0.015260 /end COMPU_METHOD
/begin COMPU_METHOD Compuc_RPSSCTGRAD "Compuc_RPSSCTGRAD" RAT_FUNC "%8.6" "kPa/V" COEFFS 0 1 0.000000 0 0 9.812500 /end COMPU_METHOD
/begin COMPU_METHOD Compuc_RPSSCTOFS "Compuc_RPSSCTOFS" RAT_FUNC "%8.6" "kPa" COEFFS 0 1 0.000000 0 0 0.095828 /end COMPU_METHOD
/begin COMPU_METHOD Compuc_THCGUN "Compuc_THCGUN" RAT_FUNC "%8.6" "mm" COEFFS 0 1 0.000000 0 0 0.007630 /end COMPU_METHOD
/begin COMPU_METHOD Compuc_THPERTTH "Compuc_THPERTTH" RAT_FUNC "%8.6" "us" COEFFS 0 1 0.000000 0 0 32.000000 /end COMPU_METHOD
/begin COMPU_METHOD Compuc_TLAED "Compuc_TLAED" RAT_FUNC "%8.6" "s" COEFFS 0 1 0.000000 0 0 0.256000 /end COMPU_METHOD
/begin COMPU_METHOD Compuc_TVKL15 "Compuc_TVKL15" RAT_FUNC "%8.6" "sec" COEFFS 0 1 0.000000 0 0 1.024000 /end COMPU_METHOD
/begin COMPU_METHOD Compuc_TWSVSPZ "Compuc_TWSVSPZ" RAT_FUNC "%8.6" "sec" COEFFS 0 1 0.000000 0 0 0.064000 /end COMPU_METHOD
/begin COMPU_METHOD Compuc_UBNFST "Compuc_UBNFST" RAT_FUNC "%8.6" "V" COEFFS 0 1 0.000000 0 0 0.281250 /end COMPU_METHOD
/begin COMPU_METHOD Compuc_UBNLMN "Compuc_UBNLMN" RAT_FUNC "%8.6" "V" COEFFS 0 1 0.000000 0 0 0.126654 /end COMPU_METHOD
/begin COMPU_METHOD Compur_5V "Compur_5V" RAT_FUNC "%8.6" "V" COEFFS 0 1 0.000000 0 0 0.039216 /end COMPU_METHOD
/begin COMPU_METHOD Compur_AIRFLOW_W "Compur_AIRFLOW_W" RAT_FUNC "%8.6" "kg/h" COEFFS 0 1 0.000000 0 0 0.100000 /end COMPU_METHOD
/begin COMPU_METHOD Compur_APSC_B "Compur_APSC_B" RAT_FUNC "%8.6" "%" COEFFS 0 1 0.000000 0 0 0.400000 /end COMPU_METHOD
/begin COMPU_METHOD Compur_BATSQ_W "Compur_BATSQ_W" RAT_FUNC "%8.6" "V" COEFFS 0 1 0.000000 0 0 0.000732 /end COMPU_METHOD
/begin COMPU_METHOD Compur_BATSQ "Compur_BATSQ" RAT_FUNC "%8.6" "V" COEFFS 0 1 0.000000 0 0 0.188235 /end COMPU_METHOD
/begin COMPU_METHOD Compur_BRAKETIME_W "Compur_BRAKETIME_W" RAT_FUNC "%8.6" "sec" COEFFS 0 1 0.000000 0 0 0.125000 /end COMPU_METHOD
/begin COMPU_METHOD Compur_CTRLPGSWON_B "Compur_CTRLPGSWON_B" RAT_FUNC "%8.6" "sec" COEFFS 0 1 0.000000 0 0 0.032000 /end COMPU_METHOD
/begin COMPU_METHOD Compur_DMOTRQC_B "Compur_DMOTRQC_B" RAT_FUNC "%8.6" "%" COEFFS 0 1 125.000000 0 0 1.000000 /end COMPU_METHOD
/begin COMPU_METHOD Compur_ECAMPC_W "Compur_ECAMPC_W" RAT_FUNC "%8.6" "A" COEFFS 0 1 -80.000000 0 0 0.050000 /end COMPU_METHOD
/begin COMPU_METHOD Compur_EDAMPC_W "Compur_EDAMPC_W" RAT_FUNC "%8.6" "A" COEFFS 0 1 80.000000 0 0 0.050000 /end COMPU_METHOD
/begin COMPU_METHOD Compur_ESOCC_W "Compur_ESOCC_W" RAT_FUNC "%8.6" "%" COEFFS 0 1 0.000000 0 0 0.001563 /end COMPU_METHOD
/begin COMPU_METHOD Compur_EVOLC_W "Compur_EVOLC_W" RAT_FUNC "%8.6" "V" COEFFS 0 1 0.000000 0 0 0.050000 /end COMPU_METHOD
/begin COMPU_METHOD Compur_FCWTOUT_B "Compur_FCWTOUT_B" RAT_FUNC "%8.6" "degc" COEFFS 0 1 40.000000 0 0 1.000000 /end COMPU_METHOD
/begin COMPU_METHOD Compur_FPH_MP_W "Compur_FPH_MP_W" RAT_FUNC "%8.6" "MPa" COEFFS 0 1 0.000000 0 0 0.100000 /end COMPU_METHOD
/begin COMPU_METHOD Compur_FPH "Compur_FPH" RAT_FUNC "%8.6" "MPa" COEFFS 0 1 0.000000 0 0 0.351563 /end COMPU_METHOD
/begin COMPU_METHOD Compur_FPHO_W "Compur_FPHO_W" RAT_FUNC "%8.6" "MPa" COEFFS 0 1 0.000000 0 0 0.001373 /end COMPU_METHOD
/begin COMPU_METHOD Compur_FPL "Compur_FPL" RAT_FUNC "%8.6" "kPa" COEFFS 0 1 0.000000 0 0 12.265625 /end COMPU_METHOD
/begin COMPU_METHOD Compur_FSTT_B "Compur_FSTT_B" RAT_FUNC "%8.6" "bar" COEFFS 0 1 0.000000 0 0 3.971000 /end COMPU_METHOD
/begin COMPU_METHOD Compur_FSTTVAL_W "Compur_FSTTVAL_W" RAT_FUNC "%8.6" "bar" COEFFS 0 1 0.000000 0 0 0.003922 /end COMPU_METHOD
/begin COMPU_METHOD Compur_FTK_MT_W "Compur_FTK_MT_W" RAT_FUNC "%8.6" "Kelvin" COEFFS 0 1 0.000000 0 0 0.100000 /end COMPU_METHOD
/begin COMPU_METHOD Compur_FTK_W "Compur_FTK_W" RAT_FUNC "%8.6" "degK" COEFFS 0 1 -223.150000 0 0 0.610000 /end COMPU_METHOD
/begin COMPU_METHOD Compur_FVSC_W "Compur_FVSC_W" RAT_FUNC "%8.6" "km/h" COEFFS 0 1 0.000000 0 0 0.100000 /end COMPU_METHOD
/begin COMPU_METHOD Compur_GVTAF_W "Compur_GVTAF_W" RAT_FUNC "%8.6" "bar" COEFFS 0 1 0.000000 0 0 0.015450 /end COMPU_METHOD
/begin COMPU_METHOD Compur_H2CONSUMEKWHKG_B "Compur_H2CONSUMEKWHKG_B" RAT_FUNC "%8.6" "kWh/kg" COEFFS 0 1 0.000000 0 0 1.000000 /end COMPU_METHOD
/begin COMPU_METHOD Compur_H2PRESSURE_W "Compur_H2PRESSURE_W" RAT_FUNC "%8.6" "bar" COEFFS 0 1 0.000000 0 0 0.010000 /end COMPU_METHOD
/begin COMPU_METHOD Compur_HDS3_B "Compur_HDS3_B" RAT_FUNC "%8.6" "%" COEFFS 0 1 0.000000 0 0 0.015625 /end COMPU_METHOD
/begin COMPU_METHOD Compur_HDS3O_W "Compur_HDS3O_W" RAT_FUNC "%8.6" "%" COEFFS 0 1 0.000000 0 0 0.000061 /end COMPU_METHOD
/begin COMPU_METHOD Compur_HFM_W "Compur_HFM_W" RAT_FUNC "%8.6" "lpm" COEFFS 0 1 0.000000 0 0 0.030518 /end COMPU_METHOD
/begin COMPU_METHOD Compur_HVSETCURRC_W "Compur_HVSETCURRC_W" RAT_FUNC "%8.6" "A" COEFFS 0 1 0.000000 0 0 0.100000 /end COMPU_METHOD
/begin COMPU_METHOD Compur_IR_WUPIDLETIME_B "Compur_IR_WUPIDLETIME_B" RAT_FUNC "%8.6" "s" COEFFS 0 1 0.000000 0 0 1.000000 /end COMPU_METHOD
/begin COMPU_METHOD Compur_LDS_W "Compur_LDS_W" RAT_FUNC "%8.6" "mm" COEFFS 0 1 0.000000 0 0 0.007629 /end COMPU_METHOD
/begin COMPU_METHOD Compur_NGFIL_W "Compur_NGFIL_W" RAT_FUNC "%8.6" "rpm/s" COEFFS 0 1 0.000000 0 0 0.390630 /end COMPU_METHOD
/begin COMPU_METHOD Compur_NGFIL "Compur_NGFIL" RAT_FUNC "%8.6" "rpm/s" COEFFS 0 1 0.000000 0 0 100.000000 /end COMPU_METHOD
/begin COMPU_METHOD Compur_NMOTRSP_W[5] "Compur_NMOTRSP_W[5]" RAT_FUNC "%8.6" "rpm" COEFFS 0 1 0.000000 0 0 0.250000 /end COMPU_METHOD
/begin COMPU_METHOD Compur_PINSULRES_W "Compur_PINSULRES_W" RAT_FUNC "%8.6" "kOhm" COEFFS 0 1 0.000000 0 0 1.000000 /end COMPU_METHOD
/begin COMPU_METHOD Compur_POWERONHOURS_L "Compur_POWERONHOURS_L" RAT_FUNC "%8.6" "V" COEFFS 0 1 0.000000 0 0 0.100000 /end COMPU_METHOD
/begin COMPU_METHOD Compur_RGVTAF_B "Compur_RGVTAF_B" RAT_FUNC "%8.6" "%" COEFFS 0 1 0.000000 0 0 0.500000 /end COMPU_METHOD
/begin COMPU_METHOD Compur_RPM_B "Compur_RPM_B" RAT_FUNC "%8.6" "rpm" COEFFS 0 1 0.000000 0 0 40.000000 /end COMPU_METHOD
/begin COMPU_METHOD Compur_RPM08 "Compur_RPM08" RAT_FUNC "%8.6" "rpm" COEFFS 0 1 0.000000 0 0 8.000000 /end COMPU_METHOD
/begin COMPU_METHOD Compur_RPM32 "Compur_RPM32" RAT_FUNC "%8.6" "rpm" COEFFS 0 1 0.000000 0 0 32.000000 /end COMPU_METHOD
/begin COMPU_METHOD Compur_RPMC_W "Compur_RPMC_W" RAT_FUNC "%8.6" "rpm" COEFFS 0 1 0.000000 0 0 0.125000 /end COMPU_METHOD
/begin COMPU_METHOD Compur_RPMO_W "Compur_RPMO_W" RAT_FUNC "%8.6" "rpm" COEFFS 0 1 0.000000 0 0 1.000000 /end COMPU_METHOD
/begin COMPU_METHOD Compur_RPSSCTO_W "Compur_RPSSCTO_W" RAT_FUNC "%8.6" "kPa" COEFFS 0 1 0.000000 0 0 0.047913 /end COMPU_METHOD
/begin COMPU_METHOD Compur_RTSSCTLIN_B "Compur_RTSSCTLIN_B" RAT_FUNC "%8.6" "degc" COEFFS 0 1 50.000000 0 0 0.610000 /end COMPU_METHOD
/begin COMPU_METHOD Compur_SYSLISOC_B "Compur_SYSLISOC_B" RAT_FUNC "%8.6" "%" COEFFS 0 1 0.000000 0 0 1.000000 /end COMPU_METHOD
/begin COMPU_METHOD Compur_T1_W "Compur_T1_W" RAT_FUNC "%8.6" "us" COEFFS 0 1 0.000000 0 0 4.000000 /end COMPU_METHOD
/begin COMPU_METHOD Compur_TCV_W "Compur_TCV_W" RAT_FUNC "%8.6" "BitWord" COEFFS 0 1 0.000000 0 0 1.000000 /end COMPU_METHOD
/begin COMPU_METHOD Compur_TDMRCUTOFF_W "Compur_TDMRCUTOFF_W" RAT_FUNC "%8.6" "sec" COEFFS 0 1 0.000000 0 0 0.008000 /end COMPU_METHOD
/begin COMPU_METHOD Compur_TENGC_B "Compur_TENGC_B" RAT_FUNC "%8.6" "degc" COEFFS 0 1 48.000000 0 0 0.750000 /end COMPU_METHOD
/begin COMPU_METHOD Compur_TOND_SWTOV "Compur_TOND_SWTOV" RAT_FUNC "%8.6" "sec" COEFFS 0 1 0.000000 0 0 0.128000 /end COMPU_METHOD
/begin COMPU_METHOD Compur_TSAS_W "Compur_TSAS_W" RAT_FUNC "%8.6" "us" COEFFS 0 1 0.000000 0 0 256.000000 /end COMPU_METHOD
/begin COMPU_METHOD Compur_TSEGRSP_W[5] "Compur_TSEGRSP_W[5]" RAT_FUNC "%8.6" "us" COEFFS 0 1 0.000000 0 0 16.000000 /end COMPU_METHOD
/begin COMPU_METHOD Compur_TTWSVSSTF "Compur_TTWSVSSTF" RAT_FUNC "%8.6" "sec" COEFFS 0 1 0.000000 0 0 0.256000 /end COMPU_METHOD
/begin COMPU_METHOD Compur_TXLENGTH_W "Compur_TXLENGTH_W" RAT_FUNC "%8.6" "-" COEFFS 0 1 0.000000 0 0 1.000000 /end COMPU_METHOD
/begin COMPU_METHOD Compur_UNFST_B "Compur_UNFST_B" RAT_FUNC "%8.6" "V" COEFFS 0 1 0.000000 0 0 0.019608 /end COMPU_METHOD
/begin COMPU_METHOD Compur_VBR "Compur_VBR" RAT_FUNC "%8.6" "V" COEFFS 0 1 0.000000 0 0 0.127151 /end COMPU_METHOD
/begin COMPU_METHOD Compur_VSC_W "Compur_VSC_W" RAT_FUNC "%8.6" "km/h" COEFFS 0 1 0.000000 0 0 0.003906 /end COMPU_METHOD
/begin COMPU_METHOD Compur_VSSTIME_W "Compur_VSSTIME_W" RAT_FUNC "%8.6" "us" COEFFS 0 1 0.000000 0 0 64.000000 /end COMPU_METHOD
/begin COMPU_METHOD Compur_W5V_W "Compur_W5V_W" RAT_FUNC "%8.6" "V" COEFFS 0 1 0.000000 0 0 0.009766 /end COMPU_METHOD
/begin COMPU_METHOD Compur_WATERPUMPPOWER_B "Compur_WATERPUMPPOWER_B" RAT_FUNC "%8.6" "kW" COEFFS 0 1 0.000000 0 0 0.100000 /end COMPU_METHOD
/begin COMPU_METHOD Compur_WRTSSCT "Compur_WRTSSCT" RAT_FUNC "%8.6" "V" COEFFS 0 1 0.000000 0 0 0.019531 /end COMPU_METHOD
/begin COMPU_METHOD Compur_WSPA4_W "Compur_WSPA4_W" RAT_FUNC "%8.6" "V" COEFFS 0 1 0.000000 0 0 0.004883 /end COMPU_METHOD
/begin COMPU_METHOD Compur_WVBR_W "Compur_WVBR_W" RAT_FUNC "%8.6" "V" COEFFS 0 1 0.000000 0 0 0.031664 /end COMPU_METHOD
/begin COMPU_METHOD Compur_ZKFSTF_W "Compur_ZKFSTF_W" RAT_FUNC "%8.6" "sec" COEFFS 0 1 0.000000 0 0 1.000000 /end COMPU_METHOD
/begin COMPU_METHOD default "default conversion type" RAT_FUNC "%8.6" "dec" COEFFS 0 1 0.000000 0 0 1.000000 /end COMPU_METHOD
/begin COMPU_METHOD Compur_TBEFFTMP " Compu for Break point LOAD " TAB_NOINTP "%8.6" "mbar" COMPU_TAB_REF Bkload_17_Table /end COMPU_METHOD
/begin COMPU_METHOD Bkprpm_17 " Compu for Break point RPM " TAB_NOINTP "%8.6" "rpm" COMPU_TAB_REF Bkprpm_17_Table /end COMPU_METHOD
/begin COMPU_METHOD Bkprpm_18 " Compu for Break point RPM " TAB_NOINTP "%8.6" "rpm" COMPU_TAB_REF Bkprpm_18_Table /end COMPU_METHOD
/begin COMPU_METHOD TBdash1_grid_display " TBdash1_grid_display " TAB_NOINTP "%8.6" "p" COMPU_TAB_REF TBdash1_Table /end COMPU_METHOD
/begin COMPU_METHOD TBdash2_grid_display " TBdash2_grid_display " TAB_NOINTP "%8.6" "p" COMPU_TAB_REF TBdash2_Table /end COMPU_METHOD
/begin COMPU_METHOD B_TRUE "On/off conversion formula" TAB_VERB "%7.5" "" COMPU_TAB_REF B_TRUE_Table /end COMPU_METHOD
/begin COMPU_METHOD Compur_GEARPOS_ " Compu for GEARPOS_ " RAT_FUNC "%8.6" "LEVEL" COEFFS 0 1 0.0000 0 0 1 /end COMPU_METHOD
/begin COMPU_TAB Bkload_17_Table "Break point Table for 17 points" TAB_NOINTP 17 01 103.0 02 172.9 03 242.8 04 331.2 05 401.1 06 462.6 07 500.4 08 552.0 09 603.5 10 651.3 11 702.8 12 750.68 13 802.2 14 850.04 15 901.56 16 953.08 17 1041.4 /end COMPU_TAB
/begin COMPU_TAB Bkprpm_17_Table "Break point Table for 17 points" TAB_NOINTP 17 01 608 02 704 03 800 04 896 05 1008 06 1104 07 1200 08 1296 09 1408 10 1504 11 1696 12 1856 13 2096 14 2208 15 2304 16 2448 17 5984 /end COMPU_TAB
/begin COMPU_TAB Bkprpm_18_Table "Break point Table for 18 points" TAB_NOINTP 18 00 0 01 608 02 704 03 800 04 896 05 1008 06 1104 07 1200 08 1296 09 1408 10 1504 11 1696 12 1856 13 2096 14 2208 15 2304 16 2448 17 5984 /end COMPU_TAB
/begin COMPU_TAB TBdash1_Table "TBdash1 grid display" TAB_NOINTP 8 01 0.0 02 1.17 03 2.34 04 4.68 05 9.36 06 18.72 07 37.44 08 74.88 /end COMPU_TAB
/begin COMPU_TAB TBdash2_Table "TBdash2 grid display" TAB_NOINTP 8 01 0.0 02 1.17 03 2.34 04 4.68 05 9.36 06 18.72 07 37.44 08 74.88 /end COMPU_TAB
/begin COMPU_VTAB B_TRUE_Table " " TAB_VERB 2 0 "False" 1 "True" /end COMPU_VTAB
/begin MEASUREMENT ZRPH "  inph: counter schedule of phase signal" UBYTE default 1 0 0.000000 255.000000 /begin IF_DATA ASAP1B_CCP KP_BLOB 0xF924 0 1 /end IF_DATA BIT_MASK 0xFF /end MEASUREMENT
/begin MEASUREMENT ZKFSTF_W "  infstt: inverse time constant fuel level filter" UWORD Compur_ZKFSTF_W 1 0 0.000000 65535.000000 /begin IF_DATA ASAP1B_CCP KP_BLOB 0xF996 0 2 /end IF_DATA BIT_MASK 0xFFFF /end MEASUREMENT
/begin MEASUREMENT WVBR_W "  ADinput: Battery voltage after main relay by ADC" UWORD Compur_WVBR_W 1 0 0.000000 2075.100240 /begin IF_DATA ASAP1B_CCP KP_BLOB 0xFA64 0 2 /end IF_DATA BIT_MASK 0xFFFF /end MEASUREMENT
/begin MEASUREMENT WUCCNT "DWUC: Warm-up cycles since code clear" UBYTE default 1 0 0.000000 255.000000 /begin IF_DATA ASAP1B_CCP KP_BLOB 0xDC15 0 1 /end IF_DATA BIT_MASK 0xFF /end MEASUREMENT
/begin MEASUREMENT WSPA4_W "  ADinput: ADC result of ADC spare4" UWORD Compur_WSPA4_W 1 0 0.000000 320.007405 /begin IF_DATA ASAP1B_CCP KP_BLOB 0xF8FE 0 2 /end IF_DATA BIT_MASK 0xFFFF /end MEASUREMENT
/begin MEASUREMENT WSPA3_W "  ADinput: ADC result of ADC spare3" UWORD Compur_WSPA4_W 1 0 0.000000 320.007405 /begin IF_DATA ASAP1B_CCP KP_BLOB 0xFA08 0 2 /end IF_DATA BIT_MASK 0xFFFF /end MEASUREMENT
/begin MEASUREMENT WSPA2_W "  ADinput: ADC result of ADC spare2" UWORD Compur_WSPA4_W 1 0 0.000000 320.007405 /begin IF_DATA ASAP1B_CCP KP_BLOB 0xF9CA 0 2 /end IF_DATA BIT_MASK 0xFFFF /end MEASUREMENT
/begin MEASUREMENT WSPA1_W "  ADinput: ADC result of ADC spare1" UWORD Compur_WSPA4_W 1 0 0.000000 320.007405 /begin IF_DATA ASAP1B_CCP KP_BLOB 0xF91A 0 2 /end IF_DATA BIT_MASK 0xFFFF /end MEASUREMENT
/begin MEASUREMENT WRTSSCT "  INRTS: ADC result of suct Refrigerant temperature sensor 10bit" UBYTE Compur_WRTSSCT 1 0 0.000000 4.980405 /begin IF_DATA ASAP1B_CCP KP_BLOB 0xF9D9 0 1 /end IF_DATA BIT_MASK 0xFF /end MEASUREMENT
/begin MEASUREMENT WRTSSCT_W "  ADinput: ADC result of suct refrigerant temperature sensor 10bit" UWORD Compur_WSPA4_W 1 0 0.000000 320.007405 /begin IF_DATA ASAP1B_CCP KP_BLOB 0xF890 0 2 /end IF_DATA BIT_MASK 0xFFFF /end MEASUREMENT
/begin MEASUREMENT WRTSSBC "  INRTS: ADC result of subcool refrigerant temperature sensor 10bit" UBYTE Compur_WRTSSCT 1 0 0.000000 4.980405 /begin IF_DATA ASAP1B_CCP KP_BLOB 0xF9DD 0 1 /end IF_DATA BIT_MASK 0xFF /end MEASUREMENT
/begin MEASUREMENT WRTSSBC_W "  ADinput: ADC result of subcool refrigerant temperature sensor 10bit" UWORD Compur_WSPA4_W 1 0 0.000000 320.007405 /begin IF_DATA ASAP1B_CCP KP_BLOB 0xF974 0 2 /end IF_DATA BIT_MASK 0xFFFF /end MEASUREMENT
/begin MEASUREMENT WRPSSCT_W " ADinput: ADC result of suct refrigerant sensor acquisition" UWORD Compur_WSPA4_W 1 0 0.000000 320.007405 /begin IF_DATA ASAP1B_CCP KP_BLOB 0xFA60 0 2 /end IF_DATA BIT_MASK 0xFFFF /end MEASUREMENT
/begin MEASUREMENT WRPSSBC_W " ADinput: ADC result of subcool refrigerant pressure sensor acquisition" UWORD Compur_WSPA4_W 1 0 0.000000 320.007405 /begin IF_DATA ASAP1B_CCP KP_BLOB 0xF96E 0 2 /end IF_DATA BIT_MASK 0xFFFF /end MEASUREMENT
/begin MEASUREMENT WLDS_W "  ADinput: ADC result of laser distance sensor 10bit" UWORD Compur_WSPA4_W 1 0 0.000000 320.007405 /begin IF_DATA ASAP1B_CCP KP_BLOB 0xFA58 0 2 /end IF_DATA BIT_MASK 0xFFFF /end MEASUREMENT
/begin MEASUREMENT WIRDIAG_W " ADinput: ADC result of IR diag acquisition" UWORD Compur_WSPA4_W 1 0 0.000000 320.007405 /begin IF_DATA ASAP1B_CCP KP_BLOB 0xF94A 0 2 /end IF_DATA BIT_MASK 0xFFFF /end MEASUREMENT
/begin MEASUREMENT WHTTS3_W "  ADinput: ADC result of H2 tank temperature sensor 3 10bit" UWORD Compur_WSPA4_W 1 0 0.000000 320.007405 /begin IF_DATA ASAP1B_CCP KP_BLOB 0xF92C 0 2 /end IF_DATA BIT_MASK 0xFFFF /end MEASUREMENT
/begin MEASUREMENT WHTTS2_W "  ADinput: ADC result of H2 tank temperature sensor 2 10bit" UWORD Compur_WSPA4_W 1 0 0.000000 320.007405 /begin IF_DATA ASAP1B_CCP KP_BLOB 0xF9A4 0 2 /end IF_DATA BIT_MASK 0xFFFF /end MEASUREMENT
/begin MEASUREMENT WHTTS1_W "  ADinput: ADC result of H2 tank temperature sensor 1 10bit" UWORD Compur_WSPA4_W 1 0 0.000000 320.007405 /begin IF_DATA ASAP1B_CCP KP_BLOB 0xFA12 0 2 /end IF_DATA BIT_MASK 0xFFFF /end MEASUREMENT
/begin MEASUREMENT WHFM_W " ADinput: Sensor value H2 flow meter (only for monitoring)" UWORD Compur_WSPA4_W 1 0 0.000000 320.007405 /begin IF_DATA ASAP1B_CCP KP_BLOB 0xF966 0 2 /end IF_DATA BIT_MASK 0xFFFF /end MEASUREMENT
/begin MEASUREMENT WHDS3_W " ADinput: ADC result of H2 detection sensor 3 acquisition" UWORD Compur_WSPA4_W 1 0 0.000000 320.007405 /begin IF_DATA ASAP1B_CCP KP_BLOB 0xF904 0 2 /end IF_DATA BIT_MASK 0xFFFF /end MEASUREMENT
/begin MEASUREMENT WHDS2_W " ADinput: ADC result of H2 detection sensor 2 acquisition" UWORD Compur_WSPA4_W 1 0 0.000000 320.007405 /begin IF_DATA ASAP1B_CCP KP_BLOB 0xFA50 0 2 /end IF_DATA BIT_MASK 0xFFFF /end MEASUREMENT
/begin MEASUREMENT WHDS1_W " ADinput: ADC result of H2 detection sensor 1 acquisition" UWORD Compur_WSPA4_W 1 0 0.000000 320.007405 /begin IF_DATA ASAP1B_CCP KP_BLOB 0xF9F0 0 2 /end IF_DATA BIT_MASK 0xFFFF /end MEASUREMENT
/begin MEASUREMENT WFPL_W " ADinput: ADC result of H2 middle pressure sensor acquisition" UWORD Compur_WSPA4_W 1 0 0.000000 320.007405 /begin IF_DATA ASAP1B_CCP KP_BLOB 0xF93C 0 2 /end IF_DATA BIT_MASK 0xFFFF /end MEASUREMENT
/begin MEASUREMENT WFPH_W " ADinput: ADC result of H2 high pressure sensor acquisition" UWORD Compur_WSPA4_W 1 0 0.000000 320.007405 /begin IF_DATA ASAP1B_CCP KP_BLOB 0xFA1C 0 2 /end IF_DATA BIT_MASK 0xFFFF /end MEASUREMENT
/begin MEASUREMENT WETS "  INETS: ADC result of evaporator temperature sensor 10bit" UBYTE Compur_WRTSSCT 1 0 0.000000 4.980405 /begin IF_DATA ASAP1B_CCP KP_BLOB 0xF9C6 0 1 /end IF_DATA BIT_MASK 0xFF /end MEASUREMENT
/begin MEASUREMENT WETS_W " ADinput: ADC result of evaporator temperatur sensor acquisition" UWORD Compur_WSPA4_W 1 0 0.000000 320.007405 /begin IF_DATA ASAP1B_CCP KP_BLOB 0xF9CE 0 2 /end IF_DATA BIT_MASK 0xFFFF /end MEASUREMENT
/begin MEASUREMENT WCWTSPE "  INCWTS: ADC result of PE coolant temperature sensor 10bit" UBYTE Compur_WRTSSCT 1 0 0.000000 4.980405 /begin IF_DATA ASAP1B_CCP KP_BLOB 0xF999 0 1 /end IF_DATA BIT_MASK 0xFF /end MEASUREMENT
/begin MEASUREMENT WCWTSPE_W " ADinput: ADC result of PE coolant temperature sensor acquisition" UWORD Compur_WSPA4_W 1 0 0.000000 320.007405 /begin IF_DATA ASAP1B_CCP KP_BLOB 0xF8F8 0 2 /end IF_DATA BIT_MASK 0xFFFF /end MEASUREMENT
/begin MEASUREMENT WCWTSBAT "  INCWTS: ADC result of battery coolant temperature sensor 10bit" UBYTE Compur_WRTSSCT 1 0 0.000000 4.980405 /begin IF_DATA ASAP1B_CCP KP_BLOB 0xF99C 0 1 /end IF_DATA BIT_MASK 0xFF /end MEASUREMENT
/begin MEASUREMENT WCWTSBAT_W " ADinput: ADC result of battery coolant temperature sensor acquisition" UWORD Compur_WSPA4_W 1 0 0.000000 320.007405 /begin IF_DATA ASAP1B_CCP KP_BLOB 0xF9C2 0 2 /end IF_DATA BIT_MASK 0xFFFF /end MEASUREMENT
/begin MEASUREMENT WBAT_W "  ADinput: 12V Battery voltage by ADC" UWORD Compur_WVBR_W 1 0 0.000000 2075.100240 /begin IF_DATA ASAP1B_CCP KP_BLOB 0xF9F4 0 2 /end IF_DATA BIT_MASK 0xFFFF /end MEASUREMENT
/begin MEASUREMENT WATS "  INATS: ADC result of subcool refrigerant temperature sensor 10bit" UBYTE Compur_WRTSSCT 1 0 0.000000 4.980405 /begin IF_DATA ASAP1B_CCP KP_BLOB 0xF9E9 0 1 /end IF_DATA BIT_MASK 0xFF /end MEASUREMENT
/begin MEASUREMENT WATS_W " ADinput: ADC result of ambient sensor acquisition" UWORD Compur_WSPA4_W 1 0 0.000000 320.007405 /begin IF_DATA ASAP1B_CCP KP_BLOB 0xF940 0 2 /end IF_DATA BIT_MASK 0xFFFF /end MEASUREMENT
/begin MEASUREMENT WATERPUMPPOWER_B "  CAN4:Water consume power" UBYTE Compur_WATERPUMPPOWER_B 1 0 0.000000 25.500000 /begin IF_DATA ASAP1B_CCP KP_BLOB 0xC179 0 1 /end IF_DATA BIT_MASK 0xFF /end MEASUREMENT
/begin MEASUREMENT W5V_W "  ADinput: 5V Sensor power supply voltage by ADC" UWORD Compur_W5V_W 1 0 0.000000 640.014810 /begin IF_DATA ASAP1B_CCP KP_BLOB 0xF9E2 0 2 /end IF_DATA BIT_MASK 0xFFFF /end MEASUREMENT
/begin MEASUREMENT VSSTIME_W "  swadap: capture of VSS interrupt event time" UWORD Compur_VSSTIME_W 1 0 0.000000 4194240.000000 /begin IF_DATA ASAP1B_CCP KP_BLOB 0xF944 0 2 /end IF_DATA BIT_MASK 0xFFFF /end MEASUREMENT
/begin MEASUREMENT VSSPERIOD_W "  swadap: old time capture of VSS interrupt event time" UWORD Compur_VSSTIME_W 1 0 0.000000 4194240.000000 /begin IF_DATA ASAP1B_CCP KP_BLOB 0xFA26 0 2 /end IF_DATA BIT_MASK 0xFFFF /end MEASUREMENT
/begin MEASUREMENT VSP_W "  Period of vehicle speed signal" UWORD Compur_VSSTIME_W 1 0 0.000000 4194240.000000 /begin IF_DATA ASAP1B_CCP KP_BLOB 0xF93E 0 2 /end IF_DATA BIT_MASK 0xFFFF /end MEASUREMENT
/begin MEASUREMENT VSC_W "  CAN4:Vehicle Speed" UWORD Compur_VSC_W 1 0 0.000000 255.979710 /begin IF_DATA ASAP1B_CCP KP_BLOB 0xC7E2 0 2 /end IF_DATA BIT_MASK 0xFFFF /end MEASUREMENT
/begin MEASUREMENT VBR " InBV: battery voltage after main relay (8bit)" UBYTE Compur_VBR 1 0 0.000000 32.423505 /begin IF_DATA ASAP1B_CCP KP_BLOB 0xFA1E 0 1 /end IF_DATA BIT_MASK 0xFF /end MEASUREMENT
/begin MEASUREMENT UNFST_B "  infstt: Battery voltage standardized tank level sensor voltage" UBYTE Compur_UNFST_B 1 0 0.000000 5.000040 /begin IF_DATA ASAP1B_CCP KP_BLOB 0xF900 0 1 /end IF_DATA BIT_MASK 0xFF /end MEASUREMENT
/begin MEASUREMENT ULDSI_W "  INLDS: Internal Sensor value Laser detection sensor A/D VALUE" UWORD Compur_WSPA4_W 1 0 0.000000 320.007405 /begin IF_DATA ASAP1B_CCP KP_BLOB 0xC81E 0 2 /end IF_DATA BIT_MASK 0xFFFF /end MEASUREMENT
/begin MEASUREMENT UIRDI_W "  IRDA: Internal Sensor value IR DIAG A/D VALUE" UWORD Compur_WSPA4_W 1 0 0.000000 320.007405 /begin IF_DATA ASAP1B_CCP KP_BLOB 0xC7D8 0 2 /end IF_DATA BIT_MASK 0xFFFF /end MEASUREMENT
/begin MEASUREMENT UHFMI_W "  INHFM: Internal Sensor value H2 gas flow A/D VALUE" UWORD Compur_WSPA4_W 1 0 0.000000 320.007405 /begin IF_DATA ASAP1B_CCP KP_BLOB 0xC822 0 2 /end IF_DATA BIT_MASK 0xFFFF /end MEASUREMENT
/begin MEASUREMENT UFST_W "  ADinput: ADC result of fuel level gauge 10bit (copy of wfph_w)" UWORD Compur_WSPA4_W 1 0 0.000000 320.007405 /begin IF_DATA ASAP1B_CCP KP_BLOB 0xFA20 0 2 /end IF_DATA BIT_MASK 0xFFFF /end MEASUREMENT
/begin MEASUREMENT TXLENGTH_W " ASC1DAT: Tx1 data length" UWORD Compur_TXLENGTH_W 1 0 0.000000 65535.000000 /begin IF_DATA ASAP1B_CCP KP_BLOB 0xC2C0 0 2 /end IF_DATA BIT_MASK 0xFFFF /end MEASUREMENT
/begin MEASUREMENT TTWSVSSTF " DSVS: timer for waiting period from start from SVS off onwords at full fault memory" UBYTE Compur_TTWSVSSTF 1 0 0.000000 65.280000 /begin IF_DATA ASAP1B_CCP KP_BLOB 0xC167 0 1 /end IF_DATA BIT_MASK 0xFF /end MEASUREMENT
/begin MEASUREMENT TTWSVSST " DSVS: timer for waiting period from start from SVS off onwords at empty fault memory" UBYTE Compur_TTWSVSSTF 1 0 0.000000 65.280000 /begin IF_DATA ASAP1B_CCP KP_BLOB 0xC127 0 1 /end IF_DATA BIT_MASK 0xFF /end MEASUREMENT
/begin MEASUREMENT TTWSVSINIF " DSVS: timer for waiting period from INI SVS off onwords at full fault memory" UBYTE Compur_TTWSVSSTF 1 0 0.000000 65.280000 /begin IF_DATA ASAP1B_CCP KP_BLOB 0xC133 0 1 /end IF_DATA BIT_MASK 0xFF /end MEASUREMENT
/begin MEASUREMENT TTWSVSINI " DSVS: timer for waiting period from INI SVS off onwords at empty fault memory" UBYTE Compur_TTWSVSSTF 1 0 0.000000 65.280000 /begin IF_DATA ASAP1B_CCP KP_BLOB 0xC148 0 1 /end IF_DATA BIT_MASK 0xFF /end MEASUREMENT
/begin MEASUREMENT TTOOTH8MS_B "  engstall: tooth counter" UBYTE default 1 0 0.000000 255.000000 /begin IF_DATA ASAP1B_CCP KP_BLOB 0xFA17 0 1 /end IF_DATA BIT_MASK 0xFF /end MEASUREMENT
/begin MEASUREMENT TSPR2_W "  Period of SPR on/off signal" UWORD Compur_VSSTIME_W 1 0 0.000000 4194240.000000 /begin IF_DATA ASAP1B_CCP KP_BLOB 0xF9B8 0 2 /end IF_DATA BIT_MASK 0xFFFF /end MEASUREMENT
/begin MEASUREMENT TSEGRSP_W[5] "  %ccng: Begin of ring buffer fir segment time[5]" UWORD Compur_TSEGRSP_W[5] 1 0 0.000000 1048560.000000 /begin IF_DATA ASAP1B_CCP KP_BLOB 0xF956 0 2 /end IF_DATA BIT_MASK 0xFFFF /end MEASUREMENT
/begin MEASUREMENT TSEGRSP_W[4] "  %ccng: Begin of ring buffer fir segment time[4]" UWORD Compur_TSEGRSP_W[5] 1 0 0.000000 1048560.000000 /begin IF_DATA ASAP1B_CCP KP_BLOB 0xF954 0 2 /end IF_DATA BIT_MASK 0xFFFF /end MEASUREMENT
/begin MEASUREMENT TSEGRSP_W[3] "  %ccng: Begin of ring buffer fir segment time[3]" UWORD Compur_TSEGRSP_W[5] 1 0 0.000000 1048560.000000 /begin IF_DATA ASAP1B_CCP KP_BLOB 0xF952 0 2 /end IF_DATA BIT_MASK 0xFFFF /end MEASUREMENT
/begin MEASUREMENT TSEGRSP_W[2] "  %ccng: Begin of ring buffer fir segment time[2]" UWORD Compur_TSEGRSP_W[5] 1 0 0.000000 1048560.000000 /begin IF_DATA ASAP1B_CCP KP_BLOB 0xF950 0 2 /end IF_DATA BIT_MASK 0xFFFF /end MEASUREMENT
/begin MEASUREMENT TSEGRSP_W[1] "  %ccng: Begin of ring buffer fir segment time[1]" UWORD Compur_TSEGRSP_W[5] 1 0 0.000000 1048560.000000 /begin IF_DATA ASAP1B_CCP KP_BLOB 0xF94E 0 2 /end IF_DATA BIT_MASK 0xFFFF /end MEASUREMENT
/begin MEASUREMENT TSEGRSP_W[0] "  %ccng: Begin of ring buffer fir segment time[0]" UWORD Compur_TSEGRSP_W[5] 1 0 0.000000 1048560.000000 /begin IF_DATA ASAP1B_CCP KP_BLOB 0xF94C 0 2 /end IF_DATA BIT_MASK 0xFFFF /end MEASUREMENT
/begin MEASUREMENT TSEGHI "  swadap: Winkel-Segmentzeit, high, low byte des high word" UBYTE default 1 0 0.000000 255.000000 /begin IF_DATA ASAP1B_CCP KP_BLOB 0xF980 0 1 /end IF_DATA BIT_MASK 0xFF /end MEASUREMENT
/begin MEASUREMENT TSEG_W "  inph: tacho edge period time (1 revolution)" UWORD Compur_VSSTIME_W 1 0 0.000000 4194240.000000 /begin IF_DATA ASAP1B_CCP KP_BLOB 0xF9C8 0 2 /end IF_DATA BIT_MASK 0xFFFF /end MEASUREMENT
/begin MEASUREMENT TSAS_W "  %ccng: tume during one working cycle for ngas_w" UWORD Compur_TSAS_W 1 0 0.000000 16776960.000000 /begin IF_DATA ASAP1B_CCP KP_BLOB 0xFA3E 0 2 /end IF_DATA BIT_MASK 0xFFFF /end MEASUREMENT
/begin MEASUREMENT TOND_SWTOV "  INFCSW: turn-over delay counter for B_mainsw" UBYTE Compur_TOND_SWTOV 1 0 0.000000 32.640000 /begin IF_DATA ASAP1B_CCP KP_BLOB 0xFA34 0 1 /end IF_DATA BIT_MASK 0xFF /end MEASUREMENT
/begin MEASUREMENT TOND_LPGSW "  INFCSW: turn-on delay counter for B_mainsw" UBYTE Compur_TOND_SWTOV 1 0 0.000000 32.640000 /begin IF_DATA ASAP1B_CCP KP_BLOB 0xF976 0 1 /end IF_DATA BIT_MASK 0xFF /end MEASUREMENT
/begin MEASUREMENT TOFD_LPGSW "  INFCSW: turn-off delay counter for B_mainsw" UBYTE Compur_TOND_SWTOV 1 0 0.000000 32.640000 /begin IF_DATA ASAP1B_CCP KP_BLOB 0xF90D 0 1 /end IF_DATA BIT_MASK 0xFF /end MEASUREMENT
/begin MEASUREMENT TODWRTSSCTMX_B "  INRTS: turn-on-delay counter to confirm max error of RTSSCT" UBYTE Compur_TOND_SWTOV 1 0 0.000000 32.640000 /begin IF_DATA ASAP1B_CCP KP_BLOB 0xF95C 0 1 /end IF_DATA BIT_MASK 0xFF /end MEASUREMENT
/begin MEASUREMENT TODWRTSSCTMN_B "  INRTS: turn-on-delay counter to confirm min error of RTSSCT" UBYTE Compur_TOND_SWTOV 1 0 0.000000 32.640000 /begin IF_DATA ASAP1B_CCP KP_BLOB 0xFA29 0 1 /end IF_DATA BIT_MASK 0xFF /end MEASUREMENT
/begin MEASUREMENT TODWRTSSBCMX_B "  INRTS: turn-on-delay counter to confirm max error of RTSSBC" UBYTE Compur_TOND_SWTOV 1 0 0.000000 32.640000 /begin IF_DATA ASAP1B_CCP KP_BLOB 0xF982 0 1 /end IF_DATA BIT_MASK 0xFF /end MEASUREMENT
/begin MEASUREMENT TODWRTSSBCMN_B "  INRTS: turn-on-delay counter to confirm min error of RTSSBC" UBYTE Compur_TOND_SWTOV 1 0 0.000000 32.640000 /begin IF_DATA ASAP1B_CCP KP_BLOB 0xFA47 0 1 /end IF_DATA BIT_MASK 0xFF /end MEASUREMENT
/begin MEASUREMENT TODWRPSSCTMX_B "  INRPS: turn-on-delay counter to confirm max error of suct RPS" UBYTE Compur_TOND_SWTOV 1 0 0.000000 32.640000 /begin IF_DATA ASAP1B_CCP KP_BLOB 0xFA22 0 1 /end IF_DATA BIT_MASK 0xFF /end MEASUREMENT
/begin MEASUREMENT TODWRPSSCTMN_B "  INRPS: turn-on-delay counter to confirm min error of suct RPS" UBYTE Compur_TOND_SWTOV 1 0 0.000000 32.640000 /begin IF_DATA ASAP1B_CCP KP_BLOB 0xF9E8 0 1 /end IF_DATA BIT_MASK 0xFF /end MEASUREMENT
/begin MEASUREMENT TODWRPSSBCMX_B "  INRPS: turn-on-delay counter to confirm max error of subcool RPS" UBYTE Compur_TOND_SWTOV 1 0 0.000000 32.640000 /begin IF_DATA ASAP1B_CCP KP_BLOB 0xFA41 0 1 /end IF_DATA BIT_MASK 0xFF /end MEASUREMENT
/begin MEASUREMENT TODWRPSSBCMN_B "  INRPS: turn-on-delay counter to confirm min error of subcool RPS" UBYTE Compur_TOND_SWTOV 1 0 0.000000 32.640000 /begin IF_DATA ASAP1B_CCP KP_BLOB 0xFA06 0 1 /end IF_DATA BIT_MASK 0xFF /end MEASUREMENT
/begin MEASUREMENT TODWLDSMX_B "  INLDS: turn-on-delay counter to confirm max error of LDS" UBYTE Compur_TOND_SWTOV 1 0 0.000000 32.640000 /begin IF_DATA ASAP1B_CCP KP_BLOB 0xF9C7 0 1 /end IF_DATA BIT_MASK 0xFF /end MEASUREMENT
/begin MEASUREMENT TODWLDSMN_B "  INLDS: turn-on-delay counter to confirm min error of LDS" UBYTE Compur_TOND_SWTOV 1 0 0.000000 32.640000 /begin IF_DATA ASAP1B_CCP KP_BLOB 0xF901 0 1 /end IF_DATA BIT_MASK 0xFF /end MEASUREMENT
/begin MEASUREMENT TODWHDS3MX_B "  INHDS: turn-on-delay counter to confirm max error of HDS3" UBYTE Compur_TOND_SWTOV 1 0 0.000000 32.640000 /begin IF_DATA ASAP1B_CCP KP_BLOB 0xFA24 0 1 /end IF_DATA BIT_MASK 0xFF /end MEASUREMENT
/begin MEASUREMENT TODWHDS3MN_B "  INHDS: turn-on-delay counter to confirm min error of HDS3" UBYTE Compur_TOND_SWTOV 1 0 0.000000 32.640000 /begin IF_DATA ASAP1B_CCP KP_BLOB 0xF9BB 0 1 /end IF_DATA BIT_MASK 0xFF /end MEASUREMENT
/begin MEASUREMENT TODWHDS2MX_B "  INHDS: turn-on-delay counter to confirm max error of HDS2" UBYTE Compur_TOND_SWTOV 1 0 0.000000 32.640000 /begin IF_DATA ASAP1B_CCP KP_BLOB 0xFA43 0 1 /end IF_DATA BIT_MASK 0xFF /end MEASUREMENT
/begin MEASUREMENT TODWHDS2MN_B "  INHDS: turn-on-delay counter to confirm min error of HDS2" UBYTE Compur_TOND_SWTOV 1 0 0.000000 32.640000 /begin IF_DATA ASAP1B_CCP KP_BLOB 0xF9D3 0 1 /end IF_DATA BIT_MASK 0xFF /end MEASUREMENT
/begin MEASUREMENT TODWHDS1MX_B "  INHDS: turn-on-delay counter to confirm max error of HDS1" UBYTE Compur_TOND_SWTOV 1 0 0.000000 32.640000 /begin IF_DATA ASAP1B_CCP KP_BLOB 0xF8EE 0 1 /end IF_DATA BIT_MASK 0xFF /end MEASUREMENT
/begin MEASUREMENT TODWHDS1MN_B "  INHDS: turn-on-delay counter to confirm min error of HDS1" UBYTE Compur_TOND_SWTOV 1 0 0.000000 32.640000 /begin IF_DATA ASAP1B_CCP KP_BLOB 0xFA16 0 1 /end IF_DATA BIT_MASK 0xFF /end MEASUREMENT
/begin MEASUREMENT TODWFPLMX_B "  INHMPS: turn-on-delay counter to confirm max error of FPL" UBYTE Compur_TOND_SWTOV 1 0 0.000000 32.640000 /begin IF_DATA ASAP1B_CCP KP_BLOB 0xF9C4 0 1 /end IF_DATA BIT_MASK 0xFF /end MEASUREMENT
/begin MEASUREMENT TODWFPLMN_B "  INHMPS: turn-on-delay counter to confirm min error of FPL" UBYTE Compur_TOND_SWTOV 1 0 0.000000 32.640000 /begin IF_DATA ASAP1B_CCP KP_BLOB 0xF9DE 0 1 /end IF_DATA BIT_MASK 0xFF /end MEASUREMENT
/begin MEASUREMENT TODWFPHMX_B "  INHHPS: turn-on-delay counter to confirm max error of FPH" UBYTE Compur_TOND_SWTOV 1 0 0.000000 32.640000 /begin IF_DATA ASAP1B_CCP KP_BLOB 0xFA2D 0 1 /end IF_DATA BIT_MASK 0xFF /end MEASUREMENT
/begin MEASUREMENT TODWFPHMN_B "  INHHPS: turn-on-delay counter to confirm min error of FPH" UBYTE Compur_TOND_SWTOV 1 0 0.000000 32.640000 /begin IF_DATA ASAP1B_CCP KP_BLOB 0xFA56 0 1 /end IF_DATA BIT_MASK 0xFF /end MEASUREMENT
/begin MEASUREMENT TODWETSMX_B "  INETS: turn-on-delay counter to confirm max error of ETS" UBYTE Compur_TOND_SWTOV 1 0 0.000000 32.640000 /begin IF_DATA ASAP1B_CCP KP_BLOB 0xF9E5 0 1 /end IF_DATA BIT_MASK 0xFF /end MEASUREMENT
/begin MEASUREMENT TODWETSMN_B "  INETS: turn-on-delay counter to confirm min error of ETS" UBYTE Compur_TOND_SWTOV 1 0 0.000000 32.640000 /begin IF_DATA ASAP1B_CCP KP_BLOB 0xF921 0 1 /end IF_DATA BIT_MASK 0xFF /end MEASUREMENT
/begin MEASUREMENT TODWCWTSPEMX_B "  INCWTS: turn-on-delay counter to confirm max error of PE coolant" UBYTE Compur_TOND_SWTOV 1 0 0.000000 32.640000 /begin IF_DATA ASAP1B_CCP KP_BLOB 0xF962 0 1 /end IF_DATA BIT_MASK 0xFF /end MEASUREMENT
/begin MEASUREMENT TODWCWTSPEMN_B "  INCWTS: turn-on-delay counter to confirm min error of PE coolant" UBYTE Compur_TOND_SWTOV 1 0 0.000000 32.640000 /begin IF_DATA ASAP1B_CCP KP_BLOB 0xF942 0 1 /end IF_DATA BIT_MASK 0xFF /end MEASUREMENT
/begin MEASUREMENT TODWCWTSBATMX_B "  INCWTS: turn-on-delay counter to confirm max error of battery coolant" UBYTE Compur_TOND_SWTOV 1 0 0.000000 32.640000 /begin IF_DATA ASAP1B_CCP KP_BLOB 0xF983 0 1 /end IF_DATA BIT_MASK 0xFF /end MEASUREMENT
/begin MEASUREMENT TODWCWTSBATMN_B "  INCWTS: turn-on-delay counter to confirm min error of battery coolant" UBYTE Compur_TOND_SWTOV 1 0 0.000000 32.640000 /begin IF_DATA ASAP1B_CCP KP_BLOB 0xFA5C 0 1 /end IF_DATA BIT_MASK 0xFF /end MEASUREMENT
/begin MEASUREMENT TODWATSMX_B "  INATS: turn-on-delay counter to confirm max error of RTSSBC" UBYTE Compur_TOND_SWTOV 1 0 0.000000 32.640000 /begin IF_DATA ASAP1B_CCP KP_BLOB 0xF9DC 0 1 /end IF_DATA BIT_MASK 0xFF /end MEASUREMENT
/begin MEASUREMENT TODWATSMN_B "  INATS: turn-on-delay counter to confirm min error of RTSSBC" UBYTE Compur_TOND_SWTOV 1 0 0.000000 32.640000 /begin IF_DATA ASAP1B_CCP KP_BLOB 0xF973 0 1 /end IF_DATA BIT_MASK 0xFF /end MEASUREMENT
/begin MEASUREMENT TODLDSSG_B "  INLDS: turn-on-delay counter to confirm signal error of LDS" UBYTE Compur_TOND_SWTOV 1 0 0.000000 32.640000 /begin IF_DATA ASAP1B_CCP KP_BLOB 0xF9B7 0 1 /end IF_DATA BIT_MASK 0xFF /end MEASUREMENT
/begin MEASUREMENT TODIRDMX_B "  IRDA: turn-on-delay counter to confirm communication error of IRDA" UBYTE Compur_TOND_SWTOV 1 0 0.000000 32.640000 /begin IF_DATA ASAP1B_CCP KP_BLOB 0xFA40 0 1 /end IF_DATA BIT_MASK 0xFF /end MEASUREMENT
/begin MEASUREMENT TNACHL_W "motaus: time of ECU switch off delay (non-volatile)" UWORD Compur_TOND_SWTOV 1 0 0.000000 8388.480000 /begin IF_DATA ASAP1B_CCP KP_BLOB 0xF964 0 2 /end IF_DATA BIT_MASK 0xFFFF /end MEASUREMENT
/begin MEASUREMENT TMSTOPTM_W "  CCSTMTM: state machine control time step in TM_STOP" UWORD default 1 0 0.000000 65535.000000 /begin IF_DATA ASAP1B_CCP KP_BLOB 0xF8AE 0 2 /end IF_DATA BIT_MASK 0xFFFF /end MEASUREMENT
/begin MEASUREMENT TMSTAT_B "  CCSTMTM: state machine state number of thermal management " UBYTE default 1 0 0.000000 255.000000 /begin IF_DATA ASAP1B_CCP KP_BLOB 0xF8BE 0 1 /end IF_DATA BIT_MASK 0xFF /end MEASUREMENT
/begin MEASUREMENT TMSHUTTINGDOWNTM_W "  CCSTMTM: state machine control time step in TM_SHUTTINGDOWN" UWORD default 1 0 0.000000 65535.000000 /begin IF_DATA ASAP1B_CCP KP_BLOB 0xF9A8 0 2 /end IF_DATA BIT_MASK 0xFFFF /end MEASUREMENT
/begin MEASUREMENT TMSERIESWITHRADIATORTM_W "  CCSTMTM: state machine control time step in TM_SERIESWITHRADIATOR" UWORD default 1 0 0.000000 65535.000000 /begin IF_DATA ASAP1B_CCP KP_BLOB 0xF90A 0 2 /end IF_DATA BIT_MASK 0xFFFF /end MEASUREMENT
/begin MEASUREMENT TMSERIESWITHOUTRADIATORTMdec "  CCSTMTM: state machine control time step in TM_SERIESWITHOUTRADIATOR" UWORD default 1 0 0.000000 65535.000000 /begin IF_DATA ASAP1B_CCP KP_BLOB 0xF8B6 0 2 /end IF_DATA BIT_MASK 0xFFFF /end MEASUREMENT
/begin MEASUREMENT TMSERIESWITHHEATERTM_W "  CCSTMTM: state machine control time step in TM_SERIESWITHHEATER" UWORD default 1 0 0.000000 65535.000000 /begin IF_DATA ASAP1B_CCP KP_BLOB 0xF978 0 2 /end IF_DATA BIT_MASK 0xFFFF /end MEASUREMENT
/begin MEASUREMENT TMSAFESTATETM_W "  CCSTMTM: state machine control time step in TM_SAFESTATE" UWORD default 1 0 0.000000 65535.000000 /begin IF_DATA ASAP1B_CCP KP_BLOB 0xF97A 0 2 /end IF_DATA BIT_MASK 0xFFFF /end MEASUREMENT
/begin MEASUREMENT TMPARALLELWITHRADIATORTM_dec "  CCSTMTM: state machine control time step in TM_PARALLELWITHRADIATOR" UWORD default 1 0 0.000000 65535.000000 /begin IF_DATA ASAP1B_CCP KP_BLOB 0xF8BC 0 2 /end IF_DATA BIT_MASK 0xFFFF /end MEASUREMENT
/begin MEASUREMENT TMPARALLELWITHOUTRADIATORdec "  CCSTMTM: state machine control time step in TM_PARALLELWITHOUTRADIATOR" UWORD default 1 0 0.000000 65535.000000 /begin IF_DATA ASAP1B_CCP KP_BLOB 0xF8C0 0 2 /end IF_DATA BIT_MASK 0xFFFF /end MEASUREMENT
/begin MEASUREMENT TMPARALLELWITHHEATERTM_W "  CCSTMTM: state machine control time step in TM_PARALLELWITHHEATER" UWORD default 1 0 0.000000 65535.000000 /begin IF_DATA ASAP1B_CCP KP_BLOB 0xF8F4 0 2 /end IF_DATA BIT_MASK 0xFFFF /end MEASUREMENT
/begin MEASUREMENT TMINITTM_W "  CCSTMTM: state machine control time step in TM_INIT" UWORD default 1 0 0.000000 65535.000000 /begin IF_DATA ASAP1B_CCP KP_BLOB 0xF9CC 0 2 /end IF_DATA BIT_MASK 0xFFFF /end MEASUREMENT
/begin MEASUREMENT TMCTRLTM_W "  CCSTMTM: state machine control time step" UWORD default 1 0 0.000000 65535.000000 /begin IF_DATA ASAP1B_CCP KP_BLOB 0xF970 0 2 /end IF_DATA BIT_MASK 0xFFFF /end MEASUREMENT
/begin MEASUREMENT TMCOOLINGTM_W "  CCSTMTM: state machine control time step in TM_COOLING" UWORD default 1 0 0.000000 65535.000000 /begin IF_DATA ASAP1B_CCP KP_BLOB 0xFA52 0 2 /end IF_DATA BIT_MASK 0xFFFF /end MEASUREMENT
/begin MEASUREMENT TENGC_B "  CAN4: Engine coolant temperature via CAN" UBYTE Compur_TENGC_B 1 0 -48.000000 143.250000 /begin IF_DATA ASAP1B_CCP KP_BLOB 0xC1F1 0 1 /end IF_DATA BIT_MASK 0xFF /end MEASUREMENT
/begin MEASUREMENT TENG "  InTENG: Engine coolant temperature. Linearized and calculated." UBYTE Compur_TENGC_B 1 0 -48.000000 143.250000 /begin IF_DATA ASAP1B_CCP KP_BLOB 0xC12C 0 1 /end IF_DATA BIT_MASK 0xFF /end MEASUREMENT
/begin MEASUREMENT TDWRTSSCT_CTR "  INRTS: Counter for time delay TDWRTS" UBYTE Compur_TOND_SWTOV 1 0 0.000000 32.640000 /begin IF_DATA ASAP1B_CCP KP_BLOB 0xFA02 0 1 /end IF_DATA BIT_MASK 0xFF /end MEASUREMENT
/begin MEASUREMENT TDWRTSSBC_CTR "  INRTS: Counter for time delay TDWRTS" UBYTE Compur_TOND_SWTOV 1 0 0.000000 32.640000 /begin IF_DATA ASAP1B_CCP KP_BLOB 0xF920 0 1 /end IF_DATA BIT_MASK 0xFF /end MEASUREMENT
/begin MEASUREMENT TDWETS_CTR "  INETS: Counter for time delay TDWETS" UBYTE Compur_TOND_SWTOV 1 0 0.000000 32.640000 /begin IF_DATA ASAP1B_CCP KP_BLOB 0xF90E 0 1 /end IF_DATA BIT_MASK 0xFF /end MEASUREMENT
/begin MEASUREMENT TDWCWTSPE_CTR "  INCWTS: Counter for time delay TDWCWTSBAT" UBYTE Compur_TOND_SWTOV 1 0 0.000000 32.640000 /begin IF_DATA ASAP1B_CCP KP_BLOB 0xFA28 0 1 /end IF_DATA BIT_MASK 0xFF /end MEASUREMENT
/begin MEASUREMENT TDWCWTSBAT_CTR "  INCWTS: Counter for time delay TDWCWTSBAT" UBYTE Compur_TOND_SWTOV 1 0 0.000000 32.640000 /begin IF_DATA ASAP1B_CCP KP_BLOB 0xFA4C 0 1 /end IF_DATA BIT_MASK 0xFF /end MEASUREMENT
/begin MEASUREMENT TDWATS_CTR "  INATS: Counter for time delay TDWATS" UBYTE Compur_TOND_SWTOV 1 0 0.000000 32.640000 /begin IF_DATA ASAP1B_CCP KP_BLOB 0xF906 0 1 /end IF_DATA BIT_MASK 0xFF /end MEASUREMENT
/begin MEASUREMENT TDNFRPSSCT_CTR "  INRPS: Counter for time delay suct TDNFRPS" UBYTE Compur_TOND_SWTOV 1 0 0.000000 32.640000 /begin IF_DATA ASAP1B_CCP KP_BLOB 0xF8B8 0 1 /end IF_DATA BIT_MASK 0xFF /end MEASUREMENT
/begin MEASUREMENT TDNFRPSSBC_CTR "  INRPS: Counter for time delay subcool TDNFRPS" UBYTE Compur_TOND_SWTOV 1 0 0.000000 32.640000 /begin IF_DATA ASAP1B_CCP KP_BLOB 0xF909 0 1 /end IF_DATA BIT_MASK 0xFF /end MEASUREMENT
/begin MEASUREMENT TDNFPNG_CTR "  INHHPS: Counter for time delay TDNGPNG" UBYTE Compur_TOND_SWTOV 1 0 0.000000 32.640000 /begin IF_DATA ASAP1B_CCP KP_BLOB 0xF9B6 0 1 /end IF_DATA BIT_MASK 0xFF /end MEASUREMENT
/begin MEASUREMENT TDNFHDS3_CTR "  INHDS: Counter for time delay TDNFHDS3" UBYTE Compur_TOND_SWTOV 1 0 0.000000 32.640000 /begin IF_DATA ASAP1B_CCP KP_BLOB 0xF8C5 0 1 /end IF_DATA BIT_MASK 0xFF /end MEASUREMENT
/begin MEASUREMENT TDNFHDS2_CTR "  INHDS: Counter for time delay TDNFHDS2" UBYTE Compur_TOND_SWTOV 1 0 0.000000 32.640000 /begin IF_DATA ASAP1B_CCP KP_BLOB 0xF898 0 1 /end IF_DATA BIT_MASK 0xFF /end MEASUREMENT
/begin MEASUREMENT TDNFHDS1_CTR "  INHDS: Counter for time delay TDNFHDS1" UBYTE Compur_TOND_SWTOV 1 0 0.000000 32.640000 /begin IF_DATA ASAP1B_CCP KP_BLOB 0xFA25 0 1 /end IF_DATA BIT_MASK 0xFF /end MEASUREMENT
/begin MEASUREMENT TDNFFPL_CTR "  INHMPS: Counter for time delay TDNFFPL" UBYTE Compur_TOND_SWTOV 1 0 0.000000 32.640000 /begin IF_DATA ASAP1B_CCP KP_BLOB 0xF9EA 0 1 /end IF_DATA BIT_MASK 0xFF /end MEASUREMENT
/begin MEASUREMENT TDMRCUTOFF_W "motaus: time of Main Relay Cut-off time (non-volatile)" UWORD Compur_TDMRCUTOFF_W 1 0 0.000000 524.280000 /begin IF_DATA ASAP1B_CCP KP_BLOB 0xF938 0 2 /end IF_DATA BIT_MASK 0xFFFF /end MEASUREMENT
/begin MEASUREMENT TDLDS_CTR "  INLDS: Counter for time delay TDWLDS" UBYTE Compur_TOND_SWTOV 1 0 0.000000 32.640000 /begin IF_DATA ASAP1B_CCP KP_BLOB 0xF993 0 1 /end IF_DATA BIT_MASK 0xFF /end MEASUREMENT
/begin MEASUREMENT TDIRDIAG_CTR "  IRDA: Counter for time delay B_irdiag" UBYTE Compur_TOND_SWTOV 1 0 0.000000 32.640000 /begin IF_DATA ASAP1B_CCP KP_BLOB 0xF9D5 0 1 /end IF_DATA BIT_MASK 0xFF /end MEASUREMENT
/begin MEASUREMENT TDIRDHL_CTR "  IRDA: Counter for time delay TDIRDHL" UBYTE Compur_TOND_SWTOV 1 0 0.000000 32.640000 /begin IF_DATA ASAP1B_CCP KP_BLOB 0xF99B 0 1 /end IF_DATA BIT_MASK 0xFF /end MEASUREMENT
/begin MEASUREMENT TDCGUNCHK_CTR "  CCSTMFC: Counter for time delay confirmation charger gun detection confirmation" UBYTE Compur_TOND_SWTOV 1 0 0.000000 32.640000 /begin IF_DATA ASAP1B_CCP KP_BLOB 0xF907 0 1 /end IF_DATA BIT_MASK 0xFF /end MEASUREMENT
/begin MEASUREMENT TDCGUNCHK_CTR "  CCSTMFC: Counter for time delay confirmation charger gun detection confirmation" UBYTE Compur_TOND_SWTOV 1 0 0.000000 32.640000 /begin IF_DATA ASAP1B_CCP KP_BLOB 0xF907 0 1 /end IF_DATA BIT_MASK 0xFF /end MEASUREMENT
/begin MEASUREMENT TDCGUN_CTR "  INLDS: Counter for time delay confirmation charger gun detection" UBYTE Compur_TOND_SWTOV 1 0 0.000000 32.640000 /begin IF_DATA ASAP1B_CCP KP_BLOB 0xF992 0 1 /end IF_DATA BIT_MASK 0xFF /end MEASUREMENT
/begin MEASUREMENT TCV_W " NULL  " UWORD Compur_TCV_W 1 0 0.000000 65535.000000 /begin IF_DATA ASAP1B_CCP KP_BLOB 0xFD20 0 2 /end IF_DATA BIT_MASK 0xFFFF /end MEASUREMENT
/begin MEASUREMENT TACHTIME_W "  inph: capture of tacho interrupt event time" UWORD Compur_VSSTIME_W 1 0 0.000000 4194240.000000 /begin IF_DATA ASAP1B_CCP KP_BLOB 0xF918 0 2 /end IF_DATA BIT_MASK 0xFFFF /end MEASUREMENT
/begin MEASUREMENT TACHPERIOD_W "  inph: old time capture of tacho interrupt event time" UWORD Compur_VSSTIME_W 1 0 0.000000 4194240.000000 /begin IF_DATA ASAP1B_CCP KP_BLOB 0xF896 0 2 /end IF_DATA BIT_MASK 0xFFFF /end MEASUREMENT
/begin MEASUREMENT T3_W "	ininjpg: T3 core timer (64usec resolution)" UWORD Compur_VSSTIME_W 1 0 0.000000 4194240.000000 /begin IF_DATA ASAP1B_CCP KP_BLOB 0xC7E6 0 2 /end IF_DATA BIT_MASK 0xFFFF /end MEASUREMENT
/begin MEASUREMENT T1_W "	ininjpg: T1 core timer (4usec resolution)" UWORD Compur_T1_W 1 0 0.000000 262140.000000 /begin IF_DATA ASAP1B_CCP KP_BLOB 0xC816 0 2 /end IF_DATA BIT_MASK 0xFFFF /end MEASUREMENT
/begin MEASUREMENT T0_W "	ininjpg: T0 core timer (4usec resolution)" UWORD Compur_T1_W 1 0 0.000000 262140.000000 /begin IF_DATA ASAP1B_CCP KP_BLOB 0xC830 0 2 /end IF_DATA BIT_MASK 0xFFFF /end MEASUREMENT
/begin MEASUREMENT SYSTMOVCTR_W " excinos: system time overflow counter" UWORD default 1 0 0.000000 65535.000000 /begin IF_DATA ASAP1B_CCP KP_BLOB 0xF89A 0 2 /end IF_DATA BIT_MASK 0xFFFF /end MEASUREMENT
/begin MEASUREMENT SYSLISOC_B "  CAN4:Lithium battery SOC" UBYTE Compur_SYSLISOC_B 1 0 0.000000 255.000000 /begin IF_DATA ASAP1B_CCP KP_BLOB 0xC1EA 0 1 /end IF_DATA BIT_MASK 0xFF /end MEASUREMENT
/begin MEASUREMENT SYNCTR "  inph: synchro counter" UBYTE default 1 0 0.000000 255.000000 /begin IF_DATA ASAP1B_CCP KP_BLOB 0xF913 0 1 /end IF_DATA BIT_MASK 0xFF /end MEASUREMENT
/begin MEASUREMENT SWTYPE_B "  INFCSW: copy of fuel cell switch type." UBYTE default 1 0 0.000000 255.000000 /begin IF_DATA ASAP1B_CCP KP_BLOB 0xF90F 0 1 /end IF_DATA BIT_MASK 0xFF /end MEASUREMENT
/begin MEASUREMENT SWOFFDLBITS " NULL  " UWORD Compur_TCV_W 1 0 0.000000 65535.000000 /begin IF_DATA ASAP1B_CCP KP_BLOB 0xFD16 0 2 /end IF_DATA BIT_MASK 0xFFFF /end MEASUREMENT
/begin MEASUREMENT SVSSTATE " DSVS: Status: Service vehicle soon lamp control" UBYTE default 1 0 0.000000 255.000000 /begin IF_DATA ASAP1B_CCP KP_BLOB 0xC202 0 1 /end IF_DATA BIT_MASK 0xFF /end MEASUREMENT
/begin MEASUREMENT SVSBITS " DSVS: bit array for %DSVS control" UBYTE default 1 0 0.000000 255.000000 /begin IF_DATA ASAP1B_CCP KP_BLOB 0xC20F 0 1 /end IF_DATA BIT_MASK 0xFF /end MEASUREMENT
/begin MEASUREMENT STVEHOP_B "  swadap: State of vehicle operation" UBYTE default 1 0 0.000000 255.000000 /begin IF_DATA ASAP1B_CCP KP_BLOB 0xF9D6 0 1 /end IF_DATA BIT_MASK 0xFF /end MEASUREMENT
/begin MEASUREMENT SPR2TIME_W "  swadap: capture of SPR2 interrupt event time" UWORD Compur_VSSTIME_W 1 0 0.000000 4194240.000000 /begin IF_DATA ASAP1B_CCP KP_BLOB 0xFA0E 0 2 /end IF_DATA BIT_MASK 0xFFFF /end MEASUREMENT
/begin MEASUREMENT SPR2PERIOD_W "  swadap: old time capture of SPR2 interrupt event time" UWORD Compur_VSSTIME_W 1 0 0.000000 4194240.000000 /begin IF_DATA ASAP1B_CCP KP_BLOB 0xFA32 0 2 /end IF_DATA BIT_MASK 0xFFFF /end MEASUREMENT
/begin MEASUREMENT SPR2_W "  Period of SPARE2 signal" UWORD Compur_VSSTIME_W 1 0 0.000000 4194240.000000 /begin IF_DATA ASAP1B_CCP KP_BLOB 0xF9EC 0 2 /end IF_DATA BIT_MASK 0xFFFF /end MEASUREMENT
/begin MEASUREMENT SFPAAA[9] "DFPM:[9]" UWORD default 1 0 0.000000 65535.000000 /begin IF_DATA ASAP1B_CCP KP_BLOB 0xDBE6 0 2 /end IF_DATA BIT_MASK 0xFFFF /end MEASUREMENT
/begin MEASUREMENT SFPAAA[8] "DFPM:[8]" UWORD default 1 0 0.000000 65535.000000 /begin IF_DATA ASAP1B_CCP KP_BLOB 0xDBE4 0 2 /end IF_DATA BIT_MASK 0xFFFF /end MEASUREMENT
/begin MEASUREMENT SFPAAA[7] "DFPM:[7]" UWORD default 1 0 0.000000 65535.000000 /begin IF_DATA ASAP1B_CCP KP_BLOB 0xDBE2 0 2 /end IF_DATA BIT_MASK 0xFFFF /end MEASUREMENT
/begin MEASUREMENT SFPAAA[6] "DFPM:[6]" UWORD default 1 0 0.000000 65535.000000 /begin IF_DATA ASAP1B_CCP KP_BLOB 0xDBE0 0 2 /end IF_DATA BIT_MASK 0xFFFF /end MEASUREMENT
/begin MEASUREMENT SFPAAA[5] "DFPM:[5]" UWORD default 1 0 0.000000 65535.000000 /begin IF_DATA ASAP1B_CCP KP_BLOB 0xDBDE 0 2 /end IF_DATA BIT_MASK 0xFFFF /end MEASUREMENT
/begin MEASUREMENT SFPAAA[4] "DFPM:[4]" UWORD default 1 0 0.000000 65535.000000 /begin IF_DATA ASAP1B_CCP KP_BLOB 0xDBDC 0 2 /end IF_DATA BIT_MASK 0xFFFF /end MEASUREMENT
/begin MEASUREMENT SFPAAA[3] "DFPM:[3]" UWORD default 1 0 0.000000 65535.000000 /begin IF_DATA ASAP1B_CCP KP_BLOB 0xDBDA 0 2 /end IF_DATA BIT_MASK 0xFFFF /end MEASUREMENT
/begin MEASUREMENT SFPAAA[22] "DFPM:[22]" UWORD default 1 0 0.000000 65535.000000 /begin IF_DATA ASAP1B_CCP KP_BLOB 0xDC00 0 2 /end IF_DATA BIT_MASK 0xFFFF /end MEASUREMENT
/begin MEASUREMENT SFPAAA[21] "DFPM:[21]" UWORD default 1 0 0.000000 65535.000000 /begin IF_DATA ASAP1B_CCP KP_BLOB 0xDBFE 0 2 /end IF_DATA BIT_MASK 0xFFFF /end MEASUREMENT
/begin MEASUREMENT SFPAAA[20] "DFPM:[20]" UWORD default 1 0 0.000000 65535.000000 /begin IF_DATA ASAP1B_CCP KP_BLOB 0xDBFC 0 2 /end IF_DATA BIT_MASK 0xFFFF /end MEASUREMENT
/begin MEASUREMENT SFPAAA[2] "DFPM:[2]" UWORD default 1 0 0.000000 65535.000000 /begin IF_DATA ASAP1B_CCP KP_BLOB 0xDBD8 0 2 /end IF_DATA BIT_MASK 0xFFFF /end MEASUREMENT
/begin MEASUREMENT SFPAAA[19] "DFPM:[19]" UWORD default 1 0 0.000000 65535.000000 /begin IF_DATA ASAP1B_CCP KP_BLOB 0xDBFA 0 2 /end IF_DATA BIT_MASK 0xFFFF /end MEASUREMENT
/begin MEASUREMENT SFPAAA[18] "DFPM:[18]" UWORD default 1 0 0.000000 65535.000000 /begin IF_DATA ASAP1B_CCP KP_BLOB 0xDBF8 0 2 /end IF_DATA BIT_MASK 0xFFFF /end MEASUREMENT
/begin MEASUREMENT SFPAAA[17] "DFPM:[17]" UWORD default 1 0 0.000000 65535.000000 /begin IF_DATA ASAP1B_CCP KP_BLOB 0xDBF6 0 2 /end IF_DATA BIT_MASK 0xFFFF /end MEASUREMENT
/begin MEASUREMENT SFPAAA[16] "DFPM:[16]" UWORD default 1 0 0.000000 65535.000000 /begin IF_DATA ASAP1B_CCP KP_BLOB 0xDBF4 0 2 /end IF_DATA BIT_MASK 0xFFFF /end MEASUREMENT
/begin MEASUREMENT SFPAAA[15] "DFPM:[15]" UWORD default 1 0 0.000000 65535.000000 /begin IF_DATA ASAP1B_CCP KP_BLOB 0xDBF2 0 2 /end IF_DATA BIT_MASK 0xFFFF /end MEASUREMENT
/begin MEASUREMENT SFPAAA[14] "DFPM:[14]" UWORD default 1 0 0.000000 65535.000000 /begin IF_DATA ASAP1B_CCP KP_BLOB 0xDBF0 0 2 /end IF_DATA BIT_MASK 0xFFFF /end MEASUREMENT
/begin MEASUREMENT SFPAAA[13] "DFPM:[13]" UWORD default 1 0 0.000000 65535.000000 /begin IF_DATA ASAP1B_CCP KP_BLOB 0xDBEE 0 2 /end IF_DATA BIT_MASK 0xFFFF /end MEASUREMENT
/begin MEASUREMENT SFPAAA[12] "DFPM:[12]" UWORD default 1 0 0.000000 65535.000000 /begin IF_DATA ASAP1B_CCP KP_BLOB 0xDBEC 0 2 /end IF_DATA BIT_MASK 0xFFFF /end MEASUREMENT
/begin MEASUREMENT SFPAAA[11] "DFPM:[11]" UWORD default 1 0 0.000000 65535.000000 /begin IF_DATA ASAP1B_CCP KP_BLOB 0xDBEA 0 2 /end IF_DATA BIT_MASK 0xFFFF /end MEASUREMENT
/begin MEASUREMENT SFPAAA[10] "DFPM:[10]" UWORD default 1 0 0.000000 65535.000000 /begin IF_DATA ASAP1B_CCP KP_BLOB 0xDBE8 0 2 /end IF_DATA BIT_MASK 0xFFFF /end MEASUREMENT
/begin MEASUREMENT SFPAAA[1] "DFPM:[1]" UWORD default 1 0 0.000000 65535.000000 /begin IF_DATA ASAP1B_CCP KP_BLOB 0xDBD6 0 2 /end IF_DATA BIT_MASK 0xFFFF /end MEASUREMENT
/begin MEASUREMENT SFPAAA[0] "DFPM:[0]" UWORD default 1 0 0.000000 65535.000000 /begin IF_DATA ASAP1B_CCP KP_BLOB 0xDBD4 0 2 /end IF_DATA BIT_MASK 0xFFFF /end MEASUREMENT
/begin MEASUREMENT RXMSG_W " ASC1DAT: Rx meaage with status code" UWORD Compur_TXLENGTH_W 1 0 0.000000 65535.000000 /begin IF_DATA ASAP1B_CCP KP_BLOB 0xC2C2 0 2 /end IF_DATA BIT_MASK 0xFFFF /end MEASUREMENT
/begin MEASUREMENT RTSSCTLIN_B "  INRTS: Suct Refrigerant temperature. Linearized and calculated." UBYTE Compur_RTSSCTLIN_B 1 0 -50.000000 105.550000 /begin IF_DATA ASAP1B_CCP KP_BLOB 0xF9DA 0 1 /end IF_DATA BIT_MASK 0xFF /end MEASUREMENT
/begin MEASUREMENT RTSSBCLIN_B "  INRTS: Subcool refrigerant temperature. Linearized and calculated." UBYTE Compur_RTSSCTLIN_B 1 0 -50.000000 105.550000 /begin IF_DATA ASAP1B_CCP KP_BLOB 0xF9D1 0 1 /end IF_DATA BIT_MASK 0xFF /end MEASUREMENT
/begin MEASUREMENT RTSCT_B "  INRTS: Suct Refrigerant temperature. Linearized and calculated." UBYTE Compur_RTSSCTLIN_B 1 0 -50.000000 105.550000 /begin IF_DATA ASAP1B_CCP KP_BLOB 0xFA3C 0 1 /end IF_DATA BIT_MASK 0xFF /end MEASUREMENT
/begin MEASUREMENT RTSBC_B "  INRTS: Subcool refrigerant temperature. Linearized and calculated." UBYTE Compur_RTSSCTLIN_B 1 0 -50.000000 105.550000 /begin IF_DATA ASAP1B_CCP KP_BLOB 0xF9BF 0 1 /end IF_DATA BIT_MASK 0xFF /end MEASUREMENT
/begin MEASUREMENT RPSSCTO_W "  INRPS: low pass filtered value for suct rps" UWORD Compur_RPSSCTO_W 1 0 0.000000 3139.978455 /begin IF_DATA ASAP1B_CCP KP_BLOB 0xFA04 0 2 /end IF_DATA BIT_MASK 0xFFFF /end MEASUREMENT
/begin MEASUREMENT RPSSCT_W "  INRPS: suct refrigerant pressure " UWORD Compur_RPSSCTO_W 1 0 0.000000 3139.978455 /begin IF_DATA ASAP1B_CCP KP_BLOB 0xF9F8 0 2 /end IF_DATA BIT_MASK 0xFFFF /end MEASUREMENT
/begin MEASUREMENT RPSSBCO_W "  INRPS: low pass filtered value for subcool rps" UWORD Compur_RPSSCTO_W 1 0 0.000000 3139.978455 /begin IF_DATA ASAP1B_CCP KP_BLOB 0xFA18 0 2 /end IF_DATA BIT_MASK 0xFFFF /end MEASUREMENT
/begin MEASUREMENT RPSSBC " No Comment" UBYTE default 1 0 0.000000 255.000000 /begin IF_DATA ASAP1B_CCP KP_BLOB 0xF912 0 1 /end IF_DATA BIT_MASK 0xFF /end MEASUREMENT
/begin MEASUREMENT RPSSBC_W "  INRPS: subcool refrigerant pressure " UWORD Compur_RPSSCTO_W 1 0 0.000000 3139.978455 /begin IF_DATA ASAP1B_CCP KP_BLOB 0xF934 0 2 /end IF_DATA BIT_MASK 0xFFFF /end MEASUREMENT
/begin MEASUREMENT RPMO_W "  ccrpm: motor speed old value" UWORD Compur_RPMO_W 1 0 0.000000 65535.000000 /begin IF_DATA ASAP1B_CCP KP_BLOB 0xF8E8 0 2 /end IF_DATA BIT_MASK 0xFFFF /end MEASUREMENT
/begin MEASUREMENT RPMC_W "  CAN4:Motor Speed (Engine Speed)" UWORD Compur_RPMC_W 1 0 0.000000 8191.875000 /begin IF_DATA ASAP1B_CCP KP_BLOB 0xF932 0 2 /end IF_DATA BIT_MASK 0xFFFF /end MEASUREMENT
/begin MEASUREMENT RPM32 "  MOTOR SPEED (32 RPM )" UBYTE Compur_RPM32 1 0 0.000000 8160.000000 /begin IF_DATA ASAP1B_CCP KP_BLOB 0xF9DF 0 1 /end IF_DATA BIT_MASK 0xFF /end MEASUREMENT
/begin MEASUREMENT RPM08 "  ccrpm: MOTOR SPEED (8 RPM )" UBYTE Compur_RPM08 1 0 0.000000 2040.000000 /begin IF_DATA ASAP1B_CCP KP_BLOB 0xF9D4 0 1 /end IF_DATA BIT_MASK 0xFF /end MEASUREMENT
/begin MEASUREMENT RPM01 "  ccrpm: MOTOR SPEED (1 RPM )" UWORD Compur_RPMO_W 1 0 0.000000 65535.000000 /begin IF_DATA ASAP1B_CCP KP_BLOB 0xFA48 0 2 /end IF_DATA BIT_MASK 0xFFFF /end MEASUREMENT
/begin MEASUREMENT RPM_W "  ccrpm: motor speed" UWORD Compur_RPMC_W 1 0 0.000000 8191.875000 /begin IF_DATA ASAP1B_CCP KP_BLOB 0xF8B2 0 2 /end IF_DATA BIT_MASK 0xFFFF /end MEASUREMENT
/begin MEASUREMENT RPM_B "  ccrpm: motor SPEED (8 bit )" UBYTE Compur_RPM_B 1 0 0.000000 10200.000000 /begin IF_DATA ASAP1B_CCP KP_BLOB 0xF925 0 1 /end IF_DATA BIT_MASK 0xFF /end MEASUREMENT
/begin MEASUREMENT RGVTAF_B "  infstt: relative free gas capacity in fuel tank" UBYTE Compur_RGVTAF_B 1 0 0.000000 127.500000 /begin IF_DATA ASAP1B_CCP KP_BLOB 0xFA2B 0 1 /end IF_DATA BIT_MASK 0xFF /end MEASUREMENT
/begin MEASUREMENT RFSTT_B "  infstt: relative fuel level" UBYTE Compur_RGVTAF_B 1 0 0.000000 127.500000 /begin IF_DATA ASAP1B_CCP KP_BLOB 0xF985 0 1 /end IF_DATA BIT_MASK 0xFF /end MEASUREMENT
/begin MEASUREMENT R2MSCNT "  BACKGROUND MONITOR COUNTER for 2ms tasks" UBYTE default 1 0 0.000000 255.000000 /begin IF_DATA ASAP1B_CCP KP_BLOB 0xF90C 0 1 /end IF_DATA BIT_MASK 0xFF /end MEASUREMENT
/begin MEASUREMENT R1MSCNT " %EXCINOS: BACKGROUND MONITOR COUNTER for 1ms tasks" UBYTE default 1 0 0.000000 255.000000 /begin IF_DATA ASAP1B_CCP KP_BLOB 0xF92A 0 1 /end IF_DATA BIT_MASK 0xFF /end MEASUREMENT
/begin MEASUREMENT PWRDWNCH "  Power Down check code is 0x5555" UWORD default 1 0 0.000000 65535.000000 /begin IF_DATA ASAP1B_CCP KP_BLOB 0xDFFE 0 2 /end IF_DATA BIT_MASK 0xFFFF /end MEASUREMENT
/begin MEASUREMENT PWF_LABEL " No Comment" UWORD default 1 0 0.000000 65535.000000 /begin IF_DATA ASAP1B_CCP KP_BLOB 0xDBD2 0 2 /end IF_DATA BIT_MASK 0xFFFF /end MEASUREMENT
/begin MEASUREMENT PSYNCTR "  inph: phase synchro counter" UBYTE default 1 0 0.000000 255.000000 /begin IF_DATA ASAP1B_CCP KP_BLOB 0xF99A 0 1 /end IF_DATA BIT_MASK 0xFF /end MEASUREMENT
/begin MEASUREMENT POWERONHOURS_L "  CAN4:System Cumulative time to power up(h)" ULONG Compur_POWERONHOURS_L 1 0 0.000000 429496729.500000 /begin IF_DATA ASAP1B_CCP KP_BLOB 0xDC16 0 4 /end IF_DATA BIT_MASK 0xFFFFFFFF /end MEASUREMENT
/begin MEASUREMENT PINSULRES_W "  CAN4:BMS+ insulation resistance" UWORD Compur_PINSULRES_W 1 0 0.000000 65535.000000 /begin IF_DATA ASAP1B_CCP KP_BLOB 0xC7FE 0 2 /end IF_DATA BIT_MASK 0xFFFF /end MEASUREMENT
/begin MEASUREMENT NMOTRSP_W[5] "  %ccng: Start ring buffer for rpm value[5]" UWORD Compur_NMOTRSP_W[5] 1 0 0.000000 16383.750000 /begin IF_DATA ASAP1B_CCP KP_BLOB 0xF990 0 2 /end IF_DATA BIT_MASK 0xFFFF /end MEASUREMENT
/begin MEASUREMENT NMOTRSP_W[4] "  %ccng: Start ring buffer for rpm value[4]" UWORD Compur_NMOTRSP_W[5] 1 0 0.000000 16383.750000 /begin IF_DATA ASAP1B_CCP KP_BLOB 0xF98E 0 2 /end IF_DATA BIT_MASK 0xFFFF /end MEASUREMENT
/begin MEASUREMENT NMOTRSP_W[3] "  %ccng: Start ring buffer for rpm value[3]" UWORD Compur_NMOTRSP_W[5] 1 0 0.000000 16383.750000 /begin IF_DATA ASAP1B_CCP KP_BLOB 0xF98C 0 2 /end IF_DATA BIT_MASK 0xFFFF /end MEASUREMENT
/begin MEASUREMENT NMOTRSP_W[2] "  %ccng: Start ring buffer for rpm value[2]" UWORD Compur_NMOTRSP_W[5] 1 0 0.000000 16383.750000 /begin IF_DATA ASAP1B_CCP KP_BLOB 0xF98A 0 2 /end IF_DATA BIT_MASK 0xFFFF /end MEASUREMENT
/begin MEASUREMENT NMOTRSP_W[1] "  %ccng: Start ring buffer for rpm value[1]" UWORD Compur_NMOTRSP_W[5] 1 0 0.000000 16383.750000 /begin IF_DATA ASAP1B_CCP KP_BLOB 0xF988 0 2 /end IF_DATA BIT_MASK 0xFFFF /end MEASUREMENT
/begin MEASUREMENT NMOTRSP_W[0] "  %ccng: Start ring buffer for rpm value[0]" UWORD Compur_NMOTRSP_W[5] 1 0 0.000000 16383.750000 /begin IF_DATA ASAP1B_CCP KP_BLOB 0xF986 0 2 /end IF_DATA BIT_MASK 0xFFFF /end MEASUREMENT
/begin MEASUREMENT NMOTAS_W "  %ccng: engine revolution ofer SY_ZYLZA segements" UWORD Compur_NMOTRSP_W[5] 1 0 0.000000 16383.750000 /begin IF_DATA ASAP1B_CCP KP_BLOB 0xF91E 0 2 /end IF_DATA BIT_MASK 0xFFFF /end MEASUREMENT
/begin MEASUREMENT NINSULRES_W "  CAN4:BMS- insulation resistance" UWORD Compur_PINSULRES_W 1 0 0.000000 65535.000000 /begin IF_DATA ASAP1B_CCP KP_BLOB 0xC80C 0 2 /end IF_DATA BIT_MASK 0xFFFF /end MEASUREMENT
/begin MEASUREMENT NGFIL " %ccng: filtered engine speed gradient" SBYTE Compur_NGFIL 1 0 -12800.000000 12700.000000 /begin IF_DATA ASAP1B_CCP KP_BLOB 0xF8AC 0 1 /end IF_DATA BIT_MASK 0xFF /end MEASUREMENT
/begin MEASUREMENT NGFIL_W " %ccng: filtered engine speed gradient" SWORD Compur_NGFIL_W 1 0 -12800.163840 12799.773210 /begin IF_DATA ASAP1B_CCP KP_BLOB 0xFA2E 0 2 /end IF_DATA BIT_MASK 0xFFFF /end MEASUREMENT
/begin MEASUREMENT NGAS_W " %ccng: engine speed gradient during one working cycle" SWORD Compur_NGFIL_W 1 0 -12800.163840 12799.773210 /begin IF_DATA ASAP1B_CCP KP_BLOB 0xFA62 0 2 /end IF_DATA BIT_MASK 0xFFFF /end MEASUREMENT
/begin MEASUREMENT MILSTATNOV " DMIL: Status der MIL non volatile part" UBYTE default 1 0 0.000000 255.000000 /begin IF_DATA ASAP1B_CCP KP_BLOB 0xDBC6 0 1 /end IF_DATA BIT_MASK 0xFF /end MEASUREMENT
/begin MEASUREMENT MILSTAT " DMIL: Status des DMIL-Moduls" UBYTE default 1 0 0.000000 255.000000 /begin IF_DATA ASAP1B_CCP KP_BLOB 0xC165 0 1 /end IF_DATA BIT_MASK 0xFF /end MEASUREMENT
/begin MEASUREMENT LOWVOLTPOWER_B "  CAN4:Low voltage 24V comsume power" UBYTE Compur_WATERPUMPPOWER_B 1 0 0.000000 25.500000 /begin IF_DATA ASAP1B_CCP KP_BLOB 0xC18C 0 1 /end IF_DATA BIT_MASK 0xFF /end MEASUREMENT
/begin MEASUREMENT LDS_W "  INLDS: Laser detection sensor" UWORD Compur_LDS_W 1 0 0.000000 499.966515 /begin IF_DATA ASAP1B_CCP KP_BLOB 0xF8F2 0 2 /end IF_DATA BIT_MASK 0xFFFF /end MEASUREMENT
/begin MEASUREMENT IRSPSYN " %ccng: index to address memory of tsegrsp_w, nmottrsp_w" UBYTE default 1 0 0.000000 255.000000 /begin IF_DATA ASAP1B_CCP KP_BLOB 0xF9EE 0 1 /end IF_DATA BIT_MASK 0xFF /end MEASUREMENT
/begin MEASUREMENT IRDA100MSCTR_B "  IRDA: Counter for 100msec Rx event" UBYTE Compur_TXLENGTH_W 1 0 0.000000 255.000000 /begin IF_DATA ASAP1B_CCP KP_BLOB 0xF92E 0 1 /end IF_DATA BIT_MASK 0xFF /end MEASUREMENT
/begin MEASUREMENT IR_WUPIDLETIME_B " IRDA: for time-measurement WUP idle time of IRDA" UBYTE Compur_IR_WUPIDLETIME_B 1 0 0.000000 255.000000 /begin IF_DATA ASAP1B_CCP KP_BLOB 0xC10E 0 1 /end IF_DATA BIT_MASK 0xFF /end MEASUREMENT
/begin MEASUREMENT INLPGSWNVRAM "inlpgsw: bit array: 0: LPG switch state from the port input (non-volatile)" UBYTE default 1 0 0.000000 255.000000 /begin IF_DATA ASAP1B_CCP KP_BLOB 0xDC02 0 1 /end IF_DATA BIT_MASK 0xFF /end MEASUREMENT
/begin MEASUREMENT INFSTTBITS "  infstt:" UWORD default 1 0 0.000000 65535.000000 /begin IF_DATA ASAP1B_CCP KP_BLOB 0xF8C2 0 2 /end IF_DATA BIT_MASK 0xFFFF /end MEASUREMENT
/begin MEASUREMENT INBVLOCBITS2 " %inbv: Preemptive bit array" UBYTE default 1 0 0.000000 255.000000 /begin IF_DATA ASAP1B_CCP KP_BLOB 0xF9E0 0 1 /end IF_DATA BIT_MASK 0xFF /end MEASUREMENT
/begin MEASUREMENT INBVLOCBITS1 " %inbv: Cooperative bit array" UBYTE default 1 0 0.000000 255.000000 /begin IF_DATA ASAP1B_CCP KP_BLOB 0xF9DB 0 1 /end IF_DATA BIT_MASK 0xFF /end MEASUREMENT
/begin MEASUREMENT HVSETVOLTC_W "  CAN4:Lithium battery voltage (14bits)" UWORD Compur_POWERONHOURS_L 1 0 0.000000 6553.500000 /begin IF_DATA ASAP1B_CCP KP_BLOB 0xC810 0 2 /end IF_DATA BIT_MASK 0xFFFF /end MEASUREMENT
/begin MEASUREMENT HVSETVOLT_W "  CCSTMFC:Lithium battery voltage (14bits)" UWORD Compur_POWERONHOURS_L 1 0 0.000000 6553.500000 /begin IF_DATA ASAP1B_CCP KP_BLOB 0xF9B2 0 2 /end IF_DATA BIT_MASK 0xFFFF /end MEASUREMENT
/begin MEASUREMENT HVSETVOLT_W "  CCSTMFC:Lithium battery voltage (14bits)" UWORD Compur_POWERONHOURS_L 1 0 0.000000 6553.500000 /begin IF_DATA ASAP1B_CCP KP_BLOB 0xF9B2 0 2 /end IF_DATA BIT_MASK 0xFFFF /end MEASUREMENT
/begin MEASUREMENT HVSETPOWERC_W "  CAN4:Charging power (13bits)" UWORD Compur_WATERPUMPPOWER_B 1 0 0.000000 6553.500000 /begin IF_DATA ASAP1B_CCP KP_BLOB 0xC824 0 2 /end IF_DATA BIT_MASK 0xFFFF /end MEASUREMENT
/begin MEASUREMENT HVSETPOWER_W "  CCSTMFC:Charging power (13bits)" UWORD Compur_WATERPUMPPOWER_B 1 0 0.000000 6553.500000 /begin IF_DATA ASAP1B_CCP KP_BLOB 0xFA54 0 2 /end IF_DATA BIT_MASK 0xFFFF /end MEASUREMENT
/begin MEASUREMENT HVSETPOWER_W "  CCSTMFC:Charging power (13bits)" UWORD Compur_WATERPUMPPOWER_B 1 0 0.000000 6553.500000 /begin IF_DATA ASAP1B_CCP KP_BLOB 0xFA54 0 2 /end IF_DATA BIT_MASK 0xFFFF /end MEASUREMENT
/begin MEASUREMENT HVSETCURRC_W "  CAN4:Charging current (14bits)" UWORD Compur_HVSETCURRC_W 1 0 0.000000 6553.500000 /begin IF_DATA ASAP1B_CCP KP_BLOB 0xC834 0 2 /end IF_DATA BIT_MASK 0xFFFF /end MEASUREMENT
/begin MEASUREMENT HVSETCURR_W "  CCSTMFC:Charging current (14bits)" UWORD Compur_HVSETCURRC_W 1 0 0.000000 6553.500000 /begin IF_DATA ASAP1B_CCP KP_BLOB 0xFA36 0 2 /end IF_DATA BIT_MASK 0xFFFF /end MEASUREMENT
/begin MEASUREMENT HVSETCURR_W "  CCSTMFC:Charging current (14bits)" UWORD Compur_HVSETCURRC_W 1 0 0.000000 6553.500000 /begin IF_DATA ASAP1B_CCP KP_BLOB 0xFA36 0 2 /end IF_DATA BIT_MASK 0xFFFF /end MEASUREMENT
/begin MEASUREMENT HVONVOLTACTC_B "  CAN4:Vehicle ON signal" UBYTE Compur_TXLENGTH_W 1 0 0.000000 255.000000 /begin IF_DATA ASAP1B_CCP KP_BLOB 0xC1DD 0 1 /end IF_DATA BIT_MASK 0xFF /end MEASUREMENT
/begin MEASUREMENT HVONVOLTACT_B "  CCSTMFC:Vehicle ON signal" UBYTE Compur_TXLENGTH_W 1 0 0.000000 255.000000 /begin IF_DATA ASAP1B_CCP KP_BLOB 0xF9BE 0 1 /end IF_DATA BIT_MASK 0xFF /end MEASUREMENT
/begin MEASUREMENT HVONVOLTACT_B "  CCSTMFC:Vehicle ON signal" UBYTE Compur_TXLENGTH_W 1 0 0.000000 255.000000 /begin IF_DATA ASAP1B_CCP KP_BLOB 0xF9BE 0 1 /end IF_DATA BIT_MASK 0xFF /end MEASUREMENT
/begin MEASUREMENT HIVOLTSTATUSC_B "  CAN4:Running state of vehicle" UBYTE Compur_TXLENGTH_W 1 0 0.000000 255.000000 /begin IF_DATA ASAP1B_CCP KP_BLOB 0xC1FC 0 1 /end IF_DATA BIT_MASK 0xFF /end MEASUREMENT
/begin MEASUREMENT HIVOLTSTATUS_B "  CCSTMFC:Running state of vehicle" UBYTE Compur_TXLENGTH_W 1 0 0.000000 255.000000 /begin IF_DATA ASAP1B_CCP KP_BLOB 0xF994 0 1 /end IF_DATA BIT_MASK 0xFF /end MEASUREMENT
/begin MEASUREMENT HIVOLTSTATUS_B "  CCSTMFC:Running state of vehicle" UBYTE Compur_TXLENGTH_W 1 0 0.000000 255.000000 /begin IF_DATA ASAP1B_CCP KP_BLOB 0xF994 0 1 /end IF_DATA BIT_MASK 0xFF /end MEASUREMENT
/begin MEASUREMENT HFM_W "  INHFM: H2 gas flow meter" UWORD Compur_HFM_W 1 0 0.000000 1999.997130 /begin IF_DATA ASAP1B_CCP KP_BLOB 0xF936 0 2 /end IF_DATA BIT_MASK 0xFFFF /end MEASUREMENT
/begin MEASUREMENT HEATERPOWER_B "  CAN4:Heater comsume Power" UBYTE Compur_WATERPUMPPOWER_B 1 0 0.000000 25.500000 /begin IF_DATA ASAP1B_CCP KP_BLOB 0xC201 0 1 /end IF_DATA BIT_MASK 0xFF /end MEASUREMENT
/begin MEASUREMENT HDSHI_W " NULL  " UWORD Compur_TCV_W 1 0 0.000000 65535.000000 /begin IF_DATA ASAP1B_CCP KP_BLOB 0xFD22 0 2 /end IF_DATA BIT_MASK 0xFFFF /end MEASUREMENT
/begin MEASUREMENT HDS3O_W "  INHDS: low pass filtered value for HDS3" UWORD Compur_HDS3O_W 1 0 0.000000 3.997635 /begin IF_DATA ASAP1B_CCP KP_BLOB 0xFA38 0 2 /end IF_DATA BIT_MASK 0xFFFF /end MEASUREMENT
/begin MEASUREMENT HDS3_W "  INHDS: H2 detect sensor 3 value (16bit)" UWORD Compur_HDS3O_W 1 0 0.000000 3.997635 /begin IF_DATA ASAP1B_CCP KP_BLOB 0xFA66 0 2 /end IF_DATA BIT_MASK 0xFFFF /end MEASUREMENT
/begin MEASUREMENT HDS3_B "  INHDS: H2 detect sensor 3 value (8bit)" UBYTE Compur_HDS3_B 1 0 0.000000 3.984375 /begin IF_DATA ASAP1B_CCP KP_BLOB 0xF8ED 0 1 /end IF_DATA BIT_MASK 0xFF /end MEASUREMENT
/begin MEASUREMENT HDS2O_W "  INHDS: low pass filtered value for HDS2" UWORD Compur_HDS3O_W 1 0 0.000000 3.997635 /begin IF_DATA ASAP1B_CCP KP_BLOB 0xFA3A 0 2 /end IF_DATA BIT_MASK 0xFFFF /end MEASUREMENT
/begin MEASUREMENT HDS2_W "  INHDS: H2 detect sensor 2 value (16bit)" UWORD Compur_HDS3O_W 1 0 0.000000 3.997635 /begin IF_DATA ASAP1B_CCP KP_BLOB 0xF9FE 0 2 /end IF_DATA BIT_MASK 0xFFFF /end MEASUREMENT
/begin MEASUREMENT HDS2_B "  INHDS: H2 detect sensor 2 value (8bit)" UBYTE Compur_HDS3_B 1 0 0.000000 3.984375 /begin IF_DATA ASAP1B_CCP KP_BLOB 0xFA3D 0 1 /end IF_DATA BIT_MASK 0xFF /end MEASUREMENT
/begin MEASUREMENT HDS1O_W "  INHDS: low pass filtered value for HDS1" UWORD Compur_HDS3O_W 1 0 0.000000 3.997635 /begin IF_DATA ASAP1B_CCP KP_BLOB 0xFA14 0 2 /end IF_DATA BIT_MASK 0xFFFF /end MEASUREMENT
/begin MEASUREMENT HDS1_W "  INHDS: H2 detect sensor 1 value (16bit)" UWORD Compur_HDS3O_W 1 0 0.000000 3.997635 /begin IF_DATA ASAP1B_CCP KP_BLOB 0xF894 0 2 /end IF_DATA BIT_MASK 0xFFFF /end MEASUREMENT
/begin MEASUREMENT HDS1_B "  INHDS: H2 detect sensor 1 value (8bit)" UBYTE Compur_HDS3_B 1 0 0.000000 3.984375 /begin IF_DATA ASAP1B_CCP KP_BLOB 0xF8FA 0 1 /end IF_DATA BIT_MASK 0xFF /end MEASUREMENT
/begin MEASUREMENT HDS_W " NULL  " UWORD Compur_TCV_W 1 0 0.000000 65535.000000 /begin IF_DATA ASAP1B_CCP KP_BLOB 0xFD18 0 2 /end IF_DATA BIT_MASK 0xFFFF /end MEASUREMENT
/begin MEASUREMENT H2PRESSURE_W "  CAN4:Anode H2 pressure" UWORD Compur_H2PRESSURE_W 1 0 0.000000 655.350000 /begin IF_DATA ASAP1B_CCP KP_BLOB 0xC828 0 2 /end IF_DATA BIT_MASK 0xFFFF /end MEASUREMENT
/begin MEASUREMENT H2CONSUMEKWHKG_B "  CAN4:Power generation per 1kg of hydrogen" UBYTE Compur_H2CONSUMEKWHKG_B 1 0 0.000000 255.000000 /begin IF_DATA ASAP1B_CCP KP_BLOB 0xDBBD 0 1 /end IF_DATA BIT_MASK 0xFF /end MEASUREMENT
/begin MEASUREMENT H2_CONSUME_L "  CAN4:Cumulative H2 consumption (kg)" ULONG Compur_POWERONHOURS_L 1 0 0.000000 429496729.500000 /begin IF_DATA ASAP1B_CCP KP_BLOB 0xDC06 0 4 /end IF_DATA BIT_MASK 0xFFFFFFFF /end MEASUREMENT
/begin MEASUREMENT GVTAF_W "  infstt: free gas capacity in fuel tank" UWORD Compur_GVTAF_W 1 0 0.000000 1012.515750 /begin IF_DATA ASAP1B_CCP KP_BLOB 0xFA0C 0 2 /end IF_DATA BIT_MASK 0xFFFF /end MEASUREMENT
/begin MEASUREMENT GRSTC_B "  CAN4:TransSelectedGear" UBYTE Compur_TXLENGTH_W 1 0 0.000000 255.000000 /begin IF_DATA ASAP1B_CCP KP_BLOB 0xC234 0 1 /end IF_DATA BIT_MASK 0xFF /end MEASUREMENT
/begin MEASUREMENT FVSC_W "  CAN4:vehicle speed for Tx FCU (12bit)" UWORD Compur_FVSC_W 1 0 0.000000 6553.500000 /begin IF_DATA ASAP1B_CCP KP_BLOB 0xC7F8 0 2 /end IF_DATA BIT_MASK 0xFFFF /end MEASUREMENT
/begin MEASUREMENT FUELLVLO "  ccfstt: old value gas tank fuel level" UBYTE default 1 0 0.000000 255.000000 /begin IF_DATA ASAP1B_CCP KP_BLOB 0xF91C 0 1 /end IF_DATA BIT_MASK 0xFF /end MEASUREMENT
/begin MEASUREMENT FUELLVL "  ccfstt: gas tank fuel level" UBYTE default 1 0 0.000000 255.000000 /begin IF_DATA ASAP1B_CCP KP_BLOB 0xF910 0 1 /end IF_DATA BIT_MASK 0xFF /end MEASUREMENT
/begin MEASUREMENT FTK_W "  INHTTS: Average H2 tank2 Kelvin TEMPERATURE " UWORD Compur_FTK_W 1 0 223.150000 40199.500000 /begin IF_DATA ASAP1B_CCP KP_BLOB 0xFA4A 0 2 /end IF_DATA BIT_MASK 0xFFFF /end MEASUREMENT
/begin MEASUREMENT FTK_MT_W " IRDA: J2799 Mt information" UWORD Compur_FTK_MT_W 1 0 0.000000 6553.500000 /begin IF_DATA ASAP1B_CCP KP_BLOB 0xC7E8 0 2 /end IF_DATA BIT_MASK 0xFFFF /end MEASUREMENT
/begin MEASUREMENT FSTU_W "  infstt: fuel level" UWORD Compur_GVTAF_W 1 0 0.000000 1012.515750 /begin IF_DATA ASAP1B_CCP KP_BLOB 0xF9C0 0 2 /end IF_DATA BIT_MASK 0xFFFF /end MEASUREMENT
/begin MEASUREMENT FSTTVAL1_W "  infstt: valid fuel level" UWORD Compur_GVTAF_W 1 0 0.000000 1012.515750 /begin IF_DATA ASAP1B_CCP KP_BLOB 0xF892 0 2 /end IF_DATA BIT_MASK 0xFFFF /end MEASUREMENT
/begin MEASUREMENT FSTTVAL_W "  infstt: valid fuel level NVRAM type" UWORD Compur_FSTTVAL_W 1 0 0.000000 257.028270 /begin IF_DATA ASAP1B_CCP KP_BLOB 0xDC0C 0 2 /end IF_DATA BIT_MASK 0xFFFF /end MEASUREMENT
/begin MEASUREMENT FSTT_W "  infstt: fuel level" UWORD Compur_GVTAF_W 1 0 0.000000 1012.515750 /begin IF_DATA ASAP1B_CCP KP_BLOB 0xF9FC 0 2 /end IF_DATA BIT_MASK 0xFFFF /end MEASUREMENT
/begin MEASUREMENT FSTT_B "  infstt: fuel level" UBYTE Compur_FSTT_B 1 0 0.000000 1012.605000 /begin IF_DATA ASAP1B_CCP KP_BLOB 0xFA0A 0 1 /end IF_DATA BIT_MASK 0xFF /end MEASUREMENT
/begin MEASUREMENT FSTOF_W "  infstt: unfiltered fule level" UWORD Compur_GVTAF_W 1 0 0.000000 1012.515750 /begin IF_DATA ASAP1B_CCP KP_BLOB 0xF9A6 0 2 /end IF_DATA BIT_MASK 0xFFFF /end MEASUREMENT
/begin MEASUREMENT FSTADF_W "  infstt: differential filtered fuel level" UWORD Compur_GVTAF_W 1 0 0.000000 1012.515750 /begin IF_DATA ASAP1B_CCP KP_BLOB 0xF928 0 2 /end IF_DATA BIT_MASK 0xFFFF /end MEASUREMENT
/begin MEASUREMENT FRZ_NOT_USED "DFPM:" UBYTE default 1 0 0.000000 255.000000 /begin IF_DATA ASAP1B_CCP KP_BLOB 0xDC0F 0 1 /end IF_DATA BIT_MASK 0xFF /end MEASUREMENT
/begin MEASUREMENT FPLO_W "  INHMPS: low pass filtered value for fpl" UWORD Compur_RPSSCTO_W 1 0 0.000000 3139.978455 /begin IF_DATA ASAP1B_CCP KP_BLOB 0xF9BC 0 2 /end IF_DATA BIT_MASK 0xFFFF /end MEASUREMENT
/begin MEASUREMENT FPL "  INHMPS: gas pressure low (8bit)" UBYTE Compur_FPL 1 0 0.000000 3127.734375 /begin IF_DATA ASAP1B_CCP KP_BLOB 0xF8B9 0 1 /end IF_DATA BIT_MASK 0xFF /end MEASUREMENT
/begin MEASUREMENT FPL_W "  INHMPS: gas pressure low" UWORD Compur_RPSSCTO_W 1 0 0.000000 3139.978455 /begin IF_DATA ASAP1B_CCP KP_BLOB 0xFA44 0 2 /end IF_DATA BIT_MASK 0xFFFF /end MEASUREMENT
/begin MEASUREMENT FPHO_W "  INHHPS: low pass filtered value for fph" UWORD Compur_FPHO_W 1 0 0.000000 89.979555 /begin IF_DATA ASAP1B_CCP KP_BLOB 0xF9B4 0 2 /end IF_DATA BIT_MASK 0xFFFF /end MEASUREMENT
/begin MEASUREMENT FPH "  INHHPS: gas pressure high (8bit)" UBYTE Compur_FPH 1 0 0.000000 89.648565 /begin IF_DATA ASAP1B_CCP KP_BLOB 0xF8C4 0 1 /end IF_DATA BIT_MASK 0xFF /end MEASUREMENT
/begin MEASUREMENT FPH_W "  INHHPS: gas pressure high" UWORD Compur_FPHO_W 1 0 0.000000 89.979555 /begin IF_DATA ASAP1B_CCP KP_BLOB 0xFA00 0 2 /end IF_DATA BIT_MASK 0xFFFF /end MEASUREMENT
/begin MEASUREMENT FPH_MP_W " IRDA: J2799 MP information" UWORD Compur_FPH_MP_W 1 0 0.000000 6553.500000 /begin IF_DATA ASAP1B_CCP KP_BLOB 0xC802 0 2 /end IF_DATA BIT_MASK 0xFFFF /end MEASUREMENT
/begin MEASUREMENT FLVLF_B "  ccfstt: filtered fuel level" UBYTE Compur_RGVTAF_B 1 0 0.000000 127.500000 /begin IF_DATA ASAP1B_CCP KP_BLOB 0xF92F 0 1 /end IF_DATA BIT_MASK 0xFF /end MEASUREMENT
/begin MEASUREMENT FLVL_B "  ccfstt: fuel level" UBYTE Compur_RGVTAF_B 1 0 0.000000 127.500000 /begin IF_DATA ASAP1B_CCP KP_BLOB 0xF981 0 1 /end IF_DATA BIT_MASK 0xFF /end MEASUREMENT
/begin MEASUREMENT FG2TSK "  TSK16..23 ACTIVATION" UBYTE default 1 0 0.000000 255.000000 /begin IF_DATA ASAP1B_CCP KP_BLOB 0xF902 0 1 /end IF_DATA BIT_MASK 0xFF /end MEASUREMENT
/begin MEASUREMENT FG1TSK "  TSK08..15 ACTIVATION" UBYTE default 1 0 0.000000 255.000000 /begin IF_DATA ASAP1B_CCP KP_BLOB 0xF8F6 0 1 /end IF_DATA BIT_MASK 0xFF /end MEASUREMENT
/begin MEASUREMENT FG0TSK "  TSK07..00 ACTIVATION" UBYTE default 1 0 0.000000 255.000000 /begin IF_DATA ASAP1B_CCP KP_BLOB 0xF908 0 1 /end IF_DATA BIT_MASK 0xFF /end MEASUREMENT
/begin MEASUREMENT FCWTOUT_B "  CAN4:fuel cell stack coolant outle temperature" UBYTE Compur_FCWTOUT_B 1 0 -40.000000 215.000000 /begin IF_DATA ASAP1B_CCP KP_BLOB 0xC1F8 0 1 /end IF_DATA BIT_MASK 0xFF /end MEASUREMENT
/begin MEASUREMENT FCWTIN_B "  CAN4:fuel cell stack coolant inlet temperature" UBYTE Compur_FCWTOUT_B 1 0 -40.000000 215.000000 /begin IF_DATA ASAP1B_CCP KP_BLOB 0xC218 0 1 /end IF_DATA BIT_MASK 0xFF /end MEASUREMENT
/begin MEASUREMENT FCVOLT_W "  CAN4:fuel cell system output Voltage" UWORD Compur_POWERONHOURS_L 1 0 0.000000 6553.500000 /begin IF_DATA ASAP1B_CCP KP_BLOB 0xC808 0 2 /end IF_DATA BIT_MASK 0xFFFF /end MEASUREMENT
/begin MEASUREMENT FCUVOLTAGE_W "  CAN4:controller power supply voltage" UWORD Compur_POWERONHOURS_L 1 0 0.000000 6553.500000 /begin IF_DATA ASAP1B_CCP KP_BLOB 0xC80E 0 2 /end IF_DATA BIT_MASK 0xFFFF /end MEASUREMENT
/begin MEASUREMENT FCSWV_W "  CAN4:FCU Software version number" UWORD Compur_POWERONHOURS_L 1 0 0.000000 6553.500000 /begin IF_DATA ASAP1B_CCP KP_BLOB 0xDC04 0 2 /end IF_DATA BIT_MASK 0xFFFF /end MEASUREMENT
/begin MEASUREMENT FCSTAT_B "  CCSTMFC: state machine state number of fuel cell" UBYTE default 1 0 0.000000 255.000000 /begin IF_DATA ASAP1B_CCP KP_BLOB 0xF99D 0 1 /end IF_DATA BIT_MASK 0xFF /end MEASUREMENT
/begin MEASUREMENT FCSSTRTTM_W "  CCSTMFC: state machine control time step in STARTING" UWORD default 1 0 0.000000 65535.000000 /begin IF_DATA ASAP1B_CCP KP_BLOB 0xF96C 0 2 /end IF_DATA BIT_MASK 0xFFFF /end MEASUREMENT
/begin MEASUREMENT FCSSTBYTM_W "  CCSTMFC: state machine control time step in STANDBY" UWORD default 1 0 0.000000 65535.000000 /begin IF_DATA ASAP1B_CCP KP_BLOB 0xF968 0 2 /end IF_DATA BIT_MASK 0xFFFF /end MEASUREMENT
/begin MEASUREMENT FCSSHUTDNTM_W "  CCSTMFC: state machine control time step in SHUTINGDOWN" UWORD default 1 0 0.000000 65535.000000 /begin IF_DATA ASAP1B_CCP KP_BLOB 0xFA1A 0 2 /end IF_DATA BIT_MASK 0xFFFF /end MEASUREMENT
/begin MEASUREMENT FCSRUNTM_W "  CCSTMFC: state machine control time step in RUNNING" UWORD default 1 0 0.000000 65535.000000 /begin IF_DATA ASAP1B_CCP KP_BLOB 0xF95A 0 2 /end IF_DATA BIT_MASK 0xFFFF /end MEASUREMENT
/begin MEASUREMENT FCSNOTRDYTM_W "  CCSTMFC: state machine control time step in NotReady" UWORD default 1 0 0.000000 65535.000000 /begin IF_DATA ASAP1B_CCP KP_BLOB 0xF9AC 0 2 /end IF_DATA BIT_MASK 0xFFFF /end MEASUREMENT
/begin MEASUREMENT FCSN_L "  CAN4:Fuel cell stack number" ULONG Compur_POWERONHOURS_L 1 0 0.000000 429496729.500000 /begin IF_DATA ASAP1B_CCP KP_BLOB 0xDBC0 0 4 /end IF_DATA BIT_MASK 0xFFFFFFFF /end MEASUREMENT
/begin MEASUREMENT FCSLOADTM_W "  CCSTMFC: state machine control time step in LOADING" UWORD default 1 0 0.000000 65535.000000 /begin IF_DATA ASAP1B_CCP KP_BLOB 0xF8B0 0 2 /end IF_DATA BIT_MASK 0xFFFF /end MEASUREMENT
/begin MEASUREMENT FCSFAULTTM_W "  CCSTMFC: state machine control time step in FAULT" UWORD default 1 0 0.000000 65535.000000 /begin IF_DATA ASAP1B_CCP KP_BLOB 0xF95E 0 2 /end IF_DATA BIT_MASK 0xFFFF /end MEASUREMENT
/begin MEASUREMENT FCSEMSHUTDNTM_W "  CCSTMFC: state machine control time step in EMERGENCYSHUTDOWN" UWORD default 1 0 0.000000 65535.000000 /begin IF_DATA ASAP1B_CCP KP_BLOB 0xF9E6 0 2 /end IF_DATA BIT_MASK 0xFFFF /end MEASUREMENT
/begin MEASUREMENT FCSCTRLTM_W "  CCSTMFC: state machine control time step" UWORD default 1 0 0.000000 65535.000000 /begin IF_DATA ASAP1B_CCP KP_BLOB 0xFA10 0 2 /end IF_DATA BIT_MASK 0xFFFF /end MEASUREMENT
/begin MEASUREMENT FCSCHARGTM_W "  CCSTMFC: state machine control time step in CHARGING" UWORD default 1 0 0.000000 65535.000000 /begin IF_DATA ASAP1B_CCP KP_BLOB 0xF9A0 0 2 /end IF_DATA BIT_MASK 0xFFFF /end MEASUREMENT
/begin MEASUREMENT FCS_W " IRDA: J2799 FCS CRC" UWORD default 1 0 0.000000 65535.000000 /begin IF_DATA ASAP1B_CCP KP_BLOB 0xC7FA 0 2 /end IF_DATA BIT_MASK 0xFFFF /end MEASUREMENT
/begin MEASUREMENT FCPHASE_B "  CAN4:Working state of fuel cell system" UBYTE Compur_TXLENGTH_W 1 0 0.000000 255.000000 /begin IF_DATA ASAP1B_CCP KP_BLOB 0xC1EB 0 1 /end IF_DATA BIT_MASK 0xFF /end MEASUREMENT
/begin MEASUREMENT FCOUTPOWER_W "  CAN4:fuel cell system output power" UWORD Compur_WATERPUMPPOWER_B 1 0 0.000000 6553.500000 /begin IF_DATA ASAP1B_CCP KP_BLOB 0xC7F6 0 2 /end IF_DATA BIT_MASK 0xFFFF /end MEASUREMENT
/begin MEASUREMENT FCONOFFCTRLC_B "  CAN4:Fuel cell start signal" UBYTE Compur_TXLENGTH_W 1 0 0.000000 255.000000 /begin IF_DATA ASAP1B_CCP KP_BLOB 0xC229 0 1 /end IF_DATA BIT_MASK 0xFF /end MEASUREMENT
/begin MEASUREMENT FCONOFFCTRL_B "  CCSTMFC:Fuel cell start signal" UBYTE Compur_TXLENGTH_W 1 0 0.000000 255.000000 /begin IF_DATA ASAP1B_CCP KP_BLOB 0xF899 0 1 /end IF_DATA BIT_MASK 0xFF /end MEASUREMENT
/begin MEASUREMENT FCONOFFCTRL_B "  CCSTMFC:Fuel cell start signal" UBYTE Compur_TXLENGTH_W 1 0 0.000000 255.000000 /begin IF_DATA ASAP1B_CCP KP_BLOB 0xF899 0 1 /end IF_DATA BIT_MASK 0xFF /end MEASUREMENT
/begin MEASUREMENT FCMOVERFLOW "DFPM:FAULT CODE COUNTER" UBYTE default 1 0 0.000000 255.000000 /begin IF_DATA ASAP1B_CCP KP_BLOB 0xDC0A 0 1 /end IF_DATA BIT_MASK 0xFF /end MEASUREMENT
/begin MEASUREMENT FCMEND "DFPM: FCM end pointer" UBYTE default 1 0 0.000000 255.000000 /begin IF_DATA ASAP1B_CCP KP_BLOB 0xDBC4 0 1 /end IF_DATA BIT_MASK 0xFF /end MEASUREMENT
/begin MEASUREMENT FCLIFO_B "  MRFCAUS: old value of FCU heart beat" UBYTE Compur_TXLENGTH_W 1 0 0.000000 255.000000 /begin IF_DATA ASAP1B_CCP KP_BLOB 0xC236 0 1 /end IF_DATA BIT_MASK 0xFF /end MEASUREMENT
/begin MEASUREMENT FCLIFECTR_B "  MRFCAUS: Check FCU Life" UBYTE Compur_TXLENGTH_W 1 0 0.000000 255.000000 /begin IF_DATA ASAP1B_CCP KP_BLOB 0xC21D 0 1 /end IF_DATA BIT_MASK 0xFF /end MEASUREMENT
/begin MEASUREMENT FCLIFE_B "  CAN4:heart beat" UBYTE Compur_TXLENGTH_W 1 0 0.000000 255.000000 /begin IF_DATA ASAP1B_CCP KP_BLOB 0xC192 0 1 /end IF_DATA BIT_MASK 0xFF /end MEASUREMENT
/begin MEASUREMENT FCINTERCOOLEROUTTEMP_B "  CAN4:Air outlet temperature of intercooler" UBYTE Compur_FCWTOUT_B 1 0 -40.000000 215.000000 /begin IF_DATA ASAP1B_CCP KP_BLOB 0xC20D 0 1 /end IF_DATA BIT_MASK 0xFF /end MEASUREMENT
/begin MEASUREMENT FCERRORGRADE_B "  CAN4:Fuel cell system error code class" UBYTE Compur_TXLENGTH_W 1 0 0.000000 255.000000 /begin IF_DATA ASAP1B_CCP KP_BLOB 0xC18F 0 1 /end IF_DATA BIT_MASK 0xFF /end MEASUREMENT
/begin MEASUREMENT FCERRORCODE_W "  CAN4:FCU Error code" UWORD Compur_TXLENGTH_W 1 0 0.000000 65535.000000 /begin IF_DATA ASAP1B_CCP KP_BLOB 0xC82E 0 2 /end IF_DATA BIT_MASK 0xFFFF /end MEASUREMENT
/begin MEASUREMENT FCEMERGSDC_B "  CAN4:Fuel cell emergency stop signal" UBYTE Compur_TXLENGTH_W 1 0 0.000000 255.000000 /begin IF_DATA ASAP1B_CCP KP_BLOB 0xC1E1 0 1 /end IF_DATA BIT_MASK 0xFF /end MEASUREMENT
/begin MEASUREMENT FCEMERGSD_B "  CCSTMFC:Fuel cell emergency stop signal" UBYTE Compur_TXLENGTH_W 1 0 0.000000 255.000000 /begin IF_DATA ASAP1B_CCP KP_BLOB 0xFA42 0 1 /end IF_DATA BIT_MASK 0xFF /end MEASUREMENT
/begin MEASUREMENT FCEMERGSD_B "  CCSTMFC:Fuel cell emergency stop signal" UBYTE Compur_TXLENGTH_W 1 0 0.000000 255.000000 /begin IF_DATA ASAP1B_CCP KP_BLOB 0xFA42 0 1 /end IF_DATA BIT_MASK 0xFF /end MEASUREMENT
/begin MEASUREMENT FCATOUT_B "  CAN4:Fuel cell stack air outlet temperature" UBYTE Compur_FCWTOUT_B 1 0 -40.000000 215.000000 /begin IF_DATA ASAP1B_CCP KP_BLOB 0xC1B3 0 1 /end IF_DATA BIT_MASK 0xFF /end MEASUREMENT
/begin MEASUREMENT FCATIN_B "  CAN4:Air inlet temperature" UBYTE Compur_FCWTOUT_B 1 0 -40.000000 215.000000 /begin IF_DATA ASAP1B_CCP KP_BLOB 0xC18E 0 1 /end IF_DATA BIT_MASK 0xFF /end MEASUREMENT
/begin MEASUREMENT FCAMPCMAX_W "  CAN4:Max allowable charging current" UWORD Compur_HVSETCURRC_W 1 0 0.000000 6553.500000 /begin IF_DATA ASAP1B_CCP KP_BLOB 0xC7F2 0 2 /end IF_DATA BIT_MASK 0xFFFF /end MEASUREMENT
/begin MEASUREMENT FCAMP_W "  CAN4:fuel cell system output current" UWORD Compur_HVSETCURRC_W 1 0 0.000000 6553.500000 /begin IF_DATA ASAP1B_CCP KP_BLOB 0xC814 0 2 /end IF_DATA BIT_MASK 0xFFFF /end MEASUREMENT
/begin MEASUREMENT FCALLOWEDPOWER_W "  CAN4:Maximum output power is allowed" UWORD Compur_WATERPUMPPOWER_B 1 0 0.000000 6553.500000 /begin IF_DATA ASAP1B_CCP KP_BLOB 0xC82C 0 2 /end IF_DATA BIT_MASK 0xFFFF /end MEASUREMENT
/begin MEASUREMENT FC_TPTNBR_B "  CAN4:Total number of fuel cell temperature probes" UBYTE Compur_TXLENGTH_W 1 0 0.000000 255.000000 /begin IF_DATA ASAP1B_CCP KP_BLOB 0xDBBE 0 1 /end IF_DATA BIT_MASK 0xFF /end MEASUREMENT
/begin MEASUREMENT FC_STARTTIMES_W "  CAN4:FCU System startup times" UWORD Compur_POWERONHOURS_L 1 0 0.000000 6553.500000 /begin IF_DATA ASAP1B_CCP KP_BLOB 0xDBCC 0 2 /end IF_DATA BIT_MASK 0xFFFF /end MEASUREMENT
/begin MEASUREMENT FC_RUNHOURS_L "  CAN4:System cumulative running time(h)" ULONG Compur_POWERONHOURS_L 1 0 0.000000 429496729.500000 /begin IF_DATA ASAP1B_CCP KP_BLOB 0xDC1A 0 4 /end IF_DATA BIT_MASK 0xFFFFFFFF /end MEASUREMENT
/begin MEASUREMENT FC_OUTPUT_KWH_L "  CAN4:fuel cell stack cumulative power generation(kwh)" ULONG Compur_POWERONHOURS_L 1 0 0.000000 429496729.500000 /begin IF_DATA ASAP1B_CCP KP_BLOB 0xDBC8 0 4 /end IF_DATA BIT_MASK 0xFFFFFFFF /end MEASUREMENT
/begin MEASUREMENT EVPHASE_W " NULL  " UWORD Compur_TCV_W 1 0 0.000000 65535.000000 /begin IF_DATA ASAP1B_CCP KP_BLOB 0xFD1A 0 2 /end IF_DATA BIT_MASK 0xFFFF /end MEASUREMENT
/begin MEASUREMENT EVOLC_W "  CAN4:Li Battery voltage" UWORD Compur_EVOLC_W 1 0 0.000000 3276.750000 /begin IF_DATA ASAP1B_CCP KP_BLOB 0xF916 0 2 /end IF_DATA BIT_MASK 0xFFFF /end MEASUREMENT
/begin MEASUREMENT ETSLIN_B "  INETS: Evaporator temperature. Linearized and calculated." UBYTE Compur_RTSSCTLIN_B 1 0 -50.000000 105.550000 /begin IF_DATA ASAP1B_CCP KP_BLOB 0xF9BA 0 1 /end IF_DATA BIT_MASK 0xFF /end MEASUREMENT
/begin MEASUREMENT ET_B "  INETS: Evaporator temperature. Linearized and calculated." UBYTE Compur_RTSSCTLIN_B 1 0 -50.000000 105.550000 /begin IF_DATA ASAP1B_CCP KP_BLOB 0xF93A 0 1 /end IF_DATA BIT_MASK 0xFF /end MEASUREMENT
/begin MEASUREMENT ESOCC_W "  CAN4:Li Battery SOC" UWORD Compur_ESOCC_W 1 0 0.000000 102.431205 /begin IF_DATA ASAP1B_CCP KP_BLOB 0xFA5A 0 2 /end IF_DATA BIT_MASK 0xFFFF /end MEASUREMENT
/begin MEASUREMENT ENGINEFCRR_CNT_OLD "TGRDI: engine failure counter old" UBYTE default 1 0 0.000000 255.000000 /begin IF_DATA ASAP1B_CCP KP_BLOB 0xDC14 0 1 /end IF_DATA BIT_MASK 0xFF /end MEASUREMENT
/begin MEASUREMENT ENGINEFAILURECODE_BITS "TGRDI: engine failure bits" UBYTE default 1 0 0.000000 255.000000 /begin IF_DATA ASAP1B_CCP KP_BLOB 0xDBCF 0 1 /end IF_DATA BIT_MASK 0xFF /end MEASUREMENT
/begin MEASUREMENT EDAMPC_W "  CAN4:Discharge current limit" UWORD Compur_EDAMPC_W 1 0 -80.000000 3196.750000 /begin IF_DATA ASAP1B_CCP KP_BLOB 0xF8C6 0 2 /end IF_DATA BIT_MASK 0xFFFF /end MEASUREMENT
/begin MEASUREMENT ECAMPC_W "  CAN4:Charge current limit" UWORD Compur_ECAMPC_W 1 0 80.000000 3356.750000 /begin IF_DATA ASAP1B_CCP KP_BLOB 0xFA68 0 2 /end IF_DATA BIT_MASK 0xFFFF /end MEASUREMENT
/begin MEASUREMENT EAMPC_W "  CAN4:Li Battery current" UWORD Compur_EDAMPC_W 1 0 -80.000000 3196.750000 /begin IF_DATA ASAP1B_CCP KP_BLOB 0xFA5E 0 2 /end IF_DATA BIT_MASK 0xFFFF /end MEASUREMENT
/begin MEASUREMENT DNMOTAS_W "  %ccng: engine speed difference during one working cycle" SWORD Compur_NMOTRSP_W[5] 1 0 -8192.000000 8191.750000 /begin IF_DATA ASAP1B_CCP KP_BLOB 0xF97E 0 2 /end IF_DATA BIT_MASK 0xFFFF /end MEASUREMENT
/begin MEASUREMENT DNMOT_W "  %ccng: engine speed difference between two following segments" SWORD Compur_NMOTRSP_W[5] 1 0 -8192.000000 8191.750000 /begin IF_DATA ASAP1B_CCP KP_BLOB 0xF958 0 2 /end IF_DATA BIT_MASK 0xFFFF /end MEASUREMENT
/begin MEASUREMENT DMOTRQC_B "  CAN4:Demand motor torque" UBYTE Compur_DMOTRQC_B 1 0 -125.000000 130.000000 /begin IF_DATA ASAP1B_CCP KP_BLOB 0xF984 0 1 /end IF_DATA BIT_MASK 0xFF /end MEASUREMENT
/begin MEASUREMENT DISPSTATE_B " ASC1DAT: Display H2 State number" UBYTE Compur_TXLENGTH_W 1 0 0.000000 255.000000 /begin IF_DATA ASAP1B_CCP KP_BLOB 0xC2BE 0 1 /end IF_DATA BIT_MASK 0xFF /end MEASUREMENT
/begin MEASUREMENT DISPFCSTATE_B " ASC1DAT: Display FC State number" UBYTE Compur_TXLENGTH_W 1 0 0.000000 255.000000 /begin IF_DATA ASAP1B_CCP KP_BLOB 0xC2BF 0 1 /end IF_DATA BIT_MASK 0xFF /end MEASUREMENT
/begin MEASUREMENT DFPMSVS " DSVS: control service vehicle soon - Lamp according to stored faults off/on/blinking" UBYTE default 1 0 0.000000 255.000000 /begin IF_DATA ASAP1B_CCP KP_BLOB 0xC131 0 1 /end IF_DATA BIT_MASK 0xFF /end MEASUREMENT
/begin MEASUREMENT DFP_AP "DFPM: Actual Failre for message" UBYTE default 1 0 0.000000 255.000000 /begin IF_DATA ASAP1B_CCP KP_BLOB 0xDBC5 0 1 /end IF_DATA BIT_MASK 0xFF /end MEASUREMENT
/begin MEASUREMENT DFCMSFP "DFPM: Data for check routine" UBYTE default 1 0 0.000000 255.000000 /begin IF_DATA ASAP1B_CCP KP_BLOB 0xDC0B 0 1 /end IF_DATA BIT_MASK 0xFF /end MEASUREMENT
/begin MEASUREMENT DFCMNO "DFPM: Data for check routine" UBYTE default 1 0 0.000000 255.000000 /begin IF_DATA ASAP1B_CCP KP_BLOB 0xDBD1 0 1 /end IF_DATA BIT_MASK 0xFF /end MEASUREMENT
/begin MEASUREMENT DFCMFCM "DFPM: Data for check routine" UBYTE default 1 0 0.000000 255.000000 /begin IF_DATA ASAP1B_CCP KP_BLOB 0xDBD0 0 1 /end IF_DATA BIT_MASK 0xFF /end MEASUREMENT
/begin MEASUREMENT DEBUG3_B "No Comment" UBYTE default 1 0 0.000000 255.000000 /begin IF_DATA ASAP1B_CCP KP_BLOB 0xF8BA 0 1 /end IF_DATA BIT_MASK 0xFF /end MEASUREMENT
/begin MEASUREMENT DEBUG2_B "No Comment" UBYTE default 1 0 0.000000 255.000000 /begin IF_DATA ASAP1B_CCP KP_BLOB 0xFA2A 0 1 /end IF_DATA BIT_MASK 0xFF /end MEASUREMENT
/begin MEASUREMENT DEBUG1_B "No Comment" UBYTE default 1 0 0.000000 255.000000 /begin IF_DATA ASAP1B_CCP KP_BLOB 0xF9AB 0 1 /end IF_DATA BIT_MASK 0xFF /end MEASUREMENT
/begin MEASUREMENT DEBUG0_B "No Comment" UBYTE default 1 0 0.000000 255.000000 /begin IF_DATA ASAP1B_CCP KP_BLOB 0xF948 0 1 /end IF_DATA BIT_MASK 0xFF /end MEASUREMENT
/begin MEASUREMENT DCDCTEMP_B "  CAN4:booster DC/DC temperature" UBYTE Compur_FCWTOUT_B 1 0 -40.000000 215.000000 /begin IF_DATA ASAP1B_CCP KP_BLOB 0xC204 0 1 /end IF_DATA BIT_MASK 0xFF /end MEASUREMENT
/begin MEASUREMENT DCDCOUTVOLT_W "  CAN4:Boost DC/DC output Voltage" UWORD Compur_POWERONHOURS_L 1 0 0.000000 6553.500000 /begin IF_DATA ASAP1B_CCP KP_BLOB 0xC81A 0 2 /end IF_DATA BIT_MASK 0xFFFF /end MEASUREMENT
/begin MEASUREMENT DCDCOUTPUTC_W "  CAN4:DCDC output current" UWORD Compur_HVSETCURRC_W 1 0 0.000000 6553.500000 /begin IF_DATA ASAP1B_CCP KP_BLOB 0xC826 0 2 /end IF_DATA BIT_MASK 0xFFFF /end MEASUREMENT
/begin MEASUREMENT DCDCOUTPOWER_W "  CAN4:Boost DC/DC output power" UWORD Compur_WATERPUMPPOWER_B 1 0 0.000000 6553.500000 /begin IF_DATA ASAP1B_CCP KP_BLOB 0xC80A 0 2 /end IF_DATA BIT_MASK 0xFFFF /end MEASUREMENT
/begin MEASUREMENT DCDCOUTAMP_W "  CAN4:Boost DC/DC output current" UWORD Compur_HVSETCURRC_W 1 0 0.000000 6553.500000 /begin IF_DATA ASAP1B_CCP KP_BLOB 0xC836 0 2 /end IF_DATA BIT_MASK 0xFFFF /end MEASUREMENT
/begin MEASUREMENT DCDC_OUTPUT_KWH_L "  CAN4:Boost DC/DC cumulative power generation(kWh)" ULONG Compur_POWERONHOURS_L 1 0 0.000000 429496729.500000 /begin IF_DATA ASAP1B_CCP KP_BLOB 0xDC10 0 4 /end IF_DATA BIT_MASK 0xFFFFFFFF /end MEASUREMENT
/begin MEASUREMENT CWTSPELIN_B "  INCWTS: PE coolant temperature. Linearized and calculated." UBYTE Compur_RTSSCTLIN_B 1 0 -50.000000 105.550000 /begin IF_DATA ASAP1B_CCP KP_BLOB 0xFA2C 0 1 /end IF_DATA BIT_MASK 0xFF /end MEASUREMENT
/begin MEASUREMENT CWTSBATLIN_B "  INCWTS: Battery coolant temperature. Linearized and calculated." UBYTE Compur_RTSSCTLIN_B 1 0 -50.000000 105.550000 /begin IF_DATA ASAP1B_CCP KP_BLOB 0xF9B0 0 1 /end IF_DATA BIT_MASK 0xFF /end MEASUREMENT
/begin MEASUREMENT CWTPE_B "  INCWTS: PE coolant temperature. Linearized and calculated." UBYTE Compur_RTSSCTLIN_B 1 0 -50.000000 105.550000 /begin IF_DATA ASAP1B_CCP KP_BLOB 0xF9E4 0 1 /end IF_DATA BIT_MASK 0xFF /end MEASUREMENT
/begin MEASUREMENT CWTBAT_B "  INCWTS: Battery coolant temperature. Linearized and calculated." UBYTE Compur_RTSSCTLIN_B 1 0 -50.000000 105.550000 /begin IF_DATA ASAP1B_CCP KP_BLOB 0xF8B4 0 1 /end IF_DATA BIT_MASK 0xFF /end MEASUREMENT
/begin MEASUREMENT CW_OBD " PROCON:" UBYTE default 1 0 0.000000 255.000000 /begin IF_DATA ASAP1B_CCP KP_BLOB 0xF9D0 0 1 /end IF_DATA BIT_MASK 0xFF /end MEASUREMENT
/begin MEASUREMENT CW_ERFIL " PROCON:" UBYTE default 1 0 0.000000 255.000000 /begin IF_DATA ASAP1B_CCP KP_BLOB 0xF9F2 0 1 /end IF_DATA BIT_MASK 0xFF /end MEASUREMENT
/begin MEASUREMENT CTRLPGSWON_B "  INFCSW: counter for term-in push switch on" UBYTE Compur_CTRLPGSWON_B 1 0 0.000000 8.160000 /begin IF_DATA ASAP1B_CCP KP_BLOB 0xFA46 0 1 /end IF_DATA BIT_MASK 0xFF /end MEASUREMENT
/begin MEASUREMENT CTREOLTEST_B "inlpgsw: Counter for number of EOL SW off task." UBYTE default 1 0 0.000000 255.000000 /begin IF_DATA ASAP1B_CCP KP_BLOB 0xDBBC 0 1 /end IF_DATA BIT_MASK 0xFF /end MEASUREMENT
/begin MEASUREMENT CTRENGSTL_B "  engstall: tooth counter threshold" UBYTE default 1 0 0.000000 255.000000 /begin IF_DATA ASAP1B_CCP KP_BLOB 0xFA4E 0 1 /end IF_DATA BIT_MASK 0xFF /end MEASUREMENT
/begin MEASUREMENT CTR8MS "  scheduler counter for 8mses" UBYTE default 1 0 0.000000 255.000000 /begin IF_DATA ASAP1B_CCP KP_BLOB 0xF972 0 1 /end IF_DATA BIT_MASK 0xFF /end MEASUREMENT
/begin MEASUREMENT CTR64MS "  scheduler counter for 64msec" UBYTE default 1 0 0.000000 255.000000 /begin IF_DATA ASAP1B_CCP KP_BLOB 0xF998 0 1 /end IF_DATA BIT_MASK 0xFF /end MEASUREMENT
/begin MEASUREMENT CTR512MS "  scheduler counter for 512msec" UBYTE default 1 0 0.000000 255.000000 /begin IF_DATA ASAP1B_CCP KP_BLOB 0xF926 0 1 /end IF_DATA BIT_MASK 0xFF /end MEASUREMENT
/begin MEASUREMENT CTR128MS "  scheduler counter for 128msec" UBYTE default 1 0 0.000000 255.000000 /begin IF_DATA ASAP1B_CCP KP_BLOB 0xF93B 0 1 /end IF_DATA BIT_MASK 0xFF /end MEASUREMENT
/begin MEASUREMENT CTR1024MS "  scheduler counter for 1024msec" UBYTE default 1 0 0.000000 255.000000 /begin IF_DATA ASAP1B_CCP KP_BLOB 0xF8EB 0 1 /end IF_DATA BIT_MASK 0xFF /end MEASUREMENT
/begin MEASUREMENT CPSTIME_W "  inph: capture of interrupt event time" UWORD Compur_VSSTIME_W 1 0 0.000000 4194240.000000 /begin IF_DATA ASAP1B_CCP KP_BLOB 0xF97C 0 2 /end IF_DATA BIT_MASK 0xFFFF /end MEASUREMENT
/begin MEASUREMENT CNTTTHO "  inph: TOOTH COUNTER AT TDC BASE old" UBYTE default 1 0 0.000000 255.000000 /begin IF_DATA ASAP1B_CCP KP_BLOB 0xF8EA 0 1 /end IF_DATA BIT_MASK 0xFF /end MEASUREMENT
/begin MEASUREMENT CNTTTH "  inph: TOOTH COUNTER AT TDC BASE" UBYTE default 1 0 0.000000 255.000000 /begin IF_DATA ASAP1B_CCP KP_BLOB 0xF961 0 1 /end IF_DATA BIT_MASK 0xFF /end MEASUREMENT
/begin MEASUREMENT CNTHTR "  BACKGROUND MONITOR COUNTER" UBYTE default 1 0 0.000000 255.000000 /begin IF_DATA ASAP1B_CCP KP_BLOB 0xF9AA 0 1 /end IF_DATA BIT_MASK 0xFF /end MEASUREMENT
/begin MEASUREMENT CMPERIOD_W "  inph: old time capture of interrupt event time" UWORD Compur_VSSTIME_W 1 0 0.000000 4194240.000000 /begin IF_DATA ASAP1B_CCP KP_BLOB 0xF8FC 0 2 /end IF_DATA BIT_MASK 0xFFFF /end MEASUREMENT
/begin MEASUREMENT CAMPRD_W "  inph: cam edge period time (1 revolution)" UWORD Compur_VSSTIME_W 1 0 0.000000 4194240.000000 /begin IF_DATA ASAP1B_CCP KP_BLOB 0xF9AE 0 2 /end IF_DATA BIT_MASK 0xFFFF /end MEASUREMENT
/begin MEASUREMENT BUFFEREDRAM_END " No Comment" UWORD default 1 0 0.000000 65535.000000 /begin IF_DATA ASAP1B_CCP KP_BLOB 0xDFFA 0 2 /end IF_DATA BIT_MASK 0xFFFF /end MEASUREMENT
/begin MEASUREMENT BUFFEREDRAM_CHECKBEGIN " No Comment" UWORD default 1 0 0.000000 65535.000000 /begin IF_DATA ASAP1B_CCP KP_BLOB 0xDB00 0 2 /end IF_DATA BIT_MASK 0xFFFF /end MEASUREMENT
/begin MEASUREMENT BRAKETIME_W "  Brake pedal on time" UWORD Compur_BRAKETIME_W 1 0 0.000000 8191.875000 /begin IF_DATA ASAP1B_CCP KP_BLOB 0xF99E 0 2 /end IF_DATA BIT_MASK 0xFFFF /end MEASUREMENT
/begin MEASUREMENT BBSP3 "DFPM: Trigger for DFPM" UBYTE default 1 0 0.000000 255.000000 /begin IF_DATA ASAP1B_CCP KP_BLOB 0xDBCE 0 1 /end IF_DATA BIT_MASK 0xFF /end MEASUREMENT
/begin MEASUREMENT BBNO "DFPM: Trigger for DFPM" UBYTE default 1 0 0.000000 255.000000 /begin IF_DATA ASAP1B_CCP KP_BLOB 0xDC0E 0 1 /end IF_DATA BIT_MASK 0xFF /end MEASUREMENT
/begin MEASUREMENT BATSQ " InBV: battery voltage converted to standard quantization (8bit)." UBYTE Compur_BATSQ 1 0 0.000000 47.999925 /begin IF_DATA ASAP1B_CCP KP_BLOB 0xF9FA 0 1 /end IF_DATA BIT_MASK 0xFF /end MEASUREMENT
/begin MEASUREMENT BATSQ_W " InBV: battery voltage converted to standard quantization." UWORD Compur_BATSQ_W 1 0 0.000000 47.971620 /begin IF_DATA ASAP1B_CCP KP_BLOB 0xF8F0 0 2 /end IF_DATA BIT_MASK 0xFFFF /end MEASUREMENT
/begin MEASUREMENT BAT " InBV: battery voltage (8bit)" UBYTE Compur_VBR 1 0 0.000000 32.423505 /begin IF_DATA ASAP1B_CCP KP_BLOB 0xF911 0 1 /end IF_DATA BIT_MASK 0xFF /end MEASUREMENT
/begin MEASUREMENT BASETIME5000MS "  CAN4:base time counter for 5sec raster" UWORD Compur_TXLENGTH_W 1 0 0.000000 65535.000000 /begin IF_DATA ASAP1B_CCP KP_BLOB 0xF946 0 2 /end IF_DATA BIT_MASK 0xFFFF /end MEASUREMENT
/begin MEASUREMENT ATSLIN_B "  INATS: Ambient temperature. Linearized and calculated." UBYTE Compur_RTSSCTLIN_B 1 0 -50.000000 105.550000 /begin IF_DATA ASAP1B_CCP KP_BLOB 0xF923 0 1 /end IF_DATA BIT_MASK 0xFF /end MEASUREMENT
/begin MEASUREMENT AT_B "  INATS: Ambient temperature. Linearized and calculated." UBYTE Compur_RTSSCTLIN_B 1 0 -50.000000 105.550000 /begin IF_DATA ASAP1B_CCP KP_BLOB 0xF930 0 1 /end IF_DATA BIT_MASK 0xFF /end MEASUREMENT
/begin MEASUREMENT ASC1TXDATA " ASC1DAT: Tx data budder" UBYTE Compur_TXLENGTH_W 1 0 0.000000 255.000000 /begin IF_DATA ASAP1B_CCP KP_BLOB 0xC149 0 1 /end IF_DATA BIT_MASK 0xFF /end MEASUREMENT
/begin MEASUREMENT ASC1RXDATANR_B " ASC1DAT: Rx1 data length" UBYTE Compur_TXLENGTH_W 1 0 0.000000 255.000000 /begin IF_DATA ASAP1B_CCP KP_BLOB 0xC12D 0 1 /end IF_DATA BIT_MASK 0xFF /end MEASUREMENT
/begin MEASUREMENT ASC1RXDATA " ASC1DAT: Rx data budder" UWORD Compur_TXLENGTH_W 1 0 0.000000 65535.000000 /begin IF_DATA ASAP1B_CCP KP_BLOB 0xC83C 0 2 /end IF_DATA BIT_MASK 0xFFFF /end MEASUREMENT
/begin MEASUREMENT ASC1READ_BUFFER " ASC1DAT: Tx data budder adter validation" UBYTE Compur_TXLENGTH_W 1 0 0.000000 255.000000 /begin IF_DATA ASAP1B_CCP KP_BLOB 0xC110 0 1 /end IF_DATA BIT_MASK 0xFF /end MEASUREMENT
/begin MEASUREMENT ASC1NAKCTR_B " ASC1DAT: ASC1 NAK Counter" UBYTE Compur_TXLENGTH_W 1 0 0.000000 255.000000 /begin IF_DATA ASAP1B_CCP KP_BLOB 0xC132 0 1 /end IF_DATA BIT_MASK 0xFF /end MEASUREMENT
/begin MEASUREMENT ASC1MSGCTR_B " ASC1DAT: ASC1 message Counter" UBYTE Compur_TXLENGTH_W 1 0 0.000000 255.000000 /begin IF_DATA ASAP1B_CCP KP_BLOB 0xC134 0 1 /end IF_DATA BIT_MASK 0xFF /end MEASUREMENT
/begin MEASUREMENT ASC1INDEXEND_B " ASC1DAT: Tx data end of index" UBYTE Compur_TXLENGTH_W 1 0 0.000000 255.000000 /begin IF_DATA ASAP1B_CCP KP_BLOB 0xC2BD 0 1 /end IF_DATA BIT_MASK 0xFF /end MEASUREMENT
/begin MEASUREMENT ASC1INDEX_B " ASC1DAT: Tx data index" UBYTE Compur_TXLENGTH_W 1 0 0.000000 255.000000 /begin IF_DATA ASAP1B_CCP KP_BLOB 0xC2BC 0 1 /end IF_DATA BIT_MASK 0xFF /end MEASUREMENT
/begin MEASUREMENT ASC1ACKCTR_B " ASC1DAT: ASC1 ACK Counter" UBYTE Compur_TXLENGTH_W 1 0 0.000000 255.000000 /begin IF_DATA ASAP1B_CCP KP_BLOB 0xC166 0 1 /end IF_DATA BIT_MASK 0xFF /end MEASUREMENT
/begin MEASUREMENT ASC1_WUPIDLETIME_B " ASC1DAT: for time-measurement WUP idle time of ASC1" UBYTE Compur_IR_WUPIDLETIME_B 1 0 0.000000 255.000000 /begin IF_DATA ASAP1B_CCP KP_BLOB 0xC10F 0 1 /end IF_DATA BIT_MASK 0xFF /end MEASUREMENT
/begin MEASUREMENT ASC1_BITS_W " NULL  " UWORD Compur_TCV_W 1 0 0.000000 65535.000000 /begin IF_DATA ASAP1B_CCP KP_BLOB 0xFD28 0 2 /end IF_DATA BIT_MASK 0xFFFF /end MEASUREMENT
/begin MEASUREMENT ASC0_BITS_W " NULL  " UWORD Compur_TCV_W 1 0 0.000000 65535.000000 /begin IF_DATA ASAP1B_CCP KP_BLOB 0xFD14 0 2 /end IF_DATA BIT_MASK 0xFFFF /end MEASUREMENT
/begin MEASUREMENT APSC_B "  CAN4:APS(AccelPedalPos1)" UBYTE Compur_APSC_B 1 0 0.000000 102.000000 /begin IF_DATA ASAP1B_CCP KP_BLOB 0xF9F6 0 1 /end IF_DATA BIT_MASK 0xFF /end MEASUREMENT
/begin MEASUREMENT AMBIENTTEMPERATURE_B "  CAN4:environment temperature" UBYTE Compur_FCWTOUT_B 1 0 -40.000000 215.000000 /begin IF_DATA ASAP1B_CCP KP_BLOB 0xC238 0 1 /end IF_DATA BIT_MASK 0xFF /end MEASUREMENT
/begin MEASUREMENT AIRPRESSURE_W "  CAN4:Cathode air pressure" UWORD Compur_H2PRESSURE_W 1 0 0.000000 655.350000 /begin IF_DATA ASAP1B_CCP KP_BLOB 0xC7F4 0 2 /end IF_DATA BIT_MASK 0xFFFF /end MEASUREMENT
/begin MEASUREMENT AIRFLOW_W "  CAN4:Cathode air flow" UWORD Compur_AIRFLOW_W 1 0 0.000000 6553.500000 /begin IF_DATA ASAP1B_CCP KP_BLOB 0xC838 0 2 /end IF_DATA BIT_MASK 0xFFFF /end MEASUREMENT
/begin MEASUREMENT AIRCOMPRESSORTEMP_B "  CAN4:Air compressor temperature" UBYTE Compur_FCWTOUT_B 1 0 -40.000000 215.000000 /begin IF_DATA ASAP1B_CCP KP_BLOB 0xC1F7 0 1 /end IF_DATA BIT_MASK 0xFF /end MEASUREMENT
/begin MEASUREMENT AIRCOMPRESSORCTRLTEMP_B "  CAN4:Air compressor controller temperature" UBYTE Compur_FCWTOUT_B 1 0 -40.000000 215.000000 /begin IF_DATA ASAP1B_CCP KP_BLOB 0xC203 0 1 /end IF_DATA BIT_MASK 0xFF /end MEASUREMENT
/begin MEASUREMENT AIRCMPPOWER_W "  CAN4:Air compressor comsume power" UWORD Compur_WATERPUMPPOWER_B 1 0 0.000000 6553.500000 /begin IF_DATA ASAP1B_CCP KP_BLOB 0xC800 0 2 /end IF_DATA BIT_MASK 0xFFFF /end MEASUREMENT
/begin MEASUREMENT ADRES[9] " ADinput: A/D0 input raw values[9]" UWORD default 1 0 0.000000 65535.000000 /begin IF_DATA ASAP1B_CCP KP_BLOB 0xF8DA 0 2 /end IF_DATA BIT_MASK 0xFFFF /end MEASUREMENT
/begin MEASUREMENT ADRES[8] " ADinput: A/D0 input raw values[8]" UWORD default 1 0 0.000000 65535.000000 /begin IF_DATA ASAP1B_CCP KP_BLOB 0xF8D8 0 2 /end IF_DATA BIT_MASK 0xFFFF /end MEASUREMENT
/begin MEASUREMENT ADRES[7] " ADinput: A/D0 input raw values[7]" UWORD default 1 0 0.000000 65535.000000 /begin IF_DATA ASAP1B_CCP KP_BLOB 0xF8D6 0 2 /end IF_DATA BIT_MASK 0xFFFF /end MEASUREMENT
/begin MEASUREMENT ADRES[6] " ADinput: A/D0 input raw values[6]" UWORD default 1 0 0.000000 65535.000000 /begin IF_DATA ASAP1B_CCP KP_BLOB 0xF8D4 0 2 /end IF_DATA BIT_MASK 0xFFFF /end MEASUREMENT
/begin MEASUREMENT ADRES[5] " ADinput: A/D0 input raw values[5]" UWORD default 1 0 0.000000 65535.000000 /begin IF_DATA ASAP1B_CCP KP_BLOB 0xF8D2 0 2 /end IF_DATA BIT_MASK 0xFFFF /end MEASUREMENT
/begin MEASUREMENT ADRES[4] " ADinput: A/D0 input raw values[4]" UWORD default 1 0 0.000000 65535.000000 /begin IF_DATA ASAP1B_CCP KP_BLOB 0xF8D0 0 2 /end IF_DATA BIT_MASK 0xFFFF /end MEASUREMENT
/begin MEASUREMENT ADRES[3] " ADinput: A/D0 input raw values[3]" UWORD default 1 0 0.000000 65535.000000 /begin IF_DATA ASAP1B_CCP KP_BLOB 0xF8CE 0 2 /end IF_DATA BIT_MASK 0xFFFF /end MEASUREMENT
/begin MEASUREMENT ADRES[2] " ADinput: A/D0 input raw values[2]" UWORD default 1 0 0.000000 65535.000000 /begin IF_DATA ASAP1B_CCP KP_BLOB 0xF8CC 0 2 /end IF_DATA BIT_MASK 0xFFFF /end MEASUREMENT
/begin MEASUREMENT ADRES[15] " ADinput: A/D0 input raw values[15]" UWORD default 1 0 0.000000 65535.000000 /begin IF_DATA ASAP1B_CCP KP_BLOB 0xF8E6 0 2 /end IF_DATA BIT_MASK 0xFFFF /end MEASUREMENT
/begin MEASUREMENT ADRES[14] " ADinput: A/D0 input raw values[14]" UWORD default 1 0 0.000000 65535.000000 /begin IF_DATA ASAP1B_CCP KP_BLOB 0xF8E4 0 2 /end IF_DATA BIT_MASK 0xFFFF /end MEASUREMENT
/begin MEASUREMENT ADRES[13] " ADinput: A/D0 input raw values[13]" UWORD default 1 0 0.000000 65535.000000 /begin IF_DATA ASAP1B_CCP KP_BLOB 0xF8E2 0 2 /end IF_DATA BIT_MASK 0xFFFF /end MEASUREMENT
/begin MEASUREMENT ADRES[12] " ADinput: A/D0 input raw values[12]" UWORD default 1 0 0.000000 65535.000000 /begin IF_DATA ASAP1B_CCP KP_BLOB 0xF8E0 0 2 /end IF_DATA BIT_MASK 0xFFFF /end MEASUREMENT
/begin MEASUREMENT ADRES[11] " ADinput: A/D0 input raw values[11]" UWORD default 1 0 0.000000 65535.000000 /begin IF_DATA ASAP1B_CCP KP_BLOB 0xF8DE 0 2 /end IF_DATA BIT_MASK 0xFFFF /end MEASUREMENT
/begin MEASUREMENT ADRES[10] " ADinput: A/D0 input raw values[10]" UWORD default 1 0 0.000000 65535.000000 /begin IF_DATA ASAP1B_CCP KP_BLOB 0xF8DC 0 2 /end IF_DATA BIT_MASK 0xFFFF /end MEASUREMENT
/begin MEASUREMENT ADRES[1] " ADinput: A/D0 input raw values[1]" UWORD default 1 0 0.000000 65535.000000 /begin IF_DATA ASAP1B_CCP KP_BLOB 0xF8CA 0 2 /end IF_DATA BIT_MASK 0xFFFF /end MEASUREMENT
/begin MEASUREMENT ADRES[0] " ADinput: A/D0 input raw values[0]" UWORD default 1 0 0.000000 65535.000000 /begin IF_DATA ASAP1B_CCP KP_BLOB 0xF8C8 0 2 /end IF_DATA BIT_MASK 0xFFFF /end MEASUREMENT
/begin MEASUREMENT ADCOUNT_W "No Comment" UWORD default 1 0 0.000000 65535.000000 /begin IF_DATA ASAP1B_CCP KP_BLOB 0xF9A2 0 2 /end IF_DATA BIT_MASK 0xFFFF /end MEASUREMENT
/begin MEASUREMENT ADCHANNEL1_B "  " UBYTE default 1 0 0.000000 255.000000 /begin IF_DATA ASAP1B_CCP KP_BLOB 0xF96A 0 1 /end IF_DATA BIT_MASK 0xFF /end MEASUREMENT
/begin MEASUREMENT ADCHANNEL_B "No Comment" UBYTE default 1 0 0.000000 255.000000 /begin IF_DATA ASAP1B_CCP KP_BLOB 0xF922 0 1 /end IF_DATA BIT_MASK 0xFF /end MEASUREMENT
/begin MEASUREMENT AD1RES[7] " ADinput: A/D1 input raw values[7]" UWORD default 1 0 0.000000 65535.000000 /begin IF_DATA ASAP1B_CCP KP_BLOB 0xF8AA 0 2 /end IF_DATA BIT_MASK 0xFFFF /end MEASUREMENT
/begin MEASUREMENT AD1RES[6] " ADinput: A/D1 input raw values[6]" UWORD default 1 0 0.000000 65535.000000 /begin IF_DATA ASAP1B_CCP KP_BLOB 0xF8A8 0 2 /end IF_DATA BIT_MASK 0xFFFF /end MEASUREMENT
/begin MEASUREMENT AD1RES[5] " ADinput: A/D1 input raw values[5]" UWORD default 1 0 0.000000 65535.000000 /begin IF_DATA ASAP1B_CCP KP_BLOB 0xF8A6 0 2 /end IF_DATA BIT_MASK 0xFFFF /end MEASUREMENT
/begin MEASUREMENT AD1RES[4] " ADinput: A/D1 input raw values[4]" UWORD default 1 0 0.000000 65535.000000 /begin IF_DATA ASAP1B_CCP KP_BLOB 0xF8A4 0 2 /end IF_DATA BIT_MASK 0xFFFF /end MEASUREMENT
/begin MEASUREMENT AD1RES[3] " ADinput: A/D1 input raw values[3]" UWORD default 1 0 0.000000 65535.000000 /begin IF_DATA ASAP1B_CCP KP_BLOB 0xF8A2 0 2 /end IF_DATA BIT_MASK 0xFFFF /end MEASUREMENT
/begin MEASUREMENT AD1RES[2] " ADinput: A/D1 input raw values[2]" UWORD default 1 0 0.000000 65535.000000 /begin IF_DATA ASAP1B_CCP KP_BLOB 0xF8A0 0 2 /end IF_DATA BIT_MASK 0xFFFF /end MEASUREMENT
/begin MEASUREMENT AD1RES[1] " ADinput: A/D1 input raw values[1]" UWORD default 1 0 0.000000 65535.000000 /begin IF_DATA ASAP1B_CCP KP_BLOB 0xF89E 0 2 /end IF_DATA BIT_MASK 0xFFFF /end MEASUREMENT
/begin MEASUREMENT AD1RES[0] " ADinput: A/D1 input raw values[0]" UWORD default 1 0 0.000000 65535.000000 /begin IF_DATA ASAP1B_CCP KP_BLOB 0xF89C 0 2 /end IF_DATA BIT_MASK 0xFFFF /end MEASUREMENT
/begin MEASUREMENT 5V " InBV: sensor power supply voltage (8bit)" UBYTE Compur_5V 1 0 0.000000 10.000080 /begin IF_DATA ASAP1B_CCP KP_BLOB 0xF9C5 0 1 /end IF_DATA BIT_MASK 0xFF /end MEASUREMENT
/begin MEASUREMENT BKPRPM17 "ENGINE SPEED BREAK POINT" UBYTE Bkprpm_17 1 0 608.0 6000.0 /begin IF_DATA ASAP1B_CCP KP_BLOB 0x65696461 0 1 /end IF_DATA BIT_MASK 0xFF /end MEASUREMENT
/begin MEASUREMENT BKPRPM18 "ENGINE SPEED BREAK POINT" UBYTE Bkprpm_18 1 0 0.0000 6000.0 /begin IF_DATA ASAP1B_CCP KP_BLOB 0x65696461 0 1 /end IF_DATA BIT_MASK 0xFF /end MEASUREMENT
/begin MEASUREMENT DIS_TBDASH1 "TBDASH1 grid display" UBYTE TBdash1_grid_display 1 0 0.0000 192.0 /begin IF_DATA ASAP1B_CCP KP_BLOB 0x20636974 0 1 /end IF_DATA BIT_MASK 0xFF /end MEASUREMENT
/begin MEASUREMENT DIS_TBDASH2 "TBDASH2 grid display" UBYTE TBdash2_grid_display 1 0 0.0000 192.0 /begin IF_DATA ASAP1B_CCP KP_BLOB 0x20636974 0 1 /end IF_DATA BIT_MASK 0xFF /end MEASUREMENT
/begin MEASUREMENT SYSTMOV " NULL  " UBYTE default 1 0 0.000 255.000 BIT_MASK 0x02 /end MEASUREMENT
/begin MEASUREMENT B_WUPASC1 "ASC1DAT: CONDITION: ASC1 STARTS TRANSMITTION " UBYTE default 1 0 0.000 255.000 BIT_MASK 0x10 /end MEASUREMENT
/begin MEASUREMENT B_WUPASC0 "IRDA: CONDITION: ASC0 STARTS TRANSMITTION " UBYTE default 1 0 0.000 255.000 BIT_MASK 0x10 /end MEASUREMENT
/begin MEASUREMENT B_VSS " SWADAP: CONDITION: VSS PORT " UBYTE default 1 0 0.000 255.000 BIT_MASK 0x01 /end MEASUREMENT
/begin MEASUREMENT B_VAPSOL " SWADAP: CONDITION: VAPORIZER SOLENOID VALVE " UBYTE default 1 0 0.000 255.000 BIT_MASK 0x40 /end MEASUREMENT
/begin MEASUREMENT B_VALVESERIAL " CCSTMTM: CONDITION: VALVE MODE SERIAL/PARALLEL " UBYTE default 1 0 0.000 255.000 BIT_MASK 0x01 /end MEASUREMENT
/begin MEASUREMENT B_TX1OK "ASC1DAT: CONDITION: TX DATA OK " UBYTE default 1 0 0.000 255.000 BIT_MASK 0x04 /end MEASUREMENT
/begin MEASUREMENT B_TX0OK "IRDA: CONDITION: TX DATA OK " UBYTE default 1 0 0.000 255.000 BIT_MASK 0x04 /end MEASUREMENT
/begin MEASUREMENT B_TQR " SWADAP: CONDITION: ALLOW TORQUE REDUCTION  " UBYTE default 1 0 0.000 255.000 BIT_MASK 0x02 /end MEASUREMENT
/begin MEASUREMENT B_TONDSWTOV " NULL  " UBYTE default 1 0 0.000 255.000 BIT_MASK 0x02 /end MEASUREMENT
/begin MEASUREMENT B_TONDLPGSW " NULL  " UBYTE default 1 0 0.000 255.000 BIT_MASK 0x80 /end MEASUREMENT
/begin MEASUREMENT B_TOFDLPGSW " NULL  " UBYTE default 1 0 0.000 255.000 BIT_MASK 0x01 /end MEASUREMENT
/begin MEASUREMENT B_TMPGASSWO " INFCSW: CONDITION: OLD VALUE OF TEMPORARY PORT INPUT FOR B_FCSW " UBYTE default 1 0 0.000 255.000 BIT_MASK 0x10 /end MEASUREMENT
/begin MEASUREMENT B_TMPGASSW " INFCSW: CONDITION: TEMPORARY PORT INPUT FOR B_FCSW " UBYTE default 1 0 0.000 255.000 BIT_MASK 0x01 /end MEASUREMENT
/begin MEASUREMENT B_TIPSWON " INFCSW: CONDITION: TERM-IN PUSH ON STATUS EXPIRED. " UBYTE default 1 0 0.000 255.000 BIT_MASK 0x08 /end MEASUREMENT
/begin MEASUREMENT B_TCV3 "IODIGSIG: CONDITION: OTV3 CONTROL " UBYTE default 1 0 0.000 255.000 BIT_MASK 0x04 /end MEASUREMENT
/begin MEASUREMENT B_TCV2 "IODIGSIG: CONDITION: OTV2 CONTROL " UBYTE default 1 0 0.000 255.000 BIT_MASK 0x02 /end MEASUREMENT
/begin MEASUREMENT B_TCV1 "IODIGSIG: CONDITION: OTV1 CONTROL " UBYTE default 1 0 0.000 255.000 BIT_MASK 0x01 /end MEASUREMENT
/begin MEASUREMENT B_SYN2ND " NULL  " UBYTE default 1 0 0.000 255.000 BIT_MASK 0x02 /end MEASUREMENT
/begin MEASUREMENT B_SYN " INPH: CONDITION: SYNCHRO PRESENT " UBYTE default 1 0 0.000 255.000 BIT_MASK 0x02 /end MEASUREMENT
/begin MEASUREMENT B_SWTTENG " CTLFUELSW: CONDITION: ENGINE TEMPERATURE CONDITION FOR FUEL SWTCHING " UBYTE default 1 0 0.000 255.000 BIT_MASK 0x08 /end MEASUREMENT
/begin MEASUREMENT B_SWTRPM " CTLFUELSW: CONDITION: ENGINE SPEED CONDITION FOR FUEL SWITCHING " UBYTE default 1 0 0.000 255.000 BIT_MASK 0x02 /end MEASUREMENT
/begin MEASUREMENT B_SWTPSDSS " CTLFUELSW: CONDITION: ENGINE LOAD CONDITION FOR FUEL SWITCHING " UBYTE default 1 0 0.000 255.000 BIT_MASK 0x08 /end MEASUREMENT
/begin MEASUREMENT B_SVS " NULL  " UBYTE default 1 0 0.000 255.000 BIT_MASK 0x20 /end MEASUREMENT
/begin MEASUREMENT B_STENDO " SWADAP: CONDITION OLD VALUE FOR END OF START " UBYTE default 1 0 0.000 255.000 BIT_MASK 0x02 /end MEASUREMENT
/begin MEASUREMENT B_STEND " MRFCAUS: CONDITION END OF START " UBYTE default 1 0 0.000 255.000 BIT_MASK 0x10 /end MEASUREMENT
/begin MEASUREMENT B_ST " MRFCAUS: CONDITION OF ENGINE START " UBYTE default 1 0 0.000 255.000 BIT_MASK 0x40 /end MEASUREMENT
/begin MEASUREMENT B_SPR2 " SWADAP: CONDITION: SPR2 PORT " UBYTE default 1 0 0.000 255.000 BIT_MASK 0x10 /end MEASUREMENT
/begin MEASUREMENT B_SPARESW1 " NULL  " UBYTE default 1 0 0.000 255.000 BIT_MASK 0x40 /end MEASUREMENT
/begin MEASUREMENT B_RTSSCTMIN " INRTS: CONDITION: SUCT REFRIGERANT TEMPERATURE SENSOR VALUE IS MINIMUM. " UBYTE default 1 0 0.000 255.000 BIT_MASK 0x40 /end MEASUREMENT
/begin MEASUREMENT B_RTSSCTMAX " INRTS: CONDITION: SUCT REFRIGERANT TEMPERATURE SENSOR VALUE IS MAXIMUM. " UBYTE default 1 0 0.000 255.000 BIT_MASK 0x80 /end MEASUREMENT
/begin MEASUREMENT B_RTSSBCMIN " INRTS: CONDITION: SUBCOOL REFRIGERANT TEMPERATURE SENSOR VALUE IS MINIMUM. " UBYTE default 1 0 0.000 255.000 BIT_MASK 0x40 /end MEASUREMENT
/begin MEASUREMENT B_RTSSBCMAX " INRTS: CONDITION: SUBCOOL REFRIGERANT TEMPERATURE SENSOR VALUE IS MAXIMUM. " UBYTE default 1 0 0.000 255.000 BIT_MASK 0x10 /end MEASUREMENT
/begin MEASUREMENT B_RPSSCTMIN " INRPS: CONDITION: SUCT REFRIGERANT PRESSURE SENSOR VALUE IS MINIMUM. " UBYTE default 1 0 0.000 255.000 BIT_MASK 0x08 /end MEASUREMENT
/begin MEASUREMENT B_RPSSCTMAX " INRPS: CONDITION: SUCT REFRIGERANT PRESSURE SENSOR VALUE IS MAXIMUM. " UBYTE default 1 0 0.000 255.000 BIT_MASK 0x10 /end MEASUREMENT
/begin MEASUREMENT B_RPSSCTLOW " INRPS: CONDITION: SUCT REFRIGERANT PRESSURE SENSOR VALUE IS TOO LOW. " UBYTE default 1 0 0.000 255.000 BIT_MASK 0x80 /end MEASUREMENT
/begin MEASUREMENT B_RPSSCTHIGH " INRPS: CONDITION: SUCT REFRIGERANT PRESSURE SENSOR VALUE IS TOO HIGH. " UBYTE default 1 0 0.000 255.000 BIT_MASK 0x20 /end MEASUREMENT
/begin MEASUREMENT B_RPSSBCMIN " INRPS: CONDITION: SUBCOOL REFRIGERANT PRESSURE SENSOR VALUE IS MINIMUM. " UBYTE default 1 0 0.000 255.000 BIT_MASK 0x40 /end MEASUREMENT
/begin MEASUREMENT B_RPSSBCMAX " INRPS: CONDITION: SUBCOOL REFRIGERANT PRESSURE SENSOR VALUE IS MAXIMUM. " UBYTE default 1 0 0.000 255.000 BIT_MASK 0x40 /end MEASUREMENT
/begin MEASUREMENT B_RPSSBCLOW " INRPS: CONDITION: SUBCOOL REFRIGERANT PRESSURE SENSOR VALUE IS TOO LOW. " UBYTE default 1 0 0.000 255.000 BIT_MASK 0x02 /end MEASUREMENT
/begin MEASUREMENT B_RPSSBCHIGH " INRPS: CONDITION: SUBCOOL REFRIGERANT PRESSURE SENSOR VALUE IS TOO HIGH. " UBYTE default 1 0 0.000 255.000 BIT_MASK 0x01 /end MEASUREMENT
/begin MEASUREMENT B_RPM " ENGSTALL: CONDITION: ENGINE SPEED IS PRESENTED. " UBYTE default 1 0 0.000 255.000 BIT_MASK 0x20 /end MEASUREMENT
/begin MEASUREMENT B_ROMCHK " NULL  " UBYTE default 1 0 0.000 255.000 BIT_MASK 0x20 /end MEASUREMENT
/begin MEASUREMENT B_REMNANTSYNTASKACTIVE " NULL  " UBYTE default 1 0 0.000 255.000 BIT_MASK 0x10 /end MEASUREMENT
/begin MEASUREMENT B_RADIATOR " CCSTMTM: CONDITION: RADIATOR ON/OFF " UBYTE default 1 0 0.000 255.000 BIT_MASK 0x10 /end MEASUREMENT
/begin MEASUREMENT B_PWFCSERR " %PWFD: CONDITION: CHECK-SUM FAULT AFTER POWER FAIL " UBYTE default 1 0 0.000 255.000 BIT_MASK 0x01 /end MEASUREMENT
/begin MEASUREMENT B_PWF " %PWFD: CONDITION: POWER FAIL DETECTION " UBYTE default 1 0 0.000 255.000 BIT_MASK 0x10 /end MEASUREMENT
/begin MEASUREMENT B_PSYN " INPH: CONDITION: PHASE SYNCHRO PRESENT " UBYTE default 1 0 0.000 255.000 BIT_MASK 0x40 /end MEASUREMENT
/begin MEASUREMENT B_PBSWON " INFCSW: CONDITION: PUSH-BUTTON SWITCH ON STATUS " UBYTE default 1 0 0.000 255.000 BIT_MASK 0x20 /end MEASUREMENT
/begin MEASUREMENT B_PBSWOFF " INFCSW: CONDITION: PUSH-BUTTON SWITCH ON STATUS " UBYTE default 1 0 0.000 255.000 BIT_MASK 0x10 /end MEASUREMENT
/begin MEASUREMENT B_NMIN " ENGSTALL: CONDITION: LOW RPM " UBYTE default 1 0 0.000 255.000 BIT_MASK 0x10 /end MEASUREMENT
/begin MEASUREMENT B_NGASOK " NULL  " UBYTE default 1 0 0.000 255.000 BIT_MASK 0x01 /end MEASUREMENT
/begin MEASUREMENT B_NFSLIMMX " CTLFUELSW: CONDITION: ENGINE SPEED PERMISSION MAXIMUM LIMIT IN TIMER TRIGGER RANGE " UBYTE default 1 0 0.000 255.000 BIT_MASK 0x80 /end MEASUREMENT
/begin MEASUREMENT B_NFSLIMEL " CTLFUELSW: CONDITION: B_FUELSW IMMEDIATE RESET BIT " UBYTE default 1 0 0.000 255.000 BIT_MASK 0x01 /end MEASUREMENT
/begin MEASUREMENT B_NFSLIM " CTLFUELSW: CONDITION: B_NFSLIMEL DETECTION BIT FOR TNTNFSLIM ADAPTATION " UBYTE default 1 0 0.000 255.000 BIT_MASK 0x20 /end MEASUREMENT
/begin MEASUREMENT B_NACHLSTP "MOTAUS: AFTER RUN STEP " UBYTE default 1 0 0.000 255.000 BIT_MASK 0x20 /end MEASUREMENT
/begin MEASUREMENT B_NACHLEND "MOTAUS: AFTER RUN END " UBYTE default 1 0 0.000 255.000 BIT_MASK 0x40 /end MEASUREMENT
/begin MEASUREMENT B_NACHL "MOTAUS: AFTER RUN " UBYTE default 1 0 0.000 255.000 BIT_MASK 0x80 /end MEASUREMENT
/begin MEASUREMENT B_MSGDONE "ASC1DAT: CONDITION: ASC1 MESSAGE SET DONE " UBYTE default 1 0 0.000 255.000 BIT_MASK 0x40 /end MEASUREMENT
/begin MEASUREMENT B_MRFC " MRFCAUS : CONDITION: FCU MAIN RELAY " UBYTE default 1 0 0.000 255.000 BIT_MASK 0x40 /end MEASUREMENT
/begin MEASUREMENT B_MRDC " MRDCAUS : CONDITION: DC/DC MAIN RELAY(12V -> 24V) " UBYTE default 1 0 0.000 255.000 BIT_MASK 0x08 /end MEASUREMENT
/begin MEASUREMENT B_MR " MOTAUS: CONDITION: OUTPUT OF MAIN RELAY CONTROL " UBYTE default 1 0 0.000 255.000 BIT_MASK 0x04 /end MEASUREMENT
/begin MEASUREMENT B_MILFB " SWADAP: CONDITION: MIL ORDER FROM ANOTHER ECU " UBYTE default 1 0 0.000 255.000 BIT_MASK 0x08 /end MEASUREMENT
/begin MEASUREMENT B_MIL " %DMIL: CONDITION: STEUERUNG FEHLERLAMPE (MIL) " UBYTE default 1 0 0.000 255.000 BIT_MASK 0x10 /end MEASUREMENT
/begin MEASUREMENT B_MAINSW " INFCSW: CONDITION: FUEL CELL SELECTION MAIN SWITCH " UBYTE default 1 0 0.000 255.000 BIT_MASK 0x80 /end MEASUREMENT
/begin MEASUREMENT B_LOWRPM "  INPH: CONDITION: LOW RPM " UBYTE default 1 0 0.000 255.000 BIT_MASK 0x10 /end MEASUREMENT
/begin MEASUREMENT B_LDSSIG " INLDS: CONDITION: LASER DETECTION SENSOR SIGNAL ERROR (TOO NEAR OR TOO FAR). " UBYTE default 1 0 0.000 255.000 BIT_MASK 0x04 /end MEASUREMENT
/begin MEASUREMENT B_LDSNEAR " INLDS: CONDITION: LASER DETECTION SENSOR IS TOO NEAR. " UBYTE default 1 0 0.000 255.000 BIT_MASK 0x01 /end MEASUREMENT
/begin MEASUREMENT B_LDSMIN " INLDS: CONDITION: LASER DETECTION SENSOR VALUE IS MINIMUM. " UBYTE default 1 0 0.000 255.000 BIT_MASK 0x08 /end MEASUREMENT
/begin MEASUREMENT B_LDSMAX " INLDS: CONDITION: LASER DETECTION SENSOR VALUE IS MAXIMUM. " UBYTE default 1 0 0.000 255.000 BIT_MASK 0x20 /end MEASUREMENT
/begin MEASUREMENT B_LDSFAR " INLDS: CONDITION: LASER DETECTION SENSOR IS TOO FAR. " UBYTE default 1 0 0.000 255.000 BIT_MASK 0x02 /end MEASUREMENT
/begin MEASUREMENT B_LCLDCK " SWADAP: CONDITION:   " UBYTE default 1 0 0.000 255.000 BIT_MASK 0x10 /end MEASUREMENT
/begin MEASUREMENT B_IRSTART " CCSTMFC: CONDITION: IRDA COMMUNICATION START " UBYTE default 1 0 0.000 255.000 BIT_MASK 0x08 /end MEASUREMENT
/begin MEASUREMENT B_IREND " IRDA: CONDITION: IRDA COMMUNICATION STOP " UBYTE default 1 0 0.000 255.000 BIT_MASK 0x08 /end MEASUREMENT
/begin MEASUREMENT B_IRDMAX " IRDA: CONDITION: IR COMMUNICATION ERROR " UBYTE default 1 0 0.000 255.000 BIT_MASK 0x01 /end MEASUREMENT
/begin MEASUREMENT B_IRDIAG " IRDA: CONSITION: IR COMMUNICATION DIAG FEEDBACK " UBYTE default 1 0 0.000 255.000 BIT_MASK 0x20 /end MEASUREMENT
/begin MEASUREMENT B_INISYNTSK " CONDITION: ACTIVATED _INISYN TASKS. " UBYTE default 1 0 0.000 255.000 BIT_MASK 0x02 /end MEASUREMENT
/begin MEASUREMENT B_INIPHTSK " CONDITION: ACTIVATED _INIPH TASKS. " UBYTE default 1 0 0.000 255.000 BIT_MASK 0x04 /end MEASUREMENT
/begin MEASUREMENT B_INI2TSK " CONDITION: ACTIVATED _INI2 TASKS. " UBYTE default 1 0 0.000 255.000 BIT_MASK 0x04 /end MEASUREMENT
/begin MEASUREMENT B_IGKEYO " NULL  " UBYTE default 1 0 0.000 255.000 BIT_MASK 0x20 /end MEASUREMENT
/begin MEASUREMENT B_IGKEY " IODIGSIG: CONDITION: IGNITION KEY SW " UBYTE default 1 0 0.000 255.000 BIT_MASK 0x01 /end MEASUREMENT
/begin MEASUREMENT B_HDS3MIN "INHDS: CONDITION: H2 DETECT SENSOR 3 VALUE IS MINIMUM. " UBYTE default 1 0 0.000 255.000 BIT_MASK 0x01 /end MEASUREMENT
/begin MEASUREMENT B_HDS3MAX "INHDS: CONDITION: H2 DETECT SENSOR 3 VALUE IS MAXIMUM. " UBYTE default 1 0 0.000 255.000 BIT_MASK 0x02 /end MEASUREMENT
/begin MEASUREMENT B_HDS3HIGH "INHDS: CONDITION: H2 DETECT SENSOR 3 VALUE IS TOO HIGH. " UBYTE default 1 0 0.000 255.000 BIT_MASK 0x04 /end MEASUREMENT
/begin MEASUREMENT B_HDS2MIN "INHDS: CONDITION: H2 DETECT SENSOR 2 VALUE IS MINIMUM. " UBYTE default 1 0 0.000 255.000 BIT_MASK 0x10 /end MEASUREMENT
/begin MEASUREMENT B_HDS2MAX "INHDS: CONDITION: H2 DETECT SENSOR 2 VALUE IS MAXIMUM. " UBYTE default 1 0 0.000 255.000 BIT_MASK 0x20 /end MEASUREMENT
/begin MEASUREMENT B_HDS2HIGH "INHDS: CONDITION: H2 DETECT SENSOR 2 VALUE IS TOO HIGH. " UBYTE default 1 0 0.000 255.000 BIT_MASK 0x02 /end MEASUREMENT
/begin MEASUREMENT B_HDS1MIN "INHDS: CONDITION: H2 DETECT SENSOR 1 VALUE IS MINIMUM. " UBYTE default 1 0 0.000 255.000 BIT_MASK 0x01 /end MEASUREMENT
/begin MEASUREMENT B_HDS1MAX "INHDS: CONDITION: H2 DETECT SENSOR 1 VALUE IS MAXIMUM. " UBYTE default 1 0 0.000 255.000 BIT_MASK 0x02 /end MEASUREMENT
/begin MEASUREMENT B_HDS1HIGH "INHDS: CONDITION: H2 DETECT SENSOR 1 VALUE IS TOO HIGH. " UBYTE default 1 0 0.000 255.000 BIT_MASK 0x01 /end MEASUREMENT
/begin MEASUREMENT B_FUELSW " CTLFUELSW: CONDITION: FUEL SWITCHING ACTIVE TO GAS MODE " UBYTE default 1 0 0.000 255.000 BIT_MASK 0x04 /end MEASUREMENT
/begin MEASUREMENT B_FSTFSSNL " CTLFUELSW: CONDITION: B_FSSNL FIRST SET DETECTION BIT " UBYTE default 1 0 0.000 255.000 BIT_MASK 0x20 /end MEASUREMENT
/begin MEASUREMENT B_FSSNLOLD " CTLFUELSW: CONDITION: OLD VALUE OF B_FSSNL " UBYTE default 1 0 0.000 255.000 BIT_MASK 0x20 /end MEASUREMENT
/begin MEASUREMENT B_FSSNL " CTLFUELSW: CONDITION: FUEL SWICHING CONDITION FULFILLED " UBYTE default 1 0 0.000 255.000 BIT_MASK 0x02 /end MEASUREMENT
/begin MEASUREMENT B_FSNTTA " CTLFUELSW: CONDITION: REPEATABLE COUNTER FUEL SWITCH CONTROL " UBYTE default 1 0 0.000 255.000 BIT_MASK 0x10 /end MEASUREMENT
/begin MEASUREMENT B_FPLMIN " INHMPS: CONDITION: LOW FUEL PRESSURE SENSOR VALUE IS MINIMUM. " UBYTE default 1 0 0.000 255.000 BIT_MASK 0x40 /end MEASUREMENT
/begin MEASUREMENT B_FPLMAX " INHMPS: CONDITION: LOW FUEL PRESSURE SENSOR VALUE IS MAXIMUM. " UBYTE default 1 0 0.000 255.000 BIT_MASK 0x08 /end MEASUREMENT
/begin MEASUREMENT B_FPLLOW " INHMPS: CONDITION: LOW FUEL PRESSURE SENSOR VALUE IS TOO LOW. " UBYTE default 1 0 0.000 255.000 BIT_MASK 0x02 /end MEASUREMENT
/begin MEASUREMENT B_FPLHIGH " INHMPS: CONDITION: LOW FUEL PRESSURE SENSOR VALUE IS TOO HIGH. " UBYTE default 1 0 0.000 255.000 BIT_MASK 0x80 /end MEASUREMENT
/begin MEASUREMENT B_FPHMIN " INHHPS: CONDITION: HIGH FUEL PRESSURE SENSOR VALUE IS MINIMUM. " UBYTE default 1 0 0.000 255.000 BIT_MASK 0x10 /end MEASUREMENT
/begin MEASUREMENT B_FPHMAX " INHHPS: CONDITION: HIGH FUEL PRESSURE SENSOR VALUE IS MAXIMUM. " UBYTE default 1 0 0.000 255.000 BIT_MASK 0x40 /end MEASUREMENT
/begin MEASUREMENT B_FPHLOW " INHHPS: CONDITION: HIGH FUEL PRESSURE SENSOR VALUE IS TOO LOW. " UBYTE default 1 0 0.000 255.000 BIT_MASK 0x04 /end MEASUREMENT
/begin MEASUREMENT B_FPHHIGH " INHHPS: CONDITION: HIGH FUEL PRESSURE SENSOR VALUE IS TOO HIGH. " UBYTE default 1 0 0.000 255.000 BIT_MASK 0x40 /end MEASUREMENT
/begin MEASUREMENT B_FLVLMD " NULL  " UBYTE default 1 0 0.000 255.000 BIT_MASK 0x10 /end MEASUREMENT
/begin MEASUREMENT B_FLVLLOW " NULL  " UBYTE default 1 0 0.000 255.000 BIT_MASK 0x04 /end MEASUREMENT
/begin MEASUREMENT B_FLVLHI " NULL  " UBYTE default 1 0 0.000 255.000 BIT_MASK 0x02 /end MEASUREMENT
/begin MEASUREMENT B_FLVLFL " NULL  " UBYTE default 1 0 0.000 255.000 BIT_MASK 0x08 /end MEASUREMENT
/begin MEASUREMENT B_FLVLEMT " NULL  " UBYTE default 1 0 0.000 255.000 BIT_MASK 0x80 /end MEASUREMENT
/begin MEASUREMENT B_FLSWTP3 " CTLFUELSW: CONDITION: B_FUELSW CONTROL PRE-DEFINED BIT3 " UBYTE default 1 0 0.000 255.000 BIT_MASK 0x40 /end MEASUREMENT
/begin MEASUREMENT B_FLSWTP2 " CTLFUELSW: CONDITION: B_FUELSW CONTROL PRE-DEFINED BIT2 " UBYTE default 1 0 0.000 255.000 BIT_MASK 0x02 /end MEASUREMENT
/begin MEASUREMENT B_FLSWTP1 " CTLFUELSW: CONDITION: B_FUELSW CONTROL PRE-DEFINED BIT1 " UBYTE default 1 0 0.000 255.000 BIT_MASK 0x08 /end MEASUREMENT
/begin MEASUREMENT B_FCWTHIGH " CAN4: CONDITION: COOLANT CONDUCTIVITY ALARM " UBYTE default 1 0 0.000 255.000 BIT_MASK 0x01 /end MEASUREMENT
/begin MEASUREMENT B_FCWLVLLOW " CAN4: CONDITION: WATER TANK LEVEL ALARM " UBYTE default 1 0 0.000 255.000 BIT_MASK 0x04 /end MEASUREMENT
/begin MEASUREMENT B_FCSW " IODIGSIG: CONDITION: INPUT OF FUEL CELL SELECTION SWITCH " UBYTE default 1 0 0.000 255.000 BIT_MASK 0x02 /end MEASUREMENT
/begin MEASUREMENT B_FCHIGHVOLTCTRL " NULL  " UBYTE default 1 0 0.000 255.000 BIT_MASK 0x20 /end MEASUREMENT
/begin MEASUREMENT B_FAULTCHECK " CCSTMTM: CONDITION: FAULT CHECK RESULT " UBYTE default 1 0 0.000 255.000 BIT_MASK 0x01 /end MEASUREMENT
/begin MEASUREMENT B_EVREGEN "CAN4: CONDITION: EV STATE REGEN " UBYTE default 1 0 0.000 255.000 BIT_MASK 0x02 /end MEASUREMENT
/begin MEASUREMENT B_EVDRIVING "CAN4: CONDITION: EV STATE DRIVING " UBYTE default 1 0 0.000 255.000 BIT_MASK 0x01 /end MEASUREMENT
/begin MEASUREMENT B_ETSMIN " INETS: CONDITION: EVAPORATOR TEMPERATURE SENSOR VALUE IS MINIMUM. " UBYTE default 1 0 0.000 255.000 BIT_MASK 0x01 /end MEASUREMENT
/begin MEASUREMENT B_ETSMAX " INETS: CONDITION: EVAPORATOR TEMPERATURE SENSOR VALUE IS MAXIMUM. " UBYTE default 1 0 0.000 255.000 BIT_MASK 0x04 /end MEASUREMENT
/begin MEASUREMENT B_ERMRFC "MOTAUS: DETECTION OF B_MRFC EDGE RISING " UBYTE default 1 0 0.000 255.000 BIT_MASK 0x20 /end MEASUREMENT
/begin MEASUREMENT B_ERLPGSW " INFCSW: CONDITION: TEMPORARY BIT OUTPUT FOR ER_LPGSW " UBYTE default 1 0 0.000 255.000 BIT_MASK 0x80 /end MEASUREMENT
/begin MEASUREMENT B_ERENGSTOP "MOTAUS: DETECTION OF B_ENGSTOP EDGE RISING " UBYTE default 1 0 0.000 255.000 BIT_MASK 0x02 /end MEASUREMENT
/begin MEASUREMENT B_EOLTST " NULL  " UBYTE default 1 0 0.000 255.000 BIT_MASK 0x08 /end MEASUREMENT
/begin MEASUREMENT B_EOLL9651V_2 " NULL  " UBYTE default 1 0 0.000 255.000 BIT_MASK 0x40 /end MEASUREMENT
/begin MEASUREMENT B_EOLL9651V_1 " NULL  " UBYTE default 1 0 0.000 255.000 BIT_MASK 0x02 /end MEASUREMENT
/begin MEASUREMENT B_ENGSTOPO " NULL  " UBYTE default 1 0 0.000 255.000 BIT_MASK 0x80 /end MEASUREMENT
/begin MEASUREMENT B_ENGSTOP " MRDCAUS : ENGINE STOP COMMAND VIA CAN ON ISS SYSTEM " UBYTE default 1 0 0.000 255.000 BIT_MASK 0x40 /end MEASUREMENT
/begin MEASUREMENT B_ENGSTL " NULL  " UBYTE default 1 0 0.000 255.000 BIT_MASK 0x20 /end MEASUREMENT
/begin MEASUREMENT B_EFMRFC "MOTAUS: DETECTION OF B_MRFC EDGE FALLING " UBYTE default 1 0 0.000 255.000 BIT_MASK 0x10 /end MEASUREMENT
/begin MEASUREMENT B_EFLPGSW " INFCSW: CONDITION: TEMPORARY BIT OUTPUT FOR EF_LPGSW " UBYTE default 1 0 0.000 255.000 BIT_MASK 0x08 /end MEASUREMENT
/begin MEASUREMENT B_EFENGSTOP "MOTAUS: DETECTION OF B_ENGSTOP EDGE FALLING " UBYTE default 1 0 0.000 255.000 BIT_MASK 0x01 /end MEASUREMENT
/begin MEASUREMENT B_DETLTTH " NULL  " UBYTE default 1 0 0.000 255.000 BIT_MASK 0x80 /end MEASUREMENT
/begin MEASUREMENT B_DEBUG4 " NULL  " UBYTE default 1 0 0.000 255.000 BIT_MASK 0x02 /end MEASUREMENT
/begin MEASUREMENT B_DEBUG3 " NULL  " UBYTE default 1 0 0.000 255.000 BIT_MASK 0x40 /end MEASUREMENT
/begin MEASUREMENT B_DEBUG2 " NULL  " UBYTE default 1 0 0.000 255.000 BIT_MASK 0x80 /end MEASUREMENT
/begin MEASUREMENT B_DEBUG1 " NULL  " UBYTE default 1 0 0.000 255.000 BIT_MASK 0x04 /end MEASUREMENT
/begin MEASUREMENT B_DEBUG0 " NULL  " UBYTE default 1 0 0.000 255.000 BIT_MASK 0x20 /end MEASUREMENT
/begin MEASUREMENT B_DCDCRUNSTATUS " NULL  " UBYTE default 1 0 0.000 255.000 BIT_MASK 0x80 /end MEASUREMENT
/begin MEASUREMENT B_CWTSPEMIN " INCWTS: CONDITION: COOLANT TEMPERATURE SENSOR VALUE IS MINIMUM. " UBYTE default 1 0 0.000 255.000 BIT_MASK 0x04 /end MEASUREMENT
/begin MEASUREMENT B_CWTSPEMAX " INCWTS: CONDITION: COOLANT TEMPERATURE SENSOR VALUE IS MAXIMUM. " UBYTE default 1 0 0.000 255.000 BIT_MASK 0x04 /end MEASUREMENT
/begin MEASUREMENT B_CWTSBATMIN " INCWTS: CONDITION: COOLANT TEMPERATURE SENSOR VALUE IS MINIMUM. " UBYTE default 1 0 0.000 255.000 BIT_MASK 0x08 /end MEASUREMENT
/begin MEASUREMENT B_CWTSBATMAX " INCWTS: CONDITION: COOLANT TEMPERATURE SENSOR VALUE IS MAXIMUM. " UBYTE default 1 0 0.000 255.000 BIT_MASK 0x80 /end MEASUREMENT
/begin MEASUREMENT B_CLUTCHO " MRFCAUS: CONDITION: CLUTCH SWITCH SIGNAL OLD VALUE " UBYTE default 1 0 0.000 255.000 BIT_MASK 0x04 /end MEASUREMENT
/begin MEASUREMENT B_CHILLER " CCSTMTM: CONDITION: CHILLER ON/OFF " UBYTE default 1 0 0.000 255.000 BIT_MASK 0x04 /end MEASUREMENT
/begin MEASUREMENT B_CHARGING "CAN4: CONDITION: EV STATE CHARGING BY FC " UBYTE default 1 0 0.000 255.000 BIT_MASK 0x04 /end MEASUREMENT
/begin MEASUREMENT B_CGUNCHK " CCSTMFC: CONDITION: CONFIRMATION OF CHARGER GUN DETECTION. " UBYTE default 1 0 0.000 255.000 BIT_MASK 0x40 /end MEASUREMENT
/begin MEASUREMENT B_CGUN " INLDS: CONDITION: CHARGER GUN DETECTION. " UBYTE default 1 0 0.000 255.000 BIT_MASK 0x20 /end MEASUREMENT
/begin MEASUREMENT B_CB2 " MRFCAUS : CONDITION: FCU CUT RELAY " UBYTE default 1 0 0.000 255.000 BIT_MASK 0x02 /end MEASUREMENT
/begin MEASUREMENT B_CB1 " MRDCAUS : CONDITION: DC/DC CUT RELAY(12V -> 24V) " UBYTE default 1 0 0.000 255.000 BIT_MASK 0x01 /end MEASUREMENT
/begin MEASUREMENT B_BOS " IODIGSIG: CONDITION: INPUT OF BOOST MODE SWITCH " UBYTE default 1 0 0.000 255.000 BIT_MASK 0x02 /end MEASUREMENT
/begin MEASUREMENT B_BLKFB " SWADAP: CONDITION: MIL BLINK ORDER FROM ANOTHER ECU " UBYTE default 1 0 0.000 255.000 BIT_MASK 0x08 /end MEASUREMENT
/begin MEASUREMENT B_BASE1 "ASC1DAT: CONDITION: ASC1 BASE 1ST ON " UBYTE default 1 0 0.000 255.000 BIT_MASK 0x20 /end MEASUREMENT
/begin MEASUREMENT B_ATSMIN " INATS: CONDITION: AMBIENT TEMPERATURE SENSOR VALUE IS MINIMUM. " UBYTE default 1 0 0.000 255.000 BIT_MASK 0x20 /end MEASUREMENT
/begin MEASUREMENT B_ATSMAX " INATS: CONDITION: AMBIENT TEMPERATURE SENSOR VALUE IS MAXIMUM. " UBYTE default 1 0 0.000 255.000 BIT_MASK 0x04 /end MEASUREMENT
/begin MEASUREMENT B_ASC1TRANSMITTED "ASC1DAT: CONDITION: TX WAS DONE " UBYTE default 1 0 0.000 255.000 BIT_MASK 0x01 /end MEASUREMENT
/begin MEASUREMENT B_ASC1RECEIVED "ASC1DAT: CONDITION: RX WAS DONE " UBYTE default 1 0 0.000 255.000 BIT_MASK 0x02 /end MEASUREMENT
/begin MEASUREMENT B_ASC1LOCKED "ASC1DAT: CONDITION: ASC1 START LOCKED " UBYTE default 1 0 0.000 255.000 BIT_MASK 0x08 /end MEASUREMENT
/begin MEASUREMENT B_ASC0TRANSMITTED "IRDA: CONDITION: TX WAS DONE " UBYTE default 1 0 0.000 255.000 BIT_MASK 0x01 /end MEASUREMENT
/begin MEASUREMENT B_ASC0LOCKED "IRDA: CONDITION: ASC0 START LOCKED " UBYTE default 1 0 0.000 255.000 BIT_MASK 0x08 /end MEASUREMENT
/begin MEASUREMENT B_ADTST " NULL  " UBYTE default 1 0 0.000 255.000 BIT_MASK 0x08 /end MEASUREMENT
/begin MEASUREMENT B_ADCKETRIGGER " NULL  " UBYTE default 1 0 0.000 255.000 BIT_MASK 0x04 /end MEASUREMENT
/begin CHARACTERISTIC ZNGFIL "  %ccng: time constant for engine gradient filter" VALUE 0xA8C8 DTYPE_UW 0 default 0.000000 65535.000000 /end CHARACTERISTIC
/begin CHARACTERISTIC ZKFSTV " infstt: time constant fuel level filter" VALUE 0xA8A0 DTYPE_UW 0 Compur_ZKFSTF_W 0.000000 65535.000000 /end CHARACTERISTIC
/begin CHARACTERISTIC ZKFLVL " ccfstt: time constant fuel level filter" VALUE 0xA8A4 DTYPE_UW 0 Compur_ZKFSTF_W 0.000000 65535.000000 /end CHARACTERISTIC
/begin CHARACTERISTIC ZKDFST " infstt: time constant fuel level difference filter" VALUE 0xA89E DTYPE_UW 0 Compur_ZKFSTF_W 0.000000 65535.000000 /end CHARACTERISTIC
/begin CHARACTERISTIC WRTSMIN " INRTS: Minimum input voltage for RTS minimum temperature threshold." VALUE 0xA83A DTYPE_UW 0 Compur_WSPA4_W 0.000000 320.007405 /end CHARACTERISTIC
/begin CHARACTERISTIC WRTSMAX " INRTS: Maximum input voltage for RTS maximum temperature threshold." VALUE 0xA83C DTYPE_UW 0 Compur_WSPA4_W 0.000000 320.007405 /end CHARACTERISTIC
/begin CHARACTERISTIC WRPSSCTMIN " INRPS: suct refrigerant pressure minimum threshold." VALUE 0xB6F0 DTYPE_UW 0 Compur_WSPA4_W 0.000000 320.007405 /end CHARACTERISTIC
/begin CHARACTERISTIC WRPSSCTMAX " INRPS: suct refrigerant pressure maximum threshold." VALUE 0xB6F2 DTYPE_UW 0 Compur_WSPA4_W 0.000000 320.007405 /end CHARACTERISTIC
/begin CHARACTERISTIC WRPSSBCMIN " INRPS: subcool refrigerant pressure minimum threshold." VALUE 0xA826 DTYPE_UW 0 Compur_WSPA4_W 0.000000 320.007405 /end CHARACTERISTIC
/begin CHARACTERISTIC WRPSSBCMAX " INRPS: subcool refrigerant pressure maximum threshold." VALUE 0xA828 DTYPE_UW 0 Compur_WSPA4_W 0.000000 320.007405 /end CHARACTERISTIC
/begin CHARACTERISTIC WLDSMIN " INLDS: laser detection sensor minimum threshold." VALUE 0xA80A DTYPE_UW 0 Compur_WSPA4_W 0.000000 320.007405 /end CHARACTERISTIC
/begin CHARACTERISTIC WLDSMAX " INLDS: laser detection sensor maximum threshold." VALUE 0xA80C DTYPE_UW 0 Compur_WSPA4_W 0.000000 320.007405 /end CHARACTERISTIC
/begin CHARACTERISTIC WHDSMIN " INHDS: H2 detection sensor minimum threshold." VALUE 0xA81A DTYPE_UW 0 Compur_WSPA4_W 0.000000 320.007405 /end CHARACTERISTIC
/begin CHARACTERISTIC WHDSMAX " INHDS: H2 detection sensor maximum threshold." VALUE 0xA81C DTYPE_UW 0 Compur_WSPA4_W 0.000000 320.007405 /end CHARACTERISTIC
/begin CHARACTERISTIC WETSMIN " INETS: Minimum input voltage for EXTS minimum temperature threshold." VALUE 0xA842 DTYPE_UW 0 Compur_WSPA4_W 0.000000 320.007405 /end CHARACTERISTIC
/begin CHARACTERISTIC WETSMAX " INETS: Maximum input voltage for EXTS maximum temperature threshold." VALUE 0xA844 DTYPE_UW 0 Compur_WSPA4_W 0.000000 320.007405 /end CHARACTERISTIC
/begin CHARACTERISTIC WCWTSMIN " INCWTS: Minimum input voltage for CWTS minimum temperature threshold." VALUE 0xA832 DTYPE_UW 0 Compur_WSPA4_W 0.000000 320.007405 /end CHARACTERISTIC
/begin CHARACTERISTIC WCWTSMAX " INCWTS: Maximum input voltage for CWTS maximum temperature threshold." VALUE 0xA834 DTYPE_UW 0 Compur_WSPA4_W 0.000000 320.007405 /end CHARACTERISTIC
/begin CHARACTERISTIC WATSMIN " INATS: Minimum input voltage for ATS minimum temperature threshold." VALUE 0xA82C DTYPE_UW 0 Compur_WSPA4_W 0.000000 320.007405 /end CHARACTERISTIC
/begin CHARACTERISTIC WATSMAX " INATS: Maximum input voltage for ATS maximum temperature threshold." VALUE 0xA82E DTYPE_UW 0 Compur_WSPA4_W 0.000000 320.007405 /end CHARACTERISTIC
/begin CHARACTERISTIC UFSTHYS " infstt: Hysteresis for fuel level voltage threshold" VALUE 0xA044 DTYPE_UB 0 Compur_WRTSSCT 0.000000 4.980405 /end CHARACTERISTIC
/begin CHARACTERISTIC UFSTDMX " infstt: Maximum fuel level voltage for diagnostic functions" VALUE 0xA043 DTYPE_UB 0 Compur_WRTSSCT 0.000000 4.980405 /end CHARACTERISTIC
/begin CHARACTERISTIC UFSTDMN " infstt: Minumum fuel level voltage for diagnostic functions" VALUE 0xA042 DTYPE_UB 0 Compur_WRTSSCT 0.000000 4.980405 /end CHARACTERISTIC
/begin CHARACTERISTIC UBNLMN " MOTAUS: lower limit for battery target voltage" VALUE 0xA079 DTYPE_UB 0 Compuc_UBNLMN 0.000000 32.296770 /end CHARACTERISTIC
/begin CHARACTERISTIC UBNFST " infstt: voltage standardization for tank level signal" VALUE 0xA89C DTYPE_UW 0 Compuc_UBNFST 0.000000 18431.718750 /end CHARACTERISTIC
/begin CHARACTERISTIC UBDMX " %inbv: maximum battery voltage" VALUE 0xA01E DTYPE_UB 0 Compuc_UBNLMN 0.000000 32.296770 /end CHARACTERISTIC
/begin CHARACTERISTIC UBDMN2 " %inbv: minimum battery voltage (ADC)" VALUE 0xA01D DTYPE_UB 0 Compuc_UBNLMN 0.000000 32.296770 /end CHARACTERISTIC
/begin CHARACTERISTIC UBDMN1 " %inbv: minimum battery voltage (power supply)" VALUE 0xA01C DTYPE_UB 0 Compuc_UBNLMN 0.000000 32.296770 /end CHARACTERISTIC
/begin CHARACTERISTIC UBDE " %inbv: replace value for UBATT at damaged AD-channel" VALUE 0xA804 DTYPE_UW 0 Compur_BATSQ_W 0.000000 47.971620 /end CHARACTERISTIC
/begin CHARACTERISTIC TWSVSSTF " DSVS: timer threshold for SVS on since engine start when FCM entries" VALUE 0xA08C DTYPE_UB 0 Compur_TTWSVSSTF 0.000000 65.280000 /end CHARACTERISTIC
/begin CHARACTERISTIC TWSVSST " DSVS: timer threshold for SVS on since engine start when no FCM entry" VALUE 0xA08B DTYPE_UB 0 Compur_TTWSVSSTF 0.000000 65.280000 /end CHARACTERISTIC
/begin CHARACTERISTIC TWSVSPZ " DSVS: Waiting period for pause between 2 digits within a blink code" VALUE 0xA08A DTYPE_UB 0 Compuc_TWSVSPZ 0.000000 16.320000 /end CHARACTERISTIC
/begin CHARACTERISTIC TWSVSPS " DSVS: time delay 1st break after start of blinkcode output" VALUE 0xA089 DTYPE_UB 0 Compur_TTWSVSSTF 0.000000 65.280000 /end CHARACTERISTIC
/begin CHARACTERISTIC TWSVSPC " DSVS: Waiting period for pause between 2 complete blink code output" VALUE 0xA088 DTYPE_UB 0 Compuc_TWSVSPZ 0.000000 16.320000 /end CHARACTERISTIC
/begin CHARACTERISTIC TWSVSINIF " DSVS: timer threshold for SVS on since ini when FCM entries" VALUE 0xA087 DTYPE_UB 0 Compur_TTWSVSSTF 0.000000 65.280000 /end CHARACTERISTIC
/begin CHARACTERISTIC TWSVSINI " DSVS: timer threshold for SVS on sinc`e ini when no FCM entry" VALUE 0xA086 DTYPE_UB 0 Compur_TTWSVSSTF 0.000000 65.280000 /end CHARACTERISTIC
/begin CHARACTERISTIC TWSVSENA " DSVS: ini time delay for SVS - from blinkcode output" VALUE 0xA085 DTYPE_UB 0 Compur_TTWSVSSTF 0.000000 65.280000 /end CHARACTERISTIC
/begin CHARACTERISTIC TVKL15 " infstt: delay time terminal 15" VALUE 0xA045 DTYPE_UB 0 Compuc_TVKL15 0.000000 261.120000 /end CHARACTERISTIC
/begin CHARACTERISTIC TNLSGMX " MOTAUS: Maximum time for ECM-switch-off delay" VALUE 0xA8CC DTYPE_UW 0 Compur_TOND_SWTOV 0.000000 8388.480000 /end CHARACTERISTIC
/begin CHARACTERISTIC TNLSGMN " MOTAUS: Minimum time for ECM-switch-off delay" VALUE 0xA8CA DTYPE_UW 0 Compur_TOND_SWTOV 0.000000 8388.480000 /end CHARACTERISTIC
/begin CHARACTERISTIC TLAED " %DMIL: elapse time for Reset B_milst" VALUE 0xA08E DTYPE_UB 0 Compuc_TLAED 0.000000 65.280000 /end CHARACTERISTIC
/begin CHARACTERISTIC THPERTTH "  inph: tooth period threshold." VALUE 0xA800 DTYPE_UW 0 Compuc_THPERTTH 0.000000 2097120.000000 /end CHARACTERISTIC
/begin CHARACTERISTIC THIRLEDON " IRDA: IR DIAG LED ON threshold" VALUE 0xA8D0 DTYPE_UW 0 Compur_WSPA4_W 0.000000 320.007405 /end CHARACTERISTIC
/begin CHARACTERISTIC THIRLEDOFF " IRDA: IR DIAG LED OFF threshold" VALUE 0xA8D2 DTYPE_UW 0 Compur_WSPA4_W 0.000000 320.007405 /end CHARACTERISTIC
/begin CHARACTERISTIC THCGUN "  INLDS: Charger gun detection threshold" VALUE 0xA812 DTYPE_UW 0 Compuc_THCGUN 0.000000 500.032050 /end CHARACTERISTIC
/begin CHARACTERISTIC TDUB " %inbv: delay time of voltage diagnosis" VALUE 0xA01B DTYPE_UB 0 Compur_TOND_SWTOV 0.000000 32.640000 /end CHARACTERISTIC
/begin CHARACTERISTIC TDNSUB " %inbv: time period for battery after start" VALUE 0xA802 DTYPE_UW 0 Compur_TOND_SWTOV 0.000000 8388.480000 /end CHARACTERISTIC
/begin CHARACTERISTIC TDNFRTS "  INRTS: turn-on-delay to confirm MIN or MAX error clear of RTS" VALUE 0xA037 DTYPE_UB 0 Compur_TOND_SWTOV 0.000000 32.640000 /end CHARACTERISTIC
/begin CHARACTERISTIC TDNFRPSSCT "  INRPS: turn-on-delay to confirm MIN or MAX error clear of RPS" VALUE 0xA031 DTYPE_UB 0 Compur_TOND_SWTOV 0.000000 32.640000 /end CHARACTERISTIC
/begin CHARACTERISTIC TDNFRPSSBC "  INRPS: turn-on-delay to confirm MIN or MAX error clear of subcool refrigerant RPS" VALUE 0xA02C DTYPE_UB 0 Compur_TOND_SWTOV 0.000000 32.640000 /end CHARACTERISTIC
/begin CHARACTERISTIC TDNFHDS "  INHDS: turn-on-delay to confirm MIN or MAX error clear of HDS" VALUE 0xA027 DTYPE_UB 0 Compur_TOND_SWTOV 0.000000 32.640000 /end CHARACTERISTIC
/begin CHARACTERISTIC TDNFETS "  INHHPS: turn-on-delay to confirm MIN or MAX error clear of ETS" VALUE 0xA039 DTYPE_UB 0 Compur_TOND_SWTOV 0.000000 32.640000 /end CHARACTERISTIC
/begin CHARACTERISTIC TDNFCWTS "  INCWTS: turn-on-delay to confirm MIN or MAX error clear of CWTS" VALUE 0xA035 DTYPE_UB 0 Compur_TOND_SWTOV 0.000000 32.640000 /end CHARACTERISTIC
/begin CHARACTERISTIC TDNFATS "  INHHPS: turn-on-delay to confirm MIN or MAX error clear of ATS" VALUE 0xA033 DTYPE_UB 0 Compur_TOND_SWTOV 0.000000 32.640000 /end CHARACTERISTIC
/begin CHARACTERISTIC TDMRCUTOFF " MOTAUS: Main Relay Cut-off time for engine stop" VALUE 0xA8CE DTYPE_UW 0 Compur_TDMRCUTOFF_W 0.000000 524.280000 /end CHARACTERISTIC
/begin CHARACTERISTIC TDLDS "  INLDS: turn-on-delay to confirm MIN or MAX error clear of LDS" VALUE 0xA021 DTYPE_UB 0 Compur_TOND_SWTOV 0.000000 32.640000 /end CHARACTERISTIC
/begin CHARACTERISTIC TDIRDIAG "  IRDA: time delay to confirm IR communication stop" VALUE 0xA07B DTYPE_UB 0 Compur_TOND_SWTOV 0.000000 32.640000 /end CHARACTERISTIC
/begin CHARACTERISTIC TDIRDHL "  IRDA: turn-on-delay to IR communication healing" VALUE 0xA07C DTYPE_UB 0 Compur_TOND_SWTOV 0.000000 32.640000 /end CHARACTERISTIC
/begin CHARACTERISTIC TDCGUNCHK "  CCSTMFC: turn-on-delay to confirm charger gun detection after B_cgun=T" VALUE 0xA073 DTYPE_UB 0 Compur_TOND_SWTOV 0.000000 32.640000 /end CHARACTERISTIC
/begin CHARACTERISTIC TDCGUN "  INLDS: turn-on-delay to confirm charger gun detection" VALUE 0xA022 DTYPE_UB 0 Compur_TOND_SWTOV 0.000000 32.640000 /end CHARACTERISTIC
/begin CHARACTERISTIC SYSLISOC "  CAN4:Lithium battery SOC" VALUE 0xA083 DTYPE_UB 0 Compur_SYSLISOC_B 0.000000 255.000000 /end CHARACTERISTIC
/begin CHARACTERISTIC SP_VAPSOLPRSNT "  SYSPAR, 1= present of Vaporizer solenoid, 0 = No present" VALUE 0xA00E DTYPE_UB 0 default 0.000000 255.000000 /end CHARACTERISTIC
/begin CHARACTERISTIC SP_SWTYPE " INFCSW, 1= use push-button switch, 0= use toggle switch." VALUE 0xA03A DTYPE_UB 0 default 0.000000 255.000000 /end CHARACTERISTIC
/begin CHARACTERISTIC SP_RPMFILTER "  SYSPAR, 1= use rpm filtering, 0 = No use rpm filtering" VALUE 0xA00F DTYPE_UB 0 default 0.000000 255.000000 /end CHARACTERISTIC
/begin CHARACTERISTIC SP_ROMVER " SYSPAR, ROM version 1= AVEO, 2= OPTRA" VALUE 0xA076 DTYPE_UB 0 default 0.000000 255.000000 /end CHARACTERISTIC
/begin CHARACTERISTIC SP_PHENUM " SYSPAR, edge number on cam wheel (default = 0 for 1 pole cam sensor)." VALUE 0xA00A DTYPE_UB 0 default 0.000000 255.000000 /end CHARACTERISTIC
/begin CHARACTERISTIC SP_NTTHREV " SYSPAR, Number of tooth for crank wheel." VALUE 0xA009 DTYPE_UB 0 default 0.000000 255.000000 /end CHARACTERISTIC
/begin CHARACTERISTIC SP_NTDC0 " SYSPAR, NUMBER OF TOOTH OF TDC 1 (= 1st TDC) AFTER MISSING TOOTH." VALUE 0xA008 DTYPE_UB 0 default 0.000000 255.000000 /end CHARACTERISTIC
/begin CHARACTERISTIC SP_MAPUSTYP " SYSPAR, 1= use system MAP, 0= use In-house sensor." VALUE 0xA002 DTYPE_UB 0 default 0.000000 255.000000 /end CHARACTERISTIC
/begin CHARACTERISTIC SP_KWP2000 " SYSPAR, 1= KWP2000 protocol mode enable, 0= disable" VALUE 0xA001 DTYPE_UB 0 default 0.000000 255.000000 /end CHARACTERISTIC
/begin CHARACTERISTIC SP_FTSPRSNT " SYSPAR, 1= present of FTS, 0= no present FTS." VALUE 0xA003 DTYPE_UB 0 default 0.000000 255.000000 /end CHARACTERISTIC
/begin CHARACTERISTIC SP_FSTT " SYSPAR, 1= AD_FSTT2_CH, 0= AD_FSTT_CH" VALUE 0xA010 DTYPE_UB 0 default 0.000000 255.000000 /end CHARACTERISTIC
/begin CHARACTERISTIC SP_FPLPRSNT " SYSPAR, 1= present of FPL, 0= no present FPL." VALUE 0xA004 DTYPE_UB 0 default 0.000000 255.000000 /end CHARACTERISTIC
/begin CHARACTERISTIC SP_FPHPRSNT " SYSPAR, 1= present of FPH, 0= no present FPH." VALUE 0xA005 DTYPE_UB 0 default 0.000000 255.000000 /end CHARACTERISTIC
/begin CHARACTERISTIC SP_FC4FSO "  SYSPAR, 1= Use fuel cut condition for fuel switching, 0= Do not use fuel cut condition for fuel switching" VALUE 0xA00C DTYPE_UB 0 default 0.000000 255.000000 /end CHARACTERISTIC
/begin CHARACTERISTIC SP_EFPSTPCTL "  SYSPAR, select efp control method. 0= Use table values, 1= use gear step selection" VALUE 0xA00D DTYPE_UB 0 default 0.000000 255.000000 /end CHARACTERISTIC
/begin CHARACTERISTIC SP_EFPPRSNT " SYSPAR, 1= present of fuel pump driver, 0= no present fuel pump driver." VALUE 0xA006 DTYPE_UB 0 default 0.000000 255.000000 /end CHARACTERISTIC
/begin CHARACTERISTIC SP_CYLNUM " SYSPAR, Number of cylinder in the engine." VALUE 0xA007 DTYPE_UB 0 default 0.000000 255.000000 /end CHARACTERISTIC
/begin CHARACTERISTIC SP_CTLSPK " SYSPAR, 1= Enable of Ignition control, 0= disable" VALUE 0xA000 DTYPE_UB 0 default 0.000000 255.000000 /end CHARACTERISTIC
/begin CHARACTERISTIC RPSSCTOFS " INRPS: suct refrigerant Pressure low input offset" VALUE 0xB6EC DTYPE_SW 0 Compuc_RPSSCTOFS -3140.091904 3139.996076 /end CHARACTERISTIC
/begin CHARACTERISTIC RPSSCTLOW "  INRPS: H2 fuel pressure low threshold" VALUE 0xA02D DTYPE_UB 0 Compur_FPL 0.000000 3127.734375 /end CHARACTERISTIC
/begin CHARACTERISTIC RPSSCTHIGH "  INRPS: H2 fuel pressure high threshold" VALUE 0xA02E DTYPE_UB 0 Compur_FPL 0.000000 3127.734375 /end CHARACTERISTIC
/begin CHARACTERISTIC RPSSCTGRAD " INRPS: Gradient for suct refrigerant pressure sensor low." VALUE 0xB6EA DTYPE_UW 0 Compuc_RPSSCTGRAD 0.000000 643062.187500 /end CHARACTERISTIC
/begin CHARACTERISTIC RPSSBCOFS " INRPS: subcool refrigerant Pressure low input offset" VALUE 0xA822 DTYPE_SW 0 Compuc_RPSSCTOFS -3140.091904 3139.996076 /end CHARACTERISTIC
/begin CHARACTERISTIC RPSSBCLOW "  INRPS: subcool refrigerant low threshold" VALUE 0xA028 DTYPE_UB 0 Compur_FPL 0.000000 3127.734375 /end CHARACTERISTIC
/begin CHARACTERISTIC RPSSBCHIGH "  INRPS: subcool refrigerant high threshold" VALUE 0xA029 DTYPE_UB 0 Compur_FPL 0.000000 3127.734375 /end CHARACTERISTIC
/begin CHARACTERISTIC RPSSBCGRAD " INRPS: Gradient for subcool refrigerant pressure sensor low." VALUE 0xA820 DTYPE_UW 0 Compuc_RPSSCTGRAD 0.000000 643062.187500 /end CHARACTERISTIC
/begin CHARACTERISTIC PNGDERPSSCT " INRPS: Inital reference value of RPS SCT." VALUE 0xB6EE DTYPE_UW 0 Compur_RPSSCTO_W 0.000000 3139.978455 /end CHARACTERISTIC
/begin CHARACTERISTIC PNGDERPSSBC " INRPS: Inital reference value of RPS SBC." VALUE 0xA824 DTYPE_UW 0 Compur_RPSSCTO_W 0.000000 3139.978455 /end CHARACTERISTIC
/begin CHARACTERISTIC PINSULRES "  CAN4:BMS+ insulation resistance" VALUE 0xA8DC DTYPE_UW 0 Compur_PINSULRES_W 0.000000 65535.000000 /end CHARACTERISTIC
/begin CHARACTERISTIC NINSULRES "  CAN4:BMS- insulation resistance" VALUE 0xA8DE DTYPE_UW 0 Compur_PINSULRES_W 0.000000 65535.000000 /end CHARACTERISTIC
/begin CHARACTERISTIC NENGSTL " ENGSTALL: engine speed minimum threshold to set engine stall" VALUE 0xA8C6 DTYPE_UW 0 Compur_NMOTRSP_W[5] 0.000000 16383.750000 /end CHARACTERISTIC
/begin CHARACTERISTIC LDSOFS " INLDS: offset of laser detection sensor" VALUE 0xA808 DTYPE_SW 0 Compuc_LDSOFS -500.039680 500.024420 /end CHARACTERISTIC
/begin CHARACTERISTIC LDSNEAR "  INLDS: LDS too near threshold." VALUE 0xA80E DTYPE_UW 0 Compuc_THCGUN 0.000000 500.032050 /end CHARACTERISTIC
/begin CHARACTERISTIC LDSGRAD " INLDS: Gradient for laser detection sensor" VALUE 0xA806 DTYPE_UW 0 Compuc_LDSGRAD 0.000000 102399.748200 /end CHARACTERISTIC
/begin CHARACTERISTIC LDSFAR "  INLDS: LDS too far threshold" VALUE 0xA810 DTYPE_UW 0 Compuc_THCGUN 0.000000 500.032050 /end CHARACTERISTIC
/begin CHARACTERISTIC KLFLVL " ccfstt: fuel tank level characteristic line" CURVE 0xA058 DTYPE_UB 0 Compur_RGVTAF_B 0.000000 128.000000
 /begin AXIS_DESCR FIX_AXIS RFSTT_B Compur_RGVTAF_B 17 0.000000 128.000000 FIX_AXIS_PAR_DIST 0 16 17 /end AXIS_DESCR
/end CHARACTERISTIC
/begin CHARACTERISTIC KFLVLMD "  ccfstt: upper hysteresis to change fuel level gear state (low --> middle)" VALUE 0xA06F DTYPE_UB 0 Compur_RGVTAF_B 0.000000 127.500000 /end CHARACTERISTIC
/begin CHARACTERISTIC KFLVLLO "  ccfstt: upper hysteresis to change fuel level gear state (empty --> low)" VALUE 0xA070 DTYPE_UB 0 Compur_RGVTAF_B 0.000000 127.500000 /end CHARACTERISTIC
/begin CHARACTERISTIC KFLVLHI "  ccfstt: upper hysteresis to change fuel level gear state (middle--> high)" VALUE 0xA06E DTYPE_UB 0 Compur_RGVTAF_B 0.000000 127.500000 /end CHARACTERISTIC
/begin CHARACTERISTIC KFLVLFL "  ccfstt: upper hysteresis to change fuel level state (high--> full)" VALUE 0xA06D DTYPE_UB 0 Compur_RGVTAF_B 0.000000 127.500000 /end CHARACTERISTIC
/begin CHARACTERISTIC KFLVLEMT "  ccfstt: upper hysteresis to change fuel level gear state (under empty)" VALUE 0xA071 DTYPE_UB 0 Compur_RGVTAF_B 0.000000 127.500000 /end CHARACTERISTIC
/begin CHARACTERISTIC KDFLVLMD "  ccfstt: delta hysteresis to change fuel level indication from middle state" VALUE 0xA06B DTYPE_UB 0 Compur_RGVTAF_B 0.000000 127.500000 /end CHARACTERISTIC
/begin CHARACTERISTIC KDFLVLLO "  ccfstt: delta hysteresis to change fuel level indication from low state" VALUE 0xA06C DTYPE_UB 0 Compur_RGVTAF_B 0.000000 127.500000 /end CHARACTERISTIC
/begin CHARACTERISTIC KDFLVLHI "  ccfstt: delta hysteresis to change fuel level indication from high state" VALUE 0xA06A DTYPE_UB 0 Compur_RGVTAF_B 0.000000 127.500000 /end CHARACTERISTIC
/begin CHARACTERISTIC KDFLVLFL "  ccfstt: delta hysteresis to change fuel level indication from full state" VALUE 0xA069 DTYPE_UB 0 Compur_RGVTAF_B 0.000000 127.500000 /end CHARACTERISTIC
/begin CHARACTERISTIC IRIDL_MAXTIME "  IRDA: Wake up maximum time IR COmmunication" VALUE 0xA07D DTYPE_UB 0 Compuc_IRIDL_MAXTIME 0.000000 130.560000 /end CHARACTERISTIC
/begin CHARACTERISTIC IDL_MAXTIME "  ASC1DAT: Wake up maximum time" VALUE 0xA090 DTYPE_UB 0 Compur_ZKFSTF_W 0.000000 255.000000 /end CHARACTERISTIC
/begin CHARACTERISTIC HYEVSOCLOE "  CCSTMFC: Battery SOC resume charging LO limit in ECO mode" VALUE 0xA8B4 DTYPE_UW 0 Compur_ESOCC_W 0.000000 102.431205 /end CHARACTERISTIC
/begin CHARACTERISTIC HYEVSOCLOB3 "  CCSTMFC: Battery SOC resume charging LO limit in BOOST mode 3rd" VALUE 0xA8C0 DTYPE_UW 0 Compur_ESOCC_W 0.000000 102.431205 /end CHARACTERISTIC
/begin CHARACTERISTIC HYEVSOCLOB2 "  CCSTMFC: Battery SOC resume charging LO limit in BOOST mode 2nd" VALUE 0xA8BC DTYPE_UW 0 Compur_ESOCC_W 0.000000 102.431205 /end CHARACTERISTIC
/begin CHARACTERISTIC HYEVSOCLOB1 "  CCSTMFC: Battery SOC resume charging LO limit in BOOST mode 1st" VALUE 0xA8B8 DTYPE_UW 0 Compur_ESOCC_W 0.000000 102.431205 /end CHARACTERISTIC
/begin CHARACTERISTIC HYEVSOCHIE "  CCSTMFC: Battery SOC stop charging HI limit in ECO mode" VALUE 0xA8B2 DTYPE_UW 0 Compur_ESOCC_W 0.000000 102.431205 /end CHARACTERISTIC
/begin CHARACTERISTIC HYEVSOCHIB3 "  CCSTMFC: Battery SOC stop charging HI limit in BOOST mode 3rd" VALUE 0xA8BE DTYPE_UW 0 Compur_ESOCC_W 0.000000 102.431205 /end CHARACTERISTIC
/begin CHARACTERISTIC HYEVSOCHIB2 "  CCSTMFC: Battery SOC stop charging HI limit in BOOST mode 2nd" VALUE 0xA8BA DTYPE_UW 0 Compur_ESOCC_W 0.000000 102.431205 /end CHARACTERISTIC
/begin CHARACTERISTIC HYEVSOCHIB1 "  CCSTMFC: Battery SOC stop charging HI limit in BOOST mode 1st" VALUE 0xA8B6 DTYPE_UW 0 Compur_ESOCC_W 0.000000 102.431205 /end CHARACTERISTIC
/begin CHARACTERISTIC HVSETVOLT "  CCSTMFC:Nominal Charging  voltage (14bits)" VALUE 0xA8A6 DTYPE_UW 0 Compur_POWERONHOURS_L 0.000000 6553.500000 /end CHARACTERISTIC
/begin CHARACTERISTIC HVSETPWRE "  CCSTMFC:Set Charging power (Economy mode)" VALUE 0xA8A8 DTYPE_UW 0 Compur_WATERPUMPPOWER_B 0.000000 6553.500000 /end CHARACTERISTIC
/begin CHARACTERISTIC HVSETPWRD "  CCSTMFC:Set Charging power (Default)" VALUE 0xA8B0 DTYPE_UW 0 Compur_WATERPUMPPOWER_B 0.000000 6553.500000 /end CHARACTERISTIC
/begin CHARACTERISTIC HVSETPWRB3 "  CCSTMFC:Set Charging power (Boost mode 3rd)" VALUE 0xA8AE DTYPE_UW 0 Compur_WATERPUMPPOWER_B 0.000000 6553.500000 /end CHARACTERISTIC
/begin CHARACTERISTIC HVSETPWRB2 "  CCSTMFC:Set Charging power (Boost mode 2nd)" VALUE 0xA8AC DTYPE_UW 0 Compur_WATERPUMPPOWER_B 0.000000 6553.500000 /end CHARACTERISTIC
/begin CHARACTERISTIC HVSETPWRB1 "  CCSTMFC:Set Charging power (Boost mode 1st)" VALUE 0xA8AA DTYPE_UW 0 Compur_WATERPUMPPOWER_B 0.000000 6553.500000 /end CHARACTERISTIC
/begin CHARACTERISTIC HFMOFS " INHFM: offset of H2 gas flow meter" VALUE 0xA816 DTYPE_SW 0 Compuc_HFMOFS -2000.060416 1999.999379 /end CHARACTERISTIC
/begin CHARACTERISTIC HFMGRAD " INHFM: Gradient for H2 gas flow meter" VALUE 0xA814 DTYPE_UW 0 Compuc_HFMGRAD 0.000000 409593.750000 /end CHARACTERISTIC
/begin CHARACTERISTIC HDSOFS " INHDS: H2 detection sensor input offset" VALUE 0xA023 DTYPE_SB 0 Compuc_HDSOFS -4.000000 3.968750 /end CHARACTERISTIC
/begin CHARACTERISTIC HDSHIGH "  INHDS: H2 detection high threshold" VALUE 0xA024 DTYPE_UB 0 Compur_HDS3_B 0.000000 3.984375 /end CHARACTERISTIC
/begin CHARACTERISTIC HDSGRAD " INHDS: Gradient for H2 detection sensor." VALUE 0xA818 DTYPE_UW 0 Compuc_HDSGRAD 0.000000 819.187500 /end CHARACTERISTIC
/begin CHARACTERISTIC GVTMX " infstt: maximum gas capacity fuel tank" VALUE 0xA89A DTYPE_UW 0 Compur_GVTAF_W 0.000000 1012.515750 /end CHARACTERISTIC
/begin CHARACTERISTIC GAP2DPID " %TGRDPID: Time gap between two DPID" VALUE 0xA08F DTYPE_UB 0 default 0.000000 255.000000 /end CHARACTERISTIC
/begin CHARACTERISTIC FSTTU " infstt: fuel level characteristic line" CURVE 0xA878 DTYPE_UW 0 Compur_GVTAF_W 0.000000 1012.531200
 /begin AXIS_DESCR FIX_AXIS UNFST_B Compur_UNFST_B 17 0.000000 5.019648 FIX_AXIS_PAR_DIST 0 16 17 /end AXIS_DESCR
/end CHARACTERISTIC
/begin CHARACTERISTIC FSTTMX " infstt: Maximum fuel tank capacity" VALUE 0xA852 DTYPE_UW 0 Compur_GVTAF_W 0.000000 1012.515750 /end CHARACTERISTIC
/begin CHARACTERISTIC FSTTEW " infstt: fuel level replacement value" VALUE 0xA850 DTYPE_UW 0 Compur_GVTAF_W 0.000000 1012.515750 /end CHARACTERISTIC
/begin CHARACTERISTIC FSTTDE " infstt: Initial default value for fuel level" VALUE 0xA8A2 DTYPE_UW 0 Compur_GVTAF_W 0.000000 1012.515750 /end CHARACTERISTIC
/begin CHARACTERISTIC FSTTAV " infstt: High level threshold" VALUE 0xA84E DTYPE_UW 0 Compur_GVTAF_W 0.000000 1012.515750 /end CHARACTERISTIC
/begin CHARACTERISTIC FSTTAL " infstt: Low-fuel level threshold" VALUE 0xA84C DTYPE_UW 0 Compur_GVTAF_W 0.000000 1012.515750 /end CHARACTERISTIC
/begin CHARACTERISTIC FSTHYS " infstt: Hysteresis for fuel level thresholds" VALUE 0xA84A DTYPE_UW 0 Compur_GVTAF_W 0.000000 1012.515750 /end CHARACTERISTIC
/begin CHARACTERISTIC FSTDTOL " infstt: tolerance fuel level dynamic" VALUE 0xA848 DTYPE_UW 0 Compur_GVTAF_W 0.000000 1012.515750 /end CHARACTERISTIC
/begin CHARACTERISTIC FCFTPY "  ASC1DAT: FC Power display position Y" VALUE 0xA8E4 DTYPE_UW 0 default 0.000000 65535.000000 /end CHARACTERISTIC
/begin CHARACTERISTIC FCFTPX "  ASC1DAT: FC Power display position X" VALUE 0xA8E2 DTYPE_UW 0 default 0.000000 65535.000000 /end CHARACTERISTIC
/begin CHARACTERISTIC FCDCSY "  ASC1DAT: FC Power display clear size Y" VALUE 0xA8EC DTYPE_UW 0 default 0.000000 65535.000000 /end CHARACTERISTIC
/begin CHARACTERISTIC FCDCSX "  ASC1DAT: FC Power display clear size X" VALUE 0xA8EA DTYPE_UW 0 default 0.000000 65535.000000 /end CHARACTERISTIC
/begin CHARACTERISTIC FCDCPY "  ASC1DAT: FC Power display clear position Y" VALUE 0xA8E8 DTYPE_UW 0 default 0.000000 65535.000000 /end CHARACTERISTIC
/begin CHARACTERISTIC FCDCPX "  ASC1DAT: FC Power display clear position X" VALUE 0xA8E6 DTYPE_UW 0 default 0.000000 65535.000000 /end CHARACTERISTIC
/begin CHARACTERISTIC FCAMPCMAX "  CAN4:Max allowable charging current" VALUE 0xA8DA DTYPE_UW 0 Compur_HVSETCURRC_W 0.000000 6553.500000 /end CHARACTERISTIC
/begin CHARACTERISTIC CWVEHICLEON "  CAN4:Test value of Vehicle ON" VALUE 0xA07F DTYPE_UB 0 Compur_TXLENGTH_W 0.000000 255.000000 /end CHARACTERISTIC
/begin CHARACTERISTIC CWTCV3INV "  IODIGSIG: Codeword TCV3 relay output control" VALUE 0xA014 DTYPE_UB 0 default 0.000000 255.000000 /end CHARACTERISTIC
/begin CHARACTERISTIC CWTCV2INV "  IODIGSIG: Codeword TCV2 relay output control" VALUE 0xA015 DTYPE_UB 0 default 0.000000 255.000000 /end CHARACTERISTIC
/begin CHARACTERISTIC CWTCV1INV "  IODIGSIG: Codeword TCV1 relay output control" VALUE 0xA016 DTYPE_UB 0 default 0.000000 255.000000 /end CHARACTERISTIC
/begin CHARACTERISTIC CWSVS " DSVS: Code word: Activation of the Service Vehicle Soon Lamp" VALUE 0xA8E0 DTYPE_UW 0 default 0.000000 65535.000000 /end CHARACTERISTIC
/begin CHARACTERISTIC CWSETVOLT "  CAN4:Test Value of Lithium battery voltage" VALUE 0xA8D4 DTYPE_UW 0 Compur_POWERONHOURS_L 0.000000 6553.500000 /end CHARACTERISTIC
/begin CHARACTERISTIC CWSETPOWER "  CAN4:Test Value of Charging power" VALUE 0xA8D8 DTYPE_UW 0 Compur_WATERPUMPPOWER_B 0.000000 6553.500000 /end CHARACTERISTIC
/begin CHARACTERISTIC CWSETCURR "  CAN4:Test Value of Charging current" VALUE 0xA8D6 DTYPE_UW 0 Compur_HVSETCURRC_W 0.000000 6553.500000 /end CHARACTERISTIC
/begin CHARACTERISTIC CWPWF " %PWFD: CodeWord PowerFail" VALUE 0xA093 DTYPE_UB 0 default 0.000000 255.000000 /end CHARACTERISTIC
/begin CHARACTERISTIC CWOBD " PROCON:" VALUE 0xA092 DTYPE_UB 0 default 0.000000 255.000000 /end CHARACTERISTIC
/begin CHARACTERISTIC CWNOMIL " %DMIL: Codeword MIL not active, 0 = MIL active; 1 = MIL NOT active" VALUE 0xA08D DTYPE_UB 0 default 0.000000 255.000000 /end CHARACTERISTIC
/begin CHARACTERISTIC CWMRINV "  IODIGSIG: Codeword main relay output control" VALUE 0xA013 DTYPE_UB 0 default 0.000000 255.000000 /end CHARACTERISTIC
/begin CHARACTERISTIC CWMRFCAUS "  MRFCAUS: Test codeword MRFCAUS" VALUE 0xA075 DTYPE_UB 0 default 0.000000 255.000000 /end CHARACTERISTIC
/begin CHARACTERISTIC CWMRDCAUS "  MRDCAUS: TEST Codeword for MRDCAUS" VALUE 0xA074 DTYPE_UB 0 default 0.000000 255.000000 /end CHARACTERISTIC
/begin CHARACTERISTIC CWIRDA "  IRDA:Codeword IRDA" VALUE 0xA07E DTYPE_UB 0 Compur_TXLENGTH_W 0.000000 255.000000 /end CHARACTERISTIC
/begin CHARACTERISTIC CWHVSTATE "  CAN4:Test value of Running state of vehicle" VALUE 0xA081 DTYPE_UB 0 Compur_TXLENGTH_W 0.000000 255.000000 /end CHARACTERISTIC
/begin CHARACTERISTIC CWGGFST " infstt: Codeword fuel level gauge" VALUE 0xA041 DTYPE_UB 0 default 0.000000 255.000000 /end CHARACTERISTIC
/begin CHARACTERISTIC CWFUELCELLON "  CAN4:Test value of Fuel cell ON" VALUE 0xA080 DTYPE_UB 0 Compur_TXLENGTH_W 0.000000 255.000000 /end CHARACTERISTIC
/begin CHARACTERISTIC CWFCSWINV "  IODIGSIG: Codeword fuelcell selection switch signal control" VALUE 0xA019 DTYPE_UB 0 default 0.000000 255.000000 /end CHARACTERISTIC
/begin CHARACTERISTIC CWFCSHUTDOWN "  CAN4:Test value of Fuel cell emergency stop" VALUE 0xA082 DTYPE_UB 0 Compur_TXLENGTH_W 0.000000 255.000000 /end CHARACTERISTIC
/begin CHARACTERISTIC CWERFIL " PROCON:" VALUE 0xA091 DTYPE_UB 0 default 0.000000 255.000000 /end CHARACTERISTIC
/begin CHARACTERISTIC CWEOLTST "  INDIGSIG: Codeword EOL test signal test input" VALUE 0xA012 DTYPE_UB 0 default 0.000000 255.000000 /end CHARACTERISTIC
/begin CHARACTERISTIC CWCCFSTT "  ccfstt: bit option of function %ccfstt" VALUE 0xA072 DTYPE_UB 0 default 0.000000 255.000000 /end CHARACTERISTIC
/begin CHARACTERISTIC CWCB2INV "  IODIGSIG: Codeword CB2 output control" VALUE 0xA017 DTYPE_UB 0 default 0.000000 255.000000 /end CHARACTERISTIC
/begin CHARACTERISTIC CWCB1INV "  IODIGSIG: Codeword CB1 output control" VALUE 0xA018 DTYPE_UB 0 default 0.000000 255.000000 /end CHARACTERISTIC
/begin CHARACTERISTIC CWBOSSWINV "  IODIGSIG: Codeword boost mode switch signal control" VALUE 0xA01A DTYPE_UB 0 default 0.000000 255.000000 /end CHARACTERISTIC
/begin CHARACTERISTIC CWADCHK "  ADINPUT: Codeword ADC check counter enable" VALUE 0xA011 DTYPE_UB 0 default 0.000000 255.000000 /end CHARACTERISTIC
/begin CHARACTERISTIC CW_RPMK " CCRPM: Codeword to use rpm information from K-Line (1=use, 0=don't use)" VALUE 0xA077 DTYPE_UB 0 default 0.000000 255.000000 /end CHARACTERISTIC
/begin CHARACTERISTIC CW_RPMC " CCRPM: Codeword to use rpm information from CAN (1=use, 0=don't use)" VALUE 0xA078 DTYPE_UB 0 default 0.000000 255.000000 /end CHARACTERISTIC
/begin CHARACTERISTIC CTRLPGSWON " INFCSW: fuel cell switch on delay counter" VALUE 0xA03D DTYPE_UB 0 Compur_CTRLPGSWON_B 0.000000 8.160000 /end CHARACTERISTIC
/begin CHARACTERISTIC CTREOLGASSW " INFCSW: Reference value of ctreoltest_b for gas SW reset control." VALUE 0xA03F DTYPE_UB 0 default 0.000000 255.000000 /end CHARACTERISTIC
/begin CHARACTERISTIC CRPMMIN " ENGSTALL: minimum engine speed threshold" VALUE 0xA8C2 DTYPE_UW 0 Compur_NMOTRSP_W[5] 0.000000 16383.750000 /end CHARACTERISTIC
/begin CHARACTERISTIC CPSTYPE "  SYSPAR, 1= CRANK ANGLE monitoring On, 0= crank angle monitoring off." VALUE 0xA00B DTYPE_UB 0 default 0.000000 255.000000 /end CHARACTERISTIC
/begin CHARACTERISTIC CHKSUM " ROM DATA CHECK SUM" VALUE 0xEFFE DTYPE_UW 0 default 0.000000 65535.000000 /end CHARACTERISTIC
/begin CHARACTERISTIC CFTRPSSCT "  INRPS: constant filtering time for low pressure sensor value" VALUE 0xA02F DTYPE_UB 0 Compuc_CFTRPSSCT 0.000000 255.000000 /end CHARACTERISTIC
/begin CHARACTERISTIC CFTRPSSBC "  INRPS: constant filtering time for subcool refrigerant sensor value" VALUE 0xA02A DTYPE_UB 0 Compuc_CFTRPSSCT 0.000000 255.000000 /end CHARACTERISTIC
/begin CHARACTERISTIC CFTHDS "  INHDS: constant filtering time for H2 detection sensor value" VALUE 0xA025 DTYPE_UB 0 Compuc_CFTRPSSCT 0.000000 255.000000 /end CHARACTERISTIC
/begin CHARACTERISTIC CENGSTALL " ENGSTALL: engine speed threshold to enable engine stall detection" VALUE 0xA8C4 DTYPE_UW 0 Compur_NMOTRSP_W[5] 0.000000 16383.750000 /end CHARACTERISTIC
/begin CHARACTERISTIC CDLYWRTSMNMX "  INRTS: turn-on-delay to confirm MIN or MAX error of RTS" VALUE 0xA036 DTYPE_UB 0 Compur_TOND_SWTOV 0.000000 32.640000 /end CHARACTERISTIC
/begin CHARACTERISTIC CDLYWRPSSCTMNMX "  INRPS: turn-on-delay to confirm MIN or MAX error of RPS" VALUE 0xA030 DTYPE_UB 0 Compur_TOND_SWTOV 0.000000 32.640000 /end CHARACTERISTIC
/begin CHARACTERISTIC CDLYWRPSSBCMNMX "  INRPS: turn-on-delay to confirm MIN or MAX error of subcool refrigerant RPS" VALUE 0xA02B DTYPE_UB 0 Compur_TOND_SWTOV 0.000000 32.640000 /end CHARACTERISTIC
/begin CHARACTERISTIC CDLYWLDSMNMX "  INLDS: turn-on-delay to confirm MIN or MAX error of LDS" VALUE 0xA01F DTYPE_UB 0 Compur_TOND_SWTOV 0.000000 32.640000 /end CHARACTERISTIC
/begin CHARACTERISTIC CDLYWHDSMNMX "  INHDS: turn-on-delay to confirm MIN or MAX error of HDS" VALUE 0xA026 DTYPE_UB 0 Compur_TOND_SWTOV 0.000000 32.640000 /end CHARACTERISTIC
/begin CHARACTERISTIC CDLYWETSMNMX "  INHHPS: turn-on-delay to confirm MIN or MAX error of ETS" VALUE 0xA038 DTYPE_UB 0 Compur_TOND_SWTOV 0.000000 32.640000 /end CHARACTERISTIC
/begin CHARACTERISTIC CDLYWCWTSMNMX "  INCWTS: turn-on-delay to confirm MIN or MAX error of CWTS" VALUE 0xA034 DTYPE_UB 0 Compur_TOND_SWTOV 0.000000 32.640000 /end CHARACTERISTIC
/begin CHARACTERISTIC CDLYWATSMNMX "  INHHPS: turn-on-delay to confirm MIN or MAX error of ATS" VALUE 0xA032 DTYPE_UB 0 Compur_TOND_SWTOV 0.000000 32.640000 /end CHARACTERISTIC
/begin CHARACTERISTIC CDLYSWTOV " INFCSW: Delay time to validate turning over of fuel cell switch" VALUE 0xA03E DTYPE_UB 0 Compur_TOND_SWTOV 0.000000 32.640000 /end CHARACTERISTIC
/begin CHARACTERISTIC CDLYLPGSW2 " INFCSW: delay time to validate fuel cell switch input for push-button switch" VALUE 0xA03C DTYPE_UB 0 Compur_TOND_SWTOV 0.000000 32.640000 /end CHARACTERISTIC
/begin CHARACTERISTIC CDLYLPGSW " INFCSW: delay time to validate fuel cell switch input" VALUE 0xA03B DTYPE_UB 0 Compur_TOND_SWTOV 0.000000 32.640000 /end CHARACTERISTIC
/begin CHARACTERISTIC CDLYLDSSG "  INLDS: turn-on-delay to confirm signal error of LDS" VALUE 0xA020 DTYPE_UB 0 Compur_TOND_SWTOV 0.000000 32.640000 /end CHARACTERISTIC
/begin CHARACTERISTIC CDLYIRDIAGMX "  IRDA: turn-on-delay to confirm IR Communication error" VALUE 0xA07A DTYPE_UB 0 Compur_TOND_SWTOV 0.000000 32.640000 /end CHARACTERISTIC
/begin CHARACTERISTIC AMBIENTTEMPERATURE "  CAN4:environment temperature" VALUE 0xA084 DTYPE_UB 0 Compur_FCWTOUT_B -40.000000 215.000000 /end CHARACTERISTIC
/begin CHARACTERISTIC AFSTB " infstt: debounce counter fuel tank condition" VALUE 0xA040 DTYPE_UB 0 default 0.000000 255.000000 /end CHARACTERISTIC
/begin CHARACTERISTIC ADWRTSSCT " INRTS: Test input AD value for PE coolant temperature." VALUE 0xA840 DTYPE_UW 0 Compur_WSPA4_W 0.000000 320.007405 /end CHARACTERISTIC
/begin CHARACTERISTIC ADWRTSSBC " INRTS: Test input AD value for battery coolant temperature." VALUE 0xA83E DTYPE_UW 0 Compur_WSPA4_W 0.000000 320.007405 /end CHARACTERISTIC
/begin CHARACTERISTIC ADWRPSSCT " INRPS: test suct refrigerant pressure input as AD values." VALUE 0xB6F4 DTYPE_UW 0 Compur_WSPA4_W 0.000000 320.007405 /end CHARACTERISTIC
/begin CHARACTERISTIC ADWRPSSBC " INRPS: test subcool refrigerant pressure input as AD values." VALUE 0xA82A DTYPE_UW 0 Compur_WSPA4_W 0.000000 320.007405 /end CHARACTERISTIC
/begin CHARACTERISTIC ADWHDS " INHDS: test input as AD values." VALUE 0xA81E DTYPE_UW 0 Compur_WSPA4_W 0.000000 320.007405 /end CHARACTERISTIC
/begin CHARACTERISTIC ADWETS " INETS: Test input AD value for evaporator temperature sensor." VALUE 0xA846 DTYPE_UW 0 Compur_WSPA4_W 0.000000 320.007405 /end CHARACTERISTIC
/begin CHARACTERISTIC ADWCWTSPE " INCWTS: Test input AD value for PE coolant temperature." VALUE 0xA838 DTYPE_UW 0 Compur_WSPA4_W 0.000000 320.007405 /end CHARACTERISTIC
/begin CHARACTERISTIC ADWCWTSBAT " INCWTS: Test input AD value for battery coolant temperature." VALUE 0xA836 DTYPE_UW 0 Compur_WSPA4_W 0.000000 320.007405 /end CHARACTERISTIC
/begin CHARACTERISTIC ADWATS " INATS: Test input AD value for Ambient temperature sensor." VALUE 0xA830 DTYPE_UW 0 Compur_WSPA4_W 0.000000 320.007405 /end CHARACTERISTIC
/begin FUNCTION DEMO_FLAG "ON/OFF Signals DISPLAY." /end FUNCTION
/end MODULE
/end PROJECT
